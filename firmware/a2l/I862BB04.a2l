ASAP2_VERSION 1 60
/begin PROJECT M74_9 "ИТЭЛМА M74.9, сгенерировано tools/mka2l.py"
/begin HEADER "из таблицы дескрипторов @0x416D4, 2545 записей" VERSION "I862BB04_w2346b4" /end HEADER
/begin MODULE I862BB04_w2346b4 "I862BB04_w2346b4"
/begin MOD_COMMON "" BYTE_ORDER MSB_LAST ALIGNMENT_BYTE 1 ALIGNMENT_WORD 1 ALIGNMENT_LONG 1 /end MOD_COMMON
/begin COMPU_METHOD CM_RAW "сырое значение" RAT_FUNC "%.3" "" COEFFS 0 1 0 0 0 1 /end COMPU_METHOD
/begin COMPU_METHOD CM_KMH64 "скорость, км/ч (сырое / 64)" RAT_FUNC "%.3" "km/h" COEFFS 0 1 0 0 0 64 /end COMPU_METHOD
/begin COMPU_METHOD CM_C128 "температура, °C (сырое / 128)" RAT_FUNC "%.3" "degC" COEFFS 0 1 0 0 0 128 /end COMPU_METHOD
/begin COMPU_METHOD CM_P128 "педаль / запрос, % (сырое / 128)" RAT_FUNC "%.3" "%" COEFFS 0 1 0 0 0 128 /end COMPU_METHOD
/begin COMPU_METHOD CM_RPM2 "обороты, об/мин (сырое / 2)" RAT_FUNC "%.3" "rpm" COEFFS 0 1 0 0 0 2 /end COMPU_METHOD
/begin RECORD_LAYOUT RL_AX_UWORD_17 AXIS_PTS_X 1 UWORD INDEX_INCR DIRECT FIX_NO_AXIS_PTS_X 17 /end RECORD_LAYOUT
/begin RECORD_LAYOUT RL_AX_SWORD_16 AXIS_PTS_X 1 SWORD INDEX_INCR DIRECT FIX_NO_AXIS_PTS_X 16 /end RECORD_LAYOUT
/begin RECORD_LAYOUT RL_AX_UWORD_14 AXIS_PTS_X 1 UWORD INDEX_INCR DIRECT FIX_NO_AXIS_PTS_X 14 /end RECORD_LAYOUT
/begin RECORD_LAYOUT RL_AX_UWORD_24 AXIS_PTS_X 1 UWORD INDEX_INCR DIRECT FIX_NO_AXIS_PTS_X 24 /end RECORD_LAYOUT
/begin RECORD_LAYOUT RL_AX_UWORD_15 AXIS_PTS_X 1 UWORD INDEX_INCR DIRECT FIX_NO_AXIS_PTS_X 15 /end RECORD_LAYOUT
/begin RECORD_LAYOUT RL_AX_SBYTE_4 AXIS_PTS_X 1 SBYTE INDEX_INCR DIRECT FIX_NO_AXIS_PTS_X 4 /end RECORD_LAYOUT
/begin RECORD_LAYOUT RL_AX_SBYTE_3 AXIS_PTS_X 1 SBYTE INDEX_INCR DIRECT FIX_NO_AXIS_PTS_X 3 /end RECORD_LAYOUT
/begin RECORD_LAYOUT RL_AX_SWORD_9 AXIS_PTS_X 1 SWORD INDEX_INCR DIRECT FIX_NO_AXIS_PTS_X 9 /end RECORD_LAYOUT
/begin RECORD_LAYOUT RL_AX_UWORD_9 AXIS_PTS_X 1 UWORD INDEX_INCR DIRECT FIX_NO_AXIS_PTS_X 9 /end RECORD_LAYOUT
/begin RECORD_LAYOUT RL_AX_UWORD_10 AXIS_PTS_X 1 UWORD INDEX_INCR DIRECT FIX_NO_AXIS_PTS_X 10 /end RECORD_LAYOUT
/begin RECORD_LAYOUT RL_AX_UWORD_21 AXIS_PTS_X 1 UWORD INDEX_INCR DIRECT FIX_NO_AXIS_PTS_X 21 /end RECORD_LAYOUT
/begin RECORD_LAYOUT RL_AX_UWORD_16 AXIS_PTS_X 1 UWORD INDEX_INCR DIRECT FIX_NO_AXIS_PTS_X 16 /end RECORD_LAYOUT
/begin RECORD_LAYOUT RL_AX_UWORD_18 AXIS_PTS_X 1 UWORD INDEX_INCR DIRECT FIX_NO_AXIS_PTS_X 18 /end RECORD_LAYOUT
/begin RECORD_LAYOUT RL_AX_UWORD_6 AXIS_PTS_X 1 UWORD INDEX_INCR DIRECT FIX_NO_AXIS_PTS_X 6 /end RECORD_LAYOUT
/begin RECORD_LAYOUT RL_AX_UBYTE_2 AXIS_PTS_X 1 UBYTE INDEX_INCR DIRECT FIX_NO_AXIS_PTS_X 2 /end RECORD_LAYOUT
/begin RECORD_LAYOUT RL_AX_UWORD_12 AXIS_PTS_X 1 UWORD INDEX_INCR DIRECT FIX_NO_AXIS_PTS_X 12 /end RECORD_LAYOUT
/begin RECORD_LAYOUT RL_AX_SBYTE_7 AXIS_PTS_X 1 SBYTE INDEX_INCR DIRECT FIX_NO_AXIS_PTS_X 7 /end RECORD_LAYOUT
/begin RECORD_LAYOUT RL_AX_UWORD_5 AXIS_PTS_X 1 UWORD INDEX_INCR DIRECT FIX_NO_AXIS_PTS_X 5 /end RECORD_LAYOUT
/begin RECORD_LAYOUT RL_AX_UWORD_7 AXIS_PTS_X 1 UWORD INDEX_INCR DIRECT FIX_NO_AXIS_PTS_X 7 /end RECORD_LAYOUT
/begin RECORD_LAYOUT RL_AX_UWORD_8 AXIS_PTS_X 1 UWORD INDEX_INCR DIRECT FIX_NO_AXIS_PTS_X 8 /end RECORD_LAYOUT
/begin RECORD_LAYOUT RL_AX_SBYTE_2 AXIS_PTS_X 1 SBYTE INDEX_INCR DIRECT FIX_NO_AXIS_PTS_X 2 /end RECORD_LAYOUT
/begin RECORD_LAYOUT RL_AX_SWORD_8 AXIS_PTS_X 1 SWORD INDEX_INCR DIRECT FIX_NO_AXIS_PTS_X 8 /end RECORD_LAYOUT
/begin RECORD_LAYOUT RL_AX_UWORD_11 AXIS_PTS_X 1 UWORD INDEX_INCR DIRECT FIX_NO_AXIS_PTS_X 11 /end RECORD_LAYOUT
/begin RECORD_LAYOUT RL_AX_SBYTE_8 AXIS_PTS_X 1 SBYTE INDEX_INCR DIRECT FIX_NO_AXIS_PTS_X 8 /end RECORD_LAYOUT
/begin RECORD_LAYOUT RL_AX_SBYTE_6 AXIS_PTS_X 1 SBYTE INDEX_INCR DIRECT FIX_NO_AXIS_PTS_X 6 /end RECORD_LAYOUT
/begin RECORD_LAYOUT RL_AX_SBYTE_9 AXIS_PTS_X 1 SBYTE INDEX_INCR DIRECT FIX_NO_AXIS_PTS_X 9 /end RECORD_LAYOUT
/begin RECORD_LAYOUT RL_AX_UBYTE_4 AXIS_PTS_X 1 UBYTE INDEX_INCR DIRECT FIX_NO_AXIS_PTS_X 4 /end RECORD_LAYOUT
/begin RECORD_LAYOUT RL_AX_UBYTE_10 AXIS_PTS_X 1 UBYTE INDEX_INCR DIRECT FIX_NO_AXIS_PTS_X 10 /end RECORD_LAYOUT
/begin RECORD_LAYOUT RL_AX_UWORD_2 AXIS_PTS_X 1 UWORD INDEX_INCR DIRECT FIX_NO_AXIS_PTS_X 2 /end RECORD_LAYOUT
/begin RECORD_LAYOUT RL_AX_UBYTE_8 AXIS_PTS_X 1 UBYTE INDEX_INCR DIRECT FIX_NO_AXIS_PTS_X 8 /end RECORD_LAYOUT
/begin RECORD_LAYOUT RL_AX_SBYTE_5 AXIS_PTS_X 1 SBYTE INDEX_INCR DIRECT FIX_NO_AXIS_PTS_X 5 /end RECORD_LAYOUT
/begin RECORD_LAYOUT RL_FNC_SWORD FNC_VALUES 1 SWORD ROW_DIR DIRECT /end RECORD_LAYOUT
/begin RECORD_LAYOUT RL_FNC_UWORD FNC_VALUES 1 UWORD ROW_DIR DIRECT /end RECORD_LAYOUT
/begin RECORD_LAYOUT RL_FNC_UBYTE FNC_VALUES 1 UBYTE ROW_DIR DIRECT /end RECORD_LAYOUT
/begin RECORD_LAYOUT RL_FNC_SBYTE FNC_VALUES 1 SBYTE ROW_DIR DIRECT /end RECORD_LAYOUT
/begin RECORD_LAYOUT RL_FNC_ULONG FNC_VALUES 1 ULONG ROW_DIR DIRECT /end RECORD_LAYOUT
/begin RECORD_LAYOUT RL_FNC_SLONG FNC_VALUES 1 SLONG ROW_DIR DIRECT /end RECORD_LAYOUT
/begin AXIS_PTS AX_001_N "ось #001, обороты двигателя [да (60e6/период в 0x1FD40; единица 0,5 об/мин — вероятно)]" 0x080614B4 AXIN_001_N RL_AX_UWORD_17 0 CM_RPM2 17 0 32767.5 /end AXIS_PTS
/begin AXIS_PTS AX_002_TAIR "ось #002, температура воздуха на впуске, АЦП канал 8 [вероятно]" 0x08061580 AXIN_002_TAIR RL_AX_SWORD_16 0 CM_C128 16 -256 255.992 /end AXIS_PTS
/begin AXIS_PTS AX_003_UBAT "ось #003, напряжение бортсети? (масштаб не установлен) [вероятно]" 0x08061108 AXIN_003_UBAT RL_AX_UWORD_14 0 CM_RAW 14 0 65535 /end AXIS_PTS
/begin AXIS_PTS AX_004_TCOOL "ось #004, температура двигателя (ОЖ), АЦП канал 9 [вероятно]" 0x08061220 AXIN_004_TCOOL RL_AX_SWORD_16 0 CM_C128 16 -256 255.992 /end AXIS_PTS
/begin AXIS_PTS AX_005_N "ось #005, обороты двигателя [да (60e6/период в 0x1FD40; единица 0,5 об/мин — вероятно)]" 0x080613EC AXIN_005_N RL_AX_UWORD_24 0 CM_RPM2 24 0 32767.5 /end AXIS_PTS
/begin AXIS_PTS AX_006 "ось #006" 0x080615D0 AXIN_006 RL_AX_UWORD_15 0 CM_RAW 15 0 65535 /end AXIS_PTS
/begin AXIS_PTS AX_00A_TCOOL "ось #00A, температура двигателя (ОЖ), АЦП канал 9 [вероятно]" 0x0806120C AXIN_00A_TCOOL RL_AX_SWORD_9 0 CM_C128 9 -256 255.992 /end AXIS_PTS
/begin AXIS_PTS AX_00B "ось #00B" 0x080612B0 AXIN_00B RL_AX_UWORD_9 0 CM_RAW 9 0 65535 /end AXIS_PTS
/begin AXIS_PTS AX_00C_N "ось #00C, обороты двигателя [да (60e6/период в 0x1FD40; единица 0,5 об/мин — вероятно)]" 0x08061454 AXIN_00C_N RL_AX_UWORD_10 0 CM_RPM2 10 0 32767.5 /end AXIS_PTS
/begin AXIS_PTS AX_00E "ось #00E" 0x08060A78 AXIN_00E RL_AX_UWORD_21 0 CM_RAW 21 0 65535 /end AXIS_PTS
/begin AXIS_PTS AX_00F "ось #00F" 0x08060270 AXIN_00F RL_AX_UWORD_16 0 CM_RAW 16 0 65535 /end AXIS_PTS
/begin AXIS_PTS AX_013 "ось #013" 0x08060164 AXIN_013 RL_AX_UBYTE_2 0 CM_RAW 2 0 255 /end AXIS_PTS
/begin AXIS_PTS AX_01B_PEDAL "ось #01B, положение педали газа [да]" 0x080610D4 AXIN_01B_PEDAL RL_AX_UWORD_16 0 CM_P128 16 0 511.992 /end AXIS_PTS
/begin AXIS_PTS AX_01E_LOAD "ось #01E, нагрузка / наполнение (0x3C28 / 0x3C30 / 0x3C34), масштаб не установлен [вероятно]" 0x08061264 AXIN_01E_LOAD RL_AX_UWORD_10 0 CM_RAW 10 0 65535 /end AXIS_PTS
/begin AXIS_PTS AX_027_N "ось #027, обороты двигателя [да (60e6/период в 0x1FD40; единица 0,5 об/мин — вероятно)]" 0x080606EC AXIN_027_N RL_AX_UWORD_14 0 CM_RPM2 14 0 32767.5 /end AXIS_PTS
/begin AXIS_PTS AX_029 "ось #029" 0x08060708 AXIN_029 RL_AX_UWORD_5 0 CM_RAW 5 0 65535 /end AXIS_PTS
/begin AXIS_PTS AX_036 "ось #036" 0x0806052C AXIN_036 RL_AX_UWORD_7 0 CM_RAW 7 0 65535 /end AXIS_PTS
/begin AXIS_PTS AX_039_LOAD "ось #039, нагрузка / наполнение (0x3C28 / 0x3C30 / 0x3C34), масштаб не установлен [вероятно]" 0x08060714 AXIN_039_LOAD RL_AX_UWORD_9 0 CM_RAW 9 0 65535 /end AXIS_PTS
/begin AXIS_PTS AX_03A_N "ось #03A, обороты двигателя [да (60e6/период в 0x1FD40; единица 0,5 об/мин — вероятно)]" 0x08060728 AXIN_03A_N RL_AX_UWORD_24 0 CM_RPM2 24 0 32767.5 /end AXIS_PTS
/begin AXIS_PTS AX_045_TCOOL "ось #045, температура двигателя (ОЖ), АЦП канал 9 [вероятно]" 0x08061188 AXIN_045_TCOOL RL_AX_SWORD_9 0 CM_C128 9 -256 255.992 /end AXIS_PTS
/begin AXIS_PTS AX_049_TAIR "ось #049, температура воздуха на впуске, АЦП канал 8 [вероятно]" 0x08061570 AXIN_049_TAIR RL_AX_SWORD_8 0 CM_C128 8 -256 255.992 /end AXIS_PTS
/begin AXIS_PTS AX_04B_N "ось #04B, обороты двигателя [да (60e6/период в 0x1FD40; единица 0,5 об/мин — вероятно)]" 0x080607D8 AXIN_04B_N RL_AX_UWORD_8 0 CM_RPM2 8 0 32767.5 /end AXIS_PTS
/begin AXIS_PTS AX_04C_LOAD "ось #04C, нагрузка / наполнение (0x3C28 / 0x3C30 / 0x3C34), масштаб не установлен [вероятно]" 0x080607E8 AXIN_04C_LOAD RL_AX_UWORD_10 0 CM_RAW 10 0 65535 /end AXIS_PTS
/begin AXIS_PTS AX_04D "ось #04D" 0x080607FC AXIN_04D RL_AX_UWORD_10 0 CM_RAW 10 0 65535 /end AXIS_PTS
/begin AXIS_PTS AX_04E "ось #04E" 0x08060810 AXIN_04E RL_AX_UWORD_8 0 CM_RAW 8 0 65535 /end AXIS_PTS
/begin AXIS_PTS AX_050_N "ось #050, обороты двигателя [да (60e6/период в 0x1FD40; единица 0,5 об/мин — вероятно)]" 0x0806141C AXIN_050_N RL_AX_UWORD_8 0 CM_RPM2 8 0 32767.5 /end AXIS_PTS
/begin AXIS_PTS AX_059 "ось #059" 0x08060BC0 AXIN_059 RL_AX_UWORD_11 0 CM_RAW 11 0 65535 /end AXIS_PTS
/begin AXIS_PTS AX_05E_GEAR "ось #05E, номер передачи 0…7 [вероятно]" 0x08061548 AXIN_05E_GEAR RL_AX_SBYTE_8 0 CM_RAW 8 -128 127 /end AXIS_PTS
/begin AXIS_PTS AX_060 "ось #060" 0x080605F8 AXIN_060 RL_AX_SBYTE_4 0 CM_RAW 4 -128 127 /end AXIS_PTS
/begin AXIS_PTS AX_061 "ось #061" 0x08060604 AXIN_061 RL_AX_SBYTE_6 0 CM_RAW 6 -128 127 /end AXIS_PTS
/begin AXIS_PTS AX_062 "ось #062" 0x080605FC AXIN_062 RL_AX_SBYTE_7 0 CM_RAW 7 -128 127 /end AXIS_PTS
/begin AXIS_PTS AX_063 "ось #063" 0x08061600 AXIN_063 RL_AX_UWORD_16 0 CM_RAW 16 0 65535 /end AXIS_PTS
/begin AXIS_PTS AX_064 "ось #064" 0x080610F4 AXIN_064 RL_AX_UWORD_6 0 CM_RAW 6 0 65535 /end AXIS_PTS
/begin AXIS_PTS AX_065 "ось #065" 0x08061134 AXIN_065 RL_AX_UWORD_8 0 CM_RAW 8 0 65535 /end AXIS_PTS
/begin AXIS_PTS AX_066 "ось #066" 0x08060040 AXIN_066 RL_AX_UWORD_6 0 CM_RAW 6 0 65535 /end AXIS_PTS
/begin AXIS_PTS AX_067 "ось #067" 0x0806004C AXIN_067 RL_AX_UWORD_6 0 CM_RAW 6 0 65535 /end AXIS_PTS
/begin AXIS_PTS AX_068 "ось #068" 0x08060058 AXIN_068 RL_AX_SBYTE_8 0 CM_RAW 8 -128 127 /end AXIS_PTS
/begin AXIS_PTS AX_069 "ось #069" 0x08060060 AXIN_069 RL_AX_UWORD_10 0 CM_RAW 10 0 65535 /end AXIS_PTS
/begin AXIS_PTS AX_06A_N "ось #06A, обороты двигателя [да (60e6/период в 0x1FD40; единица 0,5 об/мин — вероятно)]" 0x080601D4 AXIN_06A_N RL_AX_UWORD_10 0 CM_RPM2 10 0 32767.5 /end AXIS_PTS
/begin AXIS_PTS AX_06B "ось #06B" 0x080601E8 AXIN_06B RL_AX_UWORD_5 0 CM_RAW 5 0 65535 /end AXIS_PTS
/begin AXIS_PTS AX_06C_TAIR "ось #06C, температура воздуха на впуске, АЦП канал 8 [вероятно]" 0x08060220 AXIN_06C_TAIR RL_AX_SWORD_8 0 CM_C128 8 -256 255.992 /end AXIS_PTS
/begin AXIS_PTS AX_06D "ось #06D" 0x08060214 AXIN_06D RL_AX_UWORD_5 0 CM_RAW 5 0 65535 /end AXIS_PTS
/begin AXIS_PTS AX_06E "ось #06E" 0x080615C4 AXIN_06E RL_AX_UWORD_5 0 CM_RAW 5 0 65535 /end AXIS_PTS
/begin AXIS_PTS AX_06F "ось #06F" 0x08060080 AXIN_06F RL_AX_UWORD_8 0 CM_RAW 8 0 65535 /end AXIS_PTS
/begin AXIS_PTS AX_070 "ось #070" 0x0806129C AXIN_070 RL_AX_SBYTE_9 0 CM_RAW 9 -128 127 /end AXIS_PTS
/begin AXIS_PTS AX_071 "ось #071" 0x080612A8 AXIN_071 RL_AX_SBYTE_6 0 CM_RAW 6 -128 127 /end AXIS_PTS
/begin AXIS_PTS AX_072 "ось #072" 0x080602CC AXIN_072 RL_AX_SBYTE_2 0 CM_RAW 2 -128 127 /end AXIS_PTS
/begin AXIS_PTS AX_073 "ось #073" 0x080602D0 AXIN_073 RL_AX_SBYTE_2 0 CM_RAW 2 -128 127 /end AXIS_PTS
/begin AXIS_PTS AX_074_LOAD "ось #074, нагрузка / наполнение (0x3C28 / 0x3C30 / 0x3C34), масштаб не установлен [вероятно]" 0x080606AC AXIN_074_LOAD RL_AX_UWORD_9 0 CM_RAW 9 0 65535 /end AXIS_PTS
/begin AXIS_PTS AX_075_N "ось #075, обороты двигателя [да (60e6/период в 0x1FD40; единица 0,5 об/мин — вероятно)]" 0x080606C0 AXIN_075_N RL_AX_UWORD_14 0 CM_RPM2 14 0 32767.5 /end AXIS_PTS
/begin AXIS_PTS AX_076 "ось #076" 0x080612F4 AXIN_076 RL_AX_UWORD_18 0 CM_RAW 18 0 65535 /end AXIS_PTS
/begin AXIS_PTS AX_077 "ось #077" 0x08060ACC AXIN_077 RL_AX_UWORD_9 0 CM_RAW 9 0 65535 /end AXIS_PTS
/begin AXIS_PTS AX_078 "ось #078" 0x080609F8 AXIN_078 RL_AX_UWORD_16 0 CM_RAW 16 0 65535 /end AXIS_PTS
/begin AXIS_PTS AX_079 "ось #079" 0x08060A28 AXIN_079 RL_AX_UWORD_16 0 CM_RAW 16 0 65535 /end AXIS_PTS
/begin AXIS_PTS AX_07A_LOAD "ось #07A, нагрузка / наполнение (0x3C28 / 0x3C30 / 0x3C34), масштаб не установлен [вероятно]" 0x080609C8 AXIN_07A_LOAD RL_AX_UWORD_16 0 CM_RAW 16 0 65535 /end AXIS_PTS
/begin AXIS_PTS AX_07B_LOAD "ось #07B, нагрузка / наполнение (0x3C28 / 0x3C30 / 0x3C34), масштаб не установлен [вероятно]" 0x080609E8 AXIN_07B_LOAD RL_AX_UWORD_8 0 CM_RAW 8 0 65535 /end AXIS_PTS
/begin AXIS_PTS AX_07C "ось #07C" 0x08060A18 AXIN_07C RL_AX_UWORD_8 0 CM_RAW 8 0 65535 /end AXIS_PTS
/begin AXIS_PTS AX_07E_PEDAL "ось #07E, положение педали газа [да]" 0x08060034 AXIN_07E_PEDAL RL_AX_UWORD_6 0 CM_P128 6 0 511.992 /end AXIS_PTS
/begin AXIS_PTS AX_07F_LOAD "ось #07F, нагрузка / наполнение (0x3C28 / 0x3C30 / 0x3C34), масштаб не установлен [вероятно]" 0x08060494 AXIN_07F_LOAD RL_AX_UWORD_12 0 CM_RAW 12 0 65535 /end AXIS_PTS
/begin AXIS_PTS AX_081 "ось #081" 0x08061338 AXIN_081 RL_AX_UWORD_14 0 CM_RAW 14 0 65535 /end AXIS_PTS
/begin AXIS_PTS AX_082 "ось #082" 0x08061144 AXIN_082 RL_AX_UWORD_17 0 CM_RAW 17 0 65535 /end AXIS_PTS
/begin AXIS_PTS AX_084 "ось #084" 0x08060174 AXIN_084 RL_AX_UBYTE_4 0 CM_RAW 4 0 255 /end AXIS_PTS
/begin AXIS_PTS AX_086 "ось #086" 0x08060154 AXIN_086 RL_AX_UBYTE_10 0 CM_RAW 10 0 255 /end AXIS_PTS
/begin AXIS_PTS AX_087 "ось #087" 0x08060160 AXIN_087 RL_AX_SBYTE_2 0 CM_RAW 2 -128 127 /end AXIS_PTS
/begin AXIS_PTS AX_088 "ось #088" 0x08060168 AXIN_088 RL_AX_UWORD_6 0 CM_RAW 6 0 65535 /end AXIS_PTS
/begin AXIS_PTS AX_089_LOAD "ось #089, нагрузка / наполнение (0x3C28 / 0x3C30 / 0x3C34), масштаб не установлен [вероятно]" 0x08060484 AXIN_089_LOAD RL_AX_UWORD_8 0 CM_RAW 8 0 65535 /end AXIS_PTS
/begin AXIS_PTS AX_08A_TCOOL "ось #08A, температура двигателя (ОЖ), АЦП канал 9 [вероятно]" 0x08060474 AXIN_08A_TCOOL RL_AX_SWORD_8 0 CM_C128 8 -256 255.992 /end AXIS_PTS
/begin AXIS_PTS AX_08B "ось #08B" 0x08060230 AXIN_08B RL_AX_SBYTE_3 0 CM_RAW 3 -128 127 /end AXIS_PTS
/begin AXIS_PTS AX_094 "ось #094" 0x080602D8 AXIN_094 RL_AX_SBYTE_3 0 CM_RAW 3 -128 127 /end AXIS_PTS
/begin AXIS_PTS AX_095 "ось #095" 0x080602DC AXIN_095 RL_AX_SBYTE_3 0 CM_RAW 3 -128 127 /end AXIS_PTS
/begin AXIS_PTS AX_096 "ось #096" 0x080602D4 AXIN_096 RL_AX_SBYTE_4 0 CM_RAW 4 -128 127 /end AXIS_PTS
/begin AXIS_PTS AX_097 "ось #097" 0x080615A0 AXIN_097 RL_AX_UWORD_10 0 CM_RAW 10 0 65535 /end AXIS_PTS
/begin AXIS_PTS AX_098 "ось #098" 0x080601F4 AXIN_098 RL_AX_UWORD_15 0 CM_RAW 15 0 65535 /end AXIS_PTS
/begin AXIS_PTS AX_099 "ось #099" 0x08060B68 AXIN_099 RL_AX_UWORD_2 0 CM_RAW 2 0 65535 /end AXIS_PTS
/begin AXIS_PTS AX_09B "ось #09B" 0x080600EC AXIN_09B RL_AX_UWORD_15 0 CM_RAW 15 0 65535 /end AXIS_PTS
/begin AXIS_PTS AX_09C "ось #09C" 0x0806010C AXIN_09C RL_AX_UWORD_17 0 CM_RAW 17 0 65535 /end AXIS_PTS
/begin AXIS_PTS AX_09D "ось #09D" 0x080600C8 AXIN_09D RL_AX_UWORD_17 0 CM_RAW 17 0 65535 /end AXIS_PTS
/begin AXIS_PTS AX_09E_GEAR "ось #09E, номер передачи 0…7 [вероятно]" 0x08060130 AXIN_09E_GEAR RL_AX_UBYTE_8 0 CM_RAW 8 0 255 /end AXIS_PTS
/begin AXIS_PTS AX_09F "ось #09F" 0x08060138 AXIN_09F RL_AX_UWORD_10 0 CM_RAW 10 0 65535 /end AXIS_PTS
/begin AXIS_PTS AX_0A0 "ось #0A0, индекс 0…7 (похоже, передача)" 0x080604E0 AXIN_0A0 RL_AX_SBYTE_8 0 CM_RAW 8 -128 127 /end AXIS_PTS
/begin AXIS_PTS AX_0A2 "ось #0A2" 0x08060178 AXIN_0A2 RL_AX_UBYTE_4 0 CM_RAW 4 0 255 /end AXIS_PTS
/begin AXIS_PTS AX_0A3 "ось #0A3" 0x08060834 AXIN_0A3 RL_AX_UWORD_14 0 CM_RAW 14 0 65535 /end AXIS_PTS
/begin AXIS_PTS AX_0A4 "ось #0A4" 0x08060850 AXIN_0A4 RL_AX_SBYTE_3 0 CM_RAW 3 -128 127 /end AXIS_PTS
/begin AXIS_PTS AX_0A5 "ось #0A5" 0x08060854 AXIN_0A5 RL_AX_SBYTE_2 0 CM_RAW 2 -128 127 /end AXIS_PTS
/begin AXIS_PTS AX_0A6 "ось #0A6" 0x08060858 AXIN_0A6 RL_AX_SBYTE_2 0 CM_RAW 2 -128 127 /end AXIS_PTS
/begin AXIS_PTS AX_0A8 "ось #0A8" 0x08060880 AXIN_0A8 RL_AX_SBYTE_2 0 CM_RAW 2 -128 127 /end AXIS_PTS
/begin AXIS_PTS AX_0A9 "ось #0A9" 0x08060090 AXIN_0A9 RL_AX_SBYTE_5 0 CM_RAW 5 -128 127 /end AXIS_PTS
/begin AXIS_PTS AX_0AA "ось #0AA" 0x08060A50 AXIN_0AA RL_AX_UWORD_14 0 CM_RAW 14 0 65535 /end AXIS_PTS
/begin AXIS_PTS AX_0AB "ось #0AB" 0x08060A6C AXIN_0AB RL_AX_UWORD_6 0 CM_RAW 6 0 65535 /end AXIS_PTS
/begin AXIS_PTS AX_0B1_N "ось #0B1, обороты двигателя [да (60e6/период в 0x1FD40; единица 0,5 об/мин — вероятно)]" 0x08060E38 AXIN_0B1_N RL_AX_UWORD_11 0 CM_RPM2 11 0 32767.5 /end AXIS_PTS
/begin AXIS_PTS AX_0CD_N "ось #0CD, обороты двигателя [да (60e6/период в 0x1FD40; единица 0,5 об/мин — вероятно)]" 0x080613BC AXIN_0CD_N RL_AX_UWORD_24 0 CM_RPM2 24 0 32767.5 /end AXIS_PTS
/begin AXIS_PTS AX_0DE "ось #0DE" 0x08060868 AXIN_0DE RL_AX_UWORD_10 0 CM_RAW 10 0 65535 /end AXIS_PTS
/begin AXIS_PTS AX_0FE_N "ось #0FE, обороты двигателя [да (60e6/период в 0x1FD40; единица 0,5 об/мин — вероятно)]" 0x08060628 AXIN_0FE_N RL_AX_UWORD_10 0 CM_RPM2 10 0 32767.5 /end AXIS_PTS
/begin CHARACTERISTIC CAL_344 "массив #344" VAL_BLK 0x080619DC RL_FNC_UWORD 0 CM_RAW 0 65535 MATRIX_DIM 2 1 1 /end CHARACTERISTIC
/begin CHARACTERISTIC CAL_345 "значение #345" VALUE 0x080619E0 RL_FNC_SWORD 0 CM_RAW -32768 32767 /end CHARACTERISTIC
/begin CHARACTERISTIC CAL_346 "значение #346" VALUE 0x080619E2 RL_FNC_SWORD 0 CM_RAW -32768 32767 /end CHARACTERISTIC
/begin CHARACTERISTIC CAL_347 "значение #347" VALUE 0x08061A0C RL_FNC_UWORD 0 CM_RAW 0 65535 /end CHARACTERISTIC
/begin CHARACTERISTIC CAL_348_0 "кривая #348 10: N [1/2]" CURVE 0x080619E4 RL_FNC_UWORD 0 CM_RAW 0 65535
 /begin AXIS_DESCR COM_AXIS AXIN_00C_N CM_RPM2 10 0 32767.5 AXIS_PTS_REF AX_00C_N /end AXIS_DESCR
/end CHARACTERISTIC
/begin CHARACTERISTIC CAL_348_1 "кривая #348 10: N [2/2]" CURVE 0x080619F8 RL_FNC_UWORD 0 CM_RAW 0 65535
 /begin AXIS_DESCR COM_AXIS AXIN_00C_N CM_RPM2 10 0 32767.5 AXIS_PTS_REF AX_00C_N /end AXIS_DESCR
/end CHARACTERISTIC
/begin CHARACTERISTIC CAL_349 "значение #349" VALUE 0x08061A0E RL_FNC_UWORD 0 CM_RAW 0 65535 /end CHARACTERISTIC
/begin CHARACTERISTIC CAL_34A "значение #34A" VALUE 0x08061A10 RL_FNC_UWORD 0 CM_RAW 0 65535 /end CHARACTERISTIC
/begin CHARACTERISTIC CAL_34B "массив #34B" VAL_BLK 0x08061A14 RL_FNC_UWORD 0 CM_RAW 0 65535 MATRIX_DIM 2 1 1 /end CHARACTERISTIC
/begin CHARACTERISTIC CAL_34C "значение #34C" VALUE 0x08061A18 RL_FNC_SWORD 0 CM_RAW -32768 32767 /end CHARACTERISTIC
/begin CHARACTERISTIC CAL_34D "значение #34D" VALUE 0x08061A20 RL_FNC_UWORD 0 CM_RAW 0 65535 /end CHARACTERISTIC
/begin CHARACTERISTIC CAL_34E "массив #34E" VAL_BLK 0x08061A1C RL_FNC_UWORD 0 CM_RAW 0 65535 MATRIX_DIM 2 1 1 /end CHARACTERISTIC
/begin CHARACTERISTIC CAL_34F "значение #34F" VALUE 0x08061A22 RL_FNC_UWORD 0 CM_RAW 0 65535 /end CHARACTERISTIC
/begin CHARACTERISTIC CAL_350 "значение #350" VALUE 0x08061A24 RL_FNC_UWORD 0 CM_RAW 0 65535 /end CHARACTERISTIC
/begin CHARACTERISTIC CAL_351 "значение #351" VALUE 0x08061A26 RL_FNC_UWORD 0 CM_RAW 0 65535 /end CHARACTERISTIC
/begin CHARACTERISTIC CAL_352 "значение #352" VALUE 0x08061A28 RL_FNC_UWORD 0 CM_RAW 0 65535 /end CHARACTERISTIC
/begin CHARACTERISTIC CAL_353 "значение #353" VALUE 0x08061A2A RL_FNC_UWORD 0 CM_RAW 0 65535 /end CHARACTERISTIC
/begin CHARACTERISTIC CAL_354 "значение #354" VALUE 0x08061A2C RL_FNC_UWORD 0 CM_RAW 0 65535 /end CHARACTERISTIC
/begin CHARACTERISTIC CAL_355 "значение #355" VALUE 0x08061A30 RL_FNC_UWORD 0 CM_RAW 0 65535 /end CHARACTERISTIC
/begin CHARACTERISTIC CAL_356 "значение #356" VALUE 0x08061A32 RL_FNC_UWORD 0 CM_RAW 0 65535 /end CHARACTERISTIC
/begin CHARACTERISTIC CAL_357 "значение #357" VALUE 0x08061A34 RL_FNC_UWORD 0 CM_RAW 0 65535 /end CHARACTERISTIC
/begin CHARACTERISTIC CAL_358 "значение #358" VALUE 0x08061A2E RL_FNC_UWORD 0 CM_RAW 0 65535 /end CHARACTERISTIC
/begin CHARACTERISTIC CAL_359 "кривая #359 10: N" CURVE 0x08061A38 RL_FNC_UWORD 0 CM_RAW 0 65535
 /begin AXIS_DESCR COM_AXIS AXIN_00C_N CM_RPM2 10 0 32767.5 AXIS_PTS_REF AX_00C_N /end AXIS_DESCR
/end CHARACTERISTIC
/begin CHARACTERISTIC CAL_35A "массив #35A" VAL_BLK 0x08061A4C RL_FNC_UWORD 0 CM_RAW 0 65535 MATRIX_DIM 2 1 1 /end CHARACTERISTIC
/begin CHARACTERISTIC CAL_35C "значение #35C" VALUE 0x08061996 RL_FNC_SWORD 0 CM_RAW -32768 32767 /end CHARACTERISTIC
/begin CHARACTERISTIC CAL_35D "значение #35D" VALUE 0x0806199C RL_FNC_UWORD 0 CM_RAW 0 65535 /end CHARACTERISTIC
/begin CHARACTERISTIC CAL_35E "массив #35E" VAL_BLK 0x080619A0 RL_FNC_UWORD 0 CM_RAW 0 65535 MATRIX_DIM 2 1 1 /end CHARACTERISTIC
/begin CHARACTERISTIC CAL_35F "массив #35F" VAL_BLK 0x080619A4 RL_FNC_UWORD 0 CM_RAW 0 65535 MATRIX_DIM 2 1 1 /end CHARACTERISTIC
/begin CHARACTERISTIC CAL_360 "значение #360" VALUE 0x080619B0 RL_FNC_UWORD 0 CM_RAW 0 65535 /end CHARACTERISTIC
/begin CHARACTERISTIC CAL_361 "значение #361" VALUE 0x080619B2 RL_FNC_UWORD 0 CM_RAW 0 65535 /end CHARACTERISTIC
/begin CHARACTERISTIC CAL_362 "значение #362" VALUE 0x08074998 RL_FNC_SBYTE 0 CM_RAW -128 127 /end CHARACTERISTIC
/begin CHARACTERISTIC CAL_363 "кривая #363 9: TCOOL" CURVE 0x08064640 RL_FNC_UWORD 0 CM_RAW 0 65535
 /begin AXIS_DESCR COM_AXIS AXIN_00A_TCOOL CM_C128 9 -256 255.992 AXIS_PTS_REF AX_00A_TCOOL /end AXIS_DESCR
/end CHARACTERISTIC
/begin CHARACTERISTIC CAL_365 "значение #365" VALUE 0x0806820E RL_FNC_SBYTE 0 CM_RAW -128 127 /end CHARACTERISTIC
/begin CHARACTERISTIC CAL_366 "карта #366 4x6: ? × ?" MAP 0x08068210 RL_FNC_UBYTE 0 CM_RAW 0 255 /begin AXIS_DESCR COM_AXIS AXIN_061 CM_RAW 6 -128 127 AXIS_PTS_REF AX_061 /end AXIS_DESCR /begin AXIS_DESCR COM_AXIS AXIN_060 CM_RAW 4 -128 127 AXIS_PTS_REF AX_060 /end AXIS_DESCR /end CHARACTERISTIC
/begin CHARACTERISTIC CAL_367 "карта #367 4x7: ? × ?" MAP 0x08068228 RL_FNC_SBYTE 0 CM_RAW -128 127 /begin AXIS_DESCR COM_AXIS AXIN_062 CM_RAW 7 -128 127 AXIS_PTS_REF AX_062 /end AXIS_DESCR /begin AXIS_DESCR COM_AXIS AXIN_060 CM_RAW 4 -128 127 AXIS_PTS_REF AX_060 /end AXIS_DESCR /end CHARACTERISTIC
/begin CHARACTERISTIC CAL_368 "значение #368" VALUE 0x080705AE RL_FNC_UWORD 0 CM_RAW 0 65535 /end CHARACTERISTIC
/begin CHARACTERISTIC CAL_369 "значение #369" VALUE 0x08074901 RL_FNC_SBYTE 0 CM_RAW -128 127 /end CHARACTERISTIC
/begin CHARACTERISTIC CAL_36B "значение #36B" VALUE 0x0806F91B RL_FNC_SBYTE 0 CM_RAW -128 127 /end CHARACTERISTIC
/begin CHARACTERISTIC CAL_36C "значение #36C" VALUE 0x0806F93C RL_FNC_ULONG 0 CM_RAW 0 4.29497e+09 /end CHARACTERISTIC
/begin CHARACTERISTIC CAL_36D "массив #36D" VAL_BLK 0x0806F948 RL_FNC_UWORD 0 CM_RAW 0 65535 MATRIX_DIM 2 1 1 /end CHARACTERISTIC
/begin CHARACTERISTIC CAL_36E "значение #36E" VALUE 0x0806F94C RL_FNC_UWORD 0 CM_RAW 0 65535 /end CHARACTERISTIC
/begin CHARACTERISTIC CAL_36F "кривая #36F 9: TCOOL [знак по значениям]" CURVE 0x0806F908 RL_FNC_SWORD 0 CM_RAW -32768 32767
 /begin AXIS_DESCR COM_AXIS AXIN_00A_TCOOL CM_C128 9 -256 255.992 AXIS_PTS_REF AX_00A_TCOOL /end AXIS_DESCR
/end CHARACTERISTIC
/begin CHARACTERISTIC CAL_370 "кривая #370 14: UBAT" CURVE 0x0806F920 RL_FNC_UWORD 0 CM_RAW 0 65535
 /begin AXIS_DESCR COM_AXIS AXIN_003_UBAT CM_RAW 14 0 65535 AXIS_PTS_REF AX_003_UBAT /end AXIS_DESCR
/end CHARACTERISTIC
/begin CHARACTERISTIC CAL_371 "значение #371" VALUE 0x0806F91E RL_FNC_UWORD 0 CM_RAW 0 65535 /end CHARACTERISTIC
/begin CHARACTERISTIC CAL_372 "значение #372" VALUE 0x0806F91C RL_FNC_SWORD 0 CM_RAW -32768 32767 /end CHARACTERISTIC
/begin CHARACTERISTIC CAL_373 "значение #373" VALUE 0x0806F942 RL_FNC_UBYTE 0 CM_RAW 0 255 /end CHARACTERISTIC
/begin CHARACTERISTIC CAL_374 "значение #374" VALUE 0x0806F944 RL_FNC_SBYTE 0 CM_RAW -128 127 /end CHARACTERISTIC
/begin CHARACTERISTIC CAL_375 "значение #375" VALUE 0x0806F945 RL_FNC_SBYTE 0 CM_RAW -128 127 /end CHARACTERISTIC
/begin CHARACTERISTIC CAL_376 "массив #376 [знак по значениям]" VAL_BLK 0x080705C0 RL_FNC_SWORD 0 CM_RAW -32768 32767 MATRIX_DIM 2 1 1 /end CHARACTERISTIC
/begin CHARACTERISTIC CAL_377 "карта #377 5x11: ? × ? [знак по значениям]" MAP 0x08070540 RL_FNC_SWORD 0 CM_RAW -32768 32767 /begin AXIS_DESCR COM_AXIS AXIN_059 CM_RAW 11 0 65535 AXIS_PTS_REF AX_059 /end AXIS_DESCR /begin AXIS_DESCR COM_AXIS AXIN_06E CM_RAW 5 0 65535 AXIS_PTS_REF AX_06E /end AXIS_DESCR /end CHARACTERISTIC
/begin CHARACTERISTIC CAL_378 "значение #378" VALUE 0x0807053C RL_FNC_UWORD 0 CM_RAW 0 65535 /end CHARACTERISTIC
/begin CHARACTERISTIC CAL_379 "кривая #379 16: TCOOL" CURVE 0x08061BE8 RL_FNC_UWORD 0 CM_RAW 0 65535
 /begin AXIS_DESCR COM_AXIS AXIN_004_TCOOL CM_C128 16 -256 255.992 AXIS_PTS_REF AX_004_TCOOL /end AXIS_DESCR
/end CHARACTERISTIC
/begin CHARACTERISTIC CAL_37B "значение #37B" VALUE 0x08062ECE RL_FNC_UWORD 0 CM_RAW 0 65535 /end CHARACTERISTIC
/begin CHARACTERISTIC CAL_37C "значение #37C" VALUE 0x08062ED4 RL_FNC_UWORD 0 CM_RAW 0 65535 /end CHARACTERISTIC
/begin CHARACTERISTIC CAL_37D "массив #37D" VAL_BLK 0x08062ED8 RL_FNC_UWORD 0 CM_RAW 0 65535 MATRIX_DIM 2 1 1 /end CHARACTERISTIC
/begin CHARACTERISTIC CAL_37E "значение #37E" VALUE 0x08062EFC RL_FNC_UWORD 0 CM_RAW 0 65535 /end CHARACTERISTIC
/begin CHARACTERISTIC CAL_37F_0 "кривая #37F 17: N [1/2]" CURVE 0x08062F00 RL_FNC_UWORD 0 CM_RAW 0 65535
 /begin AXIS_DESCR COM_AXIS AXIN_001_N CM_RPM2 17 0 32767.5 AXIS_PTS_REF AX_001_N /end AXIS_DESCR
/end CHARACTERISTIC
/begin CHARACTERISTIC CAL_37F_1 "кривая #37F 17: N [2/2]" CURVE 0x08062F22 RL_FNC_UWORD 0 CM_RAW 0 65535
 /begin AXIS_DESCR COM_AXIS AXIN_001_N CM_RPM2 17 0 32767.5 AXIS_PTS_REF AX_001_N /end AXIS_DESCR
/end CHARACTERISTIC
/begin CHARACTERISTIC CAL_380 "значение #380" VALUE 0x08062F44 RL_FNC_UWORD 0 CM_RAW 0 65535 /end CHARACTERISTIC
/begin CHARACTERISTIC CAL_381 "значение #381" VALUE 0x08062F46 RL_FNC_UWORD 0 CM_RAW 0 65535 /end CHARACTERISTIC
/begin CHARACTERISTIC CAL_382 "значение #382" VALUE 0x08062F4A RL_FNC_SBYTE 0 CM_RAW -128 127 /end CHARACTERISTIC
/begin CHARACTERISTIC CAL_383 "значение #383" VALUE 0x08062ED0 RL_FNC_SLONG 0 CM_RAW -2.14748e+09 2.14748e+09 /end CHARACTERISTIC
/begin CHARACTERISTIC CAL_384 "кривая #384 16: ?" CURVE 0x08062EDC RL_FNC_UWORD 0 CM_RAW 0 65535 /begin AXIS_DESCR COM_AXIS AXIN_063 CM_RAW 16 0 65535 AXIS_PTS_REF AX_063 /end AXIS_DESCR /end CHARACTERISTIC
/begin CHARACTERISTIC CAL_385 "значение #385" VALUE 0x08062F48 RL_FNC_UWORD 0 CM_RAW 0 65535 /end CHARACTERISTIC
/begin CHARACTERISTIC CAL_386 "значение #386" VALUE 0x08062F4C RL_FNC_UWORD 0 CM_RAW 0 65535 /end CHARACTERISTIC
/begin CHARACTERISTIC CAL_387 "значение #387" VALUE 0x080647BC RL_FNC_UWORD 0 CM_RAW 0 65535 /end CHARACTERISTIC
/begin CHARACTERISTIC CAL_388 "массив #388" VAL_BLK 0x080647C0 RL_FNC_UWORD 0 CM_RAW 0 65535 MATRIX_DIM 2 1 1 /end CHARACTERISTIC
/begin CHARACTERISTIC CAL_389 "кривая #389 10: LOAD" CURVE 0x080647C8 RL_FNC_UWORD 0 CM_RAW 0 65535
 /begin AXIS_DESCR COM_AXIS AXIN_01E_LOAD CM_RAW 10 0 65535 AXIS_PTS_REF AX_01E_LOAD /end AXIS_DESCR
/end CHARACTERISTIC
/begin CHARACTERISTIC CAL_38A "значение #38A" VALUE 0x080647DC RL_FNC_UWORD 0 CM_RAW 0 65535 /end CHARACTERISTIC
/begin CHARACTERISTIC CAL_38B "значение #38B" VALUE 0x08065868 RL_FNC_UWORD 0 CM_RAW 0 65535 /end CHARACTERISTIC
/begin CHARACTERISTIC CAL_38C "карта #38C 9x8: ? × TCOOL [знак по значениям]" MAP 0x08066DF4 RL_FNC_SWORD 0 CM_RAW -32768 32767 /begin AXIS_DESCR COM_AXIS AXIN_065 CM_RAW 8 0 65535 AXIS_PTS_REF AX_065 /end AXIS_DESCR
 /begin AXIS_DESCR COM_AXIS AXIN_00A_TCOOL CM_C128 9 -256 255.992 AXIS_PTS_REF AX_00A_TCOOL /end AXIS_DESCR
/end CHARACTERISTIC
/begin CHARACTERISTIC CAL_38D "значение #38D" VALUE 0x08068052 RL_FNC_SBYTE 0 CM_RAW -128 127 /end CHARACTERISTIC
/begin CHARACTERISTIC CAL_38E "кривая #38E 24: N" CURVE 0x08069948 RL_FNC_UWORD 0 CM_RAW 0 65535
 /begin AXIS_DESCR COM_AXIS AXIN_03A_N CM_RPM2 24 0 32767.5 AXIS_PTS_REF AX_03A_N /end AXIS_DESCR
/end CHARACTERISTIC
/begin CHARACTERISTIC CAL_38F "массив #38F" VAL_BLK 0x08065E7C RL_FNC_UWORD 0 CM_RAW 0 65535 MATRIX_DIM 2 1 1 /end CHARACTERISTIC
/begin CHARACTERISTIC CAL_390 "карта #390 10x8: GEAR × N" MAP 0x08065E80 RL_FNC_UWORD 0 CM_RAW 0 65535
 /begin AXIS_DESCR COM_AXIS AXIN_05E_GEAR CM_RAW 8 -128 127 AXIS_PTS_REF AX_05E_GEAR /end AXIS_DESCR
 /begin AXIS_DESCR COM_AXIS AXIN_00C_N CM_RPM2 10 0 32767.5 AXIS_PTS_REF AX_00C_N /end AXIS_DESCR
/end CHARACTERISTIC
/begin CHARACTERISTIC CAL_391 "карта #391 10x8: GEAR × N" MAP 0x08065F24 RL_FNC_UWORD 0 CM_RAW 0 65535
 /begin AXIS_DESCR COM_AXIS AXIN_05E_GEAR CM_RAW 8 -128 127 AXIS_PTS_REF AX_05E_GEAR /end AXIS_DESCR
 /begin AXIS_DESCR COM_AXIS AXIN_00C_N CM_RPM2 10 0 32767.5 AXIS_PTS_REF AX_00C_N /end AXIS_DESCR
/end CHARACTERISTIC
/begin CHARACTERISTIC CAL_392 "значение #392" VALUE 0x08065F20 RL_FNC_UWORD 0 CM_RAW 0 65535 /end CHARACTERISTIC
/begin CHARACTERISTIC CAL_393 "массив #393" VAL_BLK 0x08065FC4 RL_FNC_SBYTE 0 CM_RAW -128 127 MATRIX_DIM 2 1 1 /end CHARACTERISTIC
/begin CHARACTERISTIC CAL_394 "карта #394 10x8: GEAR × N" MAP 0x08066108 RL_FNC_UWORD 0 CM_RAW 0 65535
 /begin AXIS_DESCR COM_AXIS AXIN_05E_GEAR CM_RAW 8 -128 127 AXIS_PTS_REF AX_05E_GEAR /end AXIS_DESCR
 /begin AXIS_DESCR COM_AXIS AXIN_00C_N CM_RPM2 10 0 32767.5 AXIS_PTS_REF AX_00C_N /end AXIS_DESCR
/end CHARACTERISTIC
/begin CHARACTERISTIC CAL_395 "значение #395" VALUE 0x080661A8 RL_FNC_UWORD 0 CM_RAW 0 65535 /end CHARACTERISTIC
/begin CHARACTERISTIC CAL_396 "карта #396 10x8: GEAR × N" MAP 0x08066068 RL_FNC_UWORD 0 CM_RAW 0 65535
 /begin AXIS_DESCR COM_AXIS AXIN_05E_GEAR CM_RAW 8 -128 127 AXIS_PTS_REF AX_05E_GEAR /end AXIS_DESCR
 /begin AXIS_DESCR COM_AXIS AXIN_00C_N CM_RPM2 10 0 32767.5 AXIS_PTS_REF AX_00C_N /end AXIS_DESCR
/end CHARACTERISTIC
/begin CHARACTERISTIC CAL_397 "значение #397" VALUE 0x08065FC6 RL_FNC_UWORD 0 CM_RAW 0 65535 /end CHARACTERISTIC
/begin CHARACTERISTIC CAL_398 "карта #398 10x8: GEAR × N" MAP 0x08065FC8 RL_FNC_UWORD 0 CM_RAW 0 65535
 /begin AXIS_DESCR COM_AXIS AXIN_05E_GEAR CM_RAW 8 -128 127 AXIS_PTS_REF AX_05E_GEAR /end AXIS_DESCR
 /begin AXIS_DESCR COM_AXIS AXIN_00C_N CM_RPM2 10 0 32767.5 AXIS_PTS_REF AX_00C_N /end AXIS_DESCR
/end CHARACTERISTIC
/begin CHARACTERISTIC CAL_399 "значение #399" VALUE 0x080661AA RL_FNC_SBYTE 0 CM_RAW -128 127 /end CHARACTERISTIC
/begin CHARACTERISTIC CAL_39A "кривая #39A 10: N" CURVE 0x080661AC RL_FNC_UWORD 0 CM_RAW 0 65535
 /begin AXIS_DESCR COM_AXIS AXIN_00C_N CM_RPM2 10 0 32767.5 AXIS_PTS_REF AX_00C_N /end AXIS_DESCR
/end CHARACTERISTIC
/begin CHARACTERISTIC CAL_39B "значение #39B" VALUE 0x080661C0 RL_FNC_UWORD 0 CM_RAW 0 65535 /end CHARACTERISTIC
/begin CHARACTERISTIC CAL_39C "кривая #39C 8: GEAR" CURVE 0x080661D4 RL_FNC_UWORD 0 CM_RAW 0 65535
 /begin AXIS_DESCR COM_AXIS AXIN_05E_GEAR CM_RAW 8 -128 127 AXIS_PTS_REF AX_05E_GEAR /end AXIS_DESCR
/end CHARACTERISTIC
/begin CHARACTERISTIC CAL_39D "кривая #39D 8: GEAR" CURVE 0x080661C4 RL_FNC_UWORD 0 CM_RAW 0 65535
 /begin AXIS_DESCR COM_AXIS AXIN_05E_GEAR CM_RAW 8 -128 127 AXIS_PTS_REF AX_05E_GEAR /end AXIS_DESCR
/end CHARACTERISTIC
/begin CHARACTERISTIC CAL_39E "значение #39E" VALUE 0x080661E4 RL_FNC_UWORD 0 CM_RAW 0 65535 /end CHARACTERISTIC
/begin CHARACTERISTIC CAL_39F "значение #39F" VALUE 0x080661E6 RL_FNC_UWORD 0 CM_RAW 0 65535 /end CHARACTERISTIC
/begin CHARACTERISTIC CAL_3A0_0 "кривая #3A0 10: N [1/2]" CURVE 0x080661F0 RL_FNC_SBYTE 0 CM_RAW -128 127
 /begin AXIS_DESCR COM_AXIS AXIN_00C_N CM_RPM2 10 0 32767.5 AXIS_PTS_REF AX_00C_N /end AXIS_DESCR
/end CHARACTERISTIC
/begin CHARACTERISTIC CAL_3A0_1 "кривая #3A0 10: N [2/2]" CURVE 0x080661FA RL_FNC_SBYTE 0 CM_RAW -128 127
 /begin AXIS_DESCR COM_AXIS AXIN_00C_N CM_RPM2 10 0 32767.5 AXIS_PTS_REF AX_00C_N /end AXIS_DESCR
/end CHARACTERISTIC
/begin CHARACTERISTIC CAL_3A1 "массив #3A1" VAL_BLK 0x080661EC RL_FNC_SBYTE 0 CM_RAW -128 127 MATRIX_DIM 4 1 1 /end CHARACTERISTIC
/begin CHARACTERISTIC CAL_3A2 "кривая #3A2 10: N" CURVE 0x08066204 RL_FNC_UWORD 0 CM_RAW 0 65535
 /begin AXIS_DESCR COM_AXIS AXIN_00C_N CM_RPM2 10 0 32767.5 AXIS_PTS_REF AX_00C_N /end AXIS_DESCR
/end CHARACTERISTIC
/begin CHARACTERISTIC CAL_3A3 "значение #3A3" VALUE 0x08066218 RL_FNC_UWORD 0 CM_RAW 0 65535 /end CHARACTERISTIC
/begin CHARACTERISTIC CAL_3A4 "значение #3A4" VALUE 0x0806621A RL_FNC_UWORD 0 CM_RAW 0 65535 /end CHARACTERISTIC
/begin CHARACTERISTIC CAL_3A5 "значение #3A5" VALUE 0x0806D110 RL_FNC_UWORD 0 CM_RAW 0 65535 /end CHARACTERISTIC
/begin CHARACTERISTIC CAL_3A6 "значение #3A6" VALUE 0x080626B6 RL_FNC_SBYTE 0 CM_RAW -128 127 /end CHARACTERISTIC
/begin CHARACTERISTIC CAL_3A7 "кривая #3A7 8: ?" CURVE 0x080626BC RL_FNC_SBYTE 0 CM_RAW -128 127 /begin AXIS_DESCR COM_AXIS AXIN_068 CM_RAW 8 -128 127 AXIS_PTS_REF AX_068 /end AXIS_DESCR /end CHARACTERISTIC
/begin CHARACTERISTIC CAL_3A8 "кривая #3A8 6: ?" CURVE 0x080626C4 RL_FNC_SBYTE 0 CM_RAW -128 127 /begin AXIS_DESCR COM_AXIS AXIN_066 CM_RAW 6 0 65535 AXIS_PTS_REF AX_066 /end AXIS_DESCR /end CHARACTERISTIC
/begin CHARACTERISTIC CAL_3A9 "значение #3A9" VALUE 0x080626F8 RL_FNC_UWORD 0 CM_RAW 0 65535 /end CHARACTERISTIC
/begin CHARACTERISTIC CAL_3AA "значение #3AA" VALUE 0x080626FA RL_FNC_UWORD 0 CM_RAW 0 65535 /end CHARACTERISTIC
/begin CHARACTERISTIC CAL_3AB "массив #3AB" VAL_BLK 0x080626FC RL_FNC_UWORD 0 CM_RAW 0 65535 MATRIX_DIM 6 1 1 /end CHARACTERISTIC
/begin CHARACTERISTIC CAL_3AC "кривая #3AC 6: ?" CURVE 0x08062708 RL_FNC_SBYTE 0 CM_RAW -128 127 /begin AXIS_DESCR COM_AXIS AXIN_066 CM_RAW 6 0 65535 AXIS_PTS_REF AX_066 /end AXIS_DESCR /end CHARACTERISTIC
/begin CHARACTERISTIC CAL_3AD "кривая #3AD 6: ?" CURVE 0x08062710 RL_FNC_SBYTE 0 CM_RAW -128 127 /begin AXIS_DESCR COM_AXIS AXIN_067 CM_RAW 6 0 65535 AXIS_PTS_REF AX_067 /end AXIS_DESCR /end CHARACTERISTIC
/begin CHARACTERISTIC CAL_3AE "значение #3AE" VALUE 0x08062718 RL_FNC_ULONG 0 CM_RAW 0 4.29497e+09 /end CHARACTERISTIC
/begin CHARACTERISTIC CAL_3AF "значение #3AF" VALUE 0x0806271C RL_FNC_UWORD 0 CM_RAW 0 65535 /end CHARACTERISTIC
/begin CHARACTERISTIC CAL_3B0 "значение #3B0" VALUE 0x0806271E RL_FNC_SBYTE 0 CM_RAW -128 127 /end CHARACTERISTIC
/begin CHARACTERISTIC CAL_3B1 "значение #3B1" VALUE 0x08062720 RL_FNC_UWORD 0 CM_RAW 0 65535 /end CHARACTERISTIC
/begin CHARACTERISTIC CAL_3B2 "значение #3B2" VALUE 0x08062722 RL_FNC_UWORD 0 CM_RAW 0 65535 /end CHARACTERISTIC
/begin CHARACTERISTIC CAL_3B3 "значение #3B3" VALUE 0x08062724 RL_FNC_UWORD 0 CM_RAW 0 65535 /end CHARACTERISTIC
/begin CHARACTERISTIC CAL_3B4 "значение #3B4" VALUE 0x08062726 RL_FNC_UWORD 0 CM_RAW 0 65535 /end CHARACTERISTIC
/begin CHARACTERISTIC CAL_3B5 "значение #3B5" VALUE 0x08062728 RL_FNC_UWORD 0 CM_RAW 0 65535 /end CHARACTERISTIC
/begin CHARACTERISTIC CAL_3B6 "кривая #3B6 10: N" CURVE 0x0806272C RL_FNC_UWORD 0 CM_RAW 0 65535
 /begin AXIS_DESCR COM_AXIS AXIN_00C_N CM_RPM2 10 0 32767.5 AXIS_PTS_REF AX_00C_N /end AXIS_DESCR
/end CHARACTERISTIC
/begin CHARACTERISTIC CAL_3B7 "кривая #3B7 10: N" CURVE 0x08062740 RL_FNC_UWORD 0 CM_RAW 0 65535
 /begin AXIS_DESCR COM_AXIS AXIN_00C_N CM_RPM2 10 0 32767.5 AXIS_PTS_REF AX_00C_N /end AXIS_DESCR
/end CHARACTERISTIC
/begin CHARACTERISTIC CAL_3B8 "значение #3B8" VALUE 0x08062894 RL_FNC_UWORD 0 CM_RAW 0 65535 /end CHARACTERISTIC
/begin CHARACTERISTIC CAL_3B9 "карта #3B9 10x8: N × LOAD" MAP 0x08062754 RL_FNC_UWORD 0 CM_RAW 0 65535
 /begin AXIS_DESCR COM_AXIS AXIN_04B_N CM_RPM2 8 0 32767.5 AXIS_PTS_REF AX_04B_N /end AXIS_DESCR
 /begin AXIS_DESCR COM_AXIS AXIN_04C_LOAD CM_RAW 10 0 65535 AXIS_PTS_REF AX_04C_LOAD /end AXIS_DESCR
/end CHARACTERISTIC
/begin CHARACTERISTIC CAL_3BA "карта #3BA 10x8: N × LOAD" MAP 0x080627F4 RL_FNC_UWORD 0 CM_RAW 0 65535
 /begin AXIS_DESCR COM_AXIS AXIN_04B_N CM_RPM2 8 0 32767.5 AXIS_PTS_REF AX_04B_N /end AXIS_DESCR
 /begin AXIS_DESCR COM_AXIS AXIN_04C_LOAD CM_RAW 10 0 65535 AXIS_PTS_REF AX_04C_LOAD /end AXIS_DESCR
/end CHARACTERISTIC
/begin CHARACTERISTIC CAL_3BB "массив #3BB" VAL_BLK 0x08062898 RL_FNC_UWORD 0 CM_RAW 0 65535 MATRIX_DIM 6 1 1 /end CHARACTERISTIC
/begin CHARACTERISTIC CAL_3BC "значение #3BC" VALUE 0x080705C6 RL_FNC_UWORD 0 CM_RAW 0 65535 /end CHARACTERISTIC
/begin CHARACTERISTIC CAL_3BD "значение #3BD" VALUE 0x080705C4 RL_FNC_SWORD 0 CM_RAW -32768 32767 /end CHARACTERISTIC
/begin CHARACTERISTIC CAL_3BE "массив #3BE" VAL_BLK 0x080705F8 RL_FNC_UWORD 0 CM_RAW 0 65535 MATRIX_DIM 2 1 1 /end CHARACTERISTIC
/begin CHARACTERISTIC CAL_3BF "массив #3BF [знак по значениям]" VAL_BLK 0x08070600 RL_FNC_SWORD 0 CM_RAW -32768 32767 MATRIX_DIM 2 1 1 /end CHARACTERISTIC
/begin CHARACTERISTIC CAL_3C0 "массив #3C0" VAL_BLK 0x080705BC RL_FNC_UWORD 0 CM_RAW 0 65535 MATRIX_DIM 2 1 1 /end CHARACTERISTIC
/begin CHARACTERISTIC CAL_3C1 "массив #3C1 [знак по значениям]" VAL_BLK 0x080705FC RL_FNC_SWORD 0 CM_RAW -32768 32767 MATRIX_DIM 2 1 1 /end CHARACTERISTIC
/begin CHARACTERISTIC CAL_3C2 "значение #3C2" VALUE 0x08070604 RL_FNC_UWORD 0 CM_RAW 0 65535 /end CHARACTERISTIC
/begin CHARACTERISTIC CAL_3C3 "массив #3C3 [знак по значениям]" VAL_BLK 0x080706AC RL_FNC_SWORD 0 CM_RAW -32768 32767 MATRIX_DIM 2 1 1 /end CHARACTERISTIC
/begin CHARACTERISTIC CAL_3C4 "значение #3C4" VALUE 0x08070698 RL_FNC_UWORD 0 CM_RAW 0 65535 /end CHARACTERISTIC
/begin CHARACTERISTIC CAL_3C5 "значение #3C5" VALUE 0x080705B2 RL_FNC_SBYTE 0 CM_RAW -128 127 /end CHARACTERISTIC
/begin CHARACTERISTIC CAL_3C6 "массив #3C6" VAL_BLK 0x080706B0 RL_FNC_UWORD 0 CM_RAW 0 65535 MATRIX_DIM 2 1 1 /end CHARACTERISTIC
/begin CHARACTERISTIC CAL_3C7 "карта #3C7 5x8: TAIR × ?" MAP 0x080640DC RL_FNC_UWORD 0 CM_RAW 0 65535
 /begin AXIS_DESCR COM_AXIS AXIN_06C_TAIR CM_C128 8 -256 255.992 AXIS_PTS_REF AX_06C_TAIR /end AXIS_DESCR
 /begin AXIS_DESCR COM_AXIS AXIN_06B CM_RAW 5 0 65535 AXIS_PTS_REF AX_06B /end AXIS_DESCR
/end CHARACTERISTIC
/begin CHARACTERISTIC CAL_3C8_0 "карта #3C8 15x10: N × ? [1/2]" MAP 0x0806412C RL_FNC_UWORD 0 CM_RAW 0 65535
 /begin AXIS_DESCR COM_AXIS AXIN_06A_N CM_RPM2 10 0 32767.5 AXIS_PTS_REF AX_06A_N /end AXIS_DESCR
 /begin AXIS_DESCR COM_AXIS AXIN_098 CM_RAW 15 0 65535 AXIS_PTS_REF AX_098 /end AXIS_DESCR
/end CHARACTERISTIC
/begin CHARACTERISTIC CAL_3C8_1 "карта #3C8 15x10: N × ? [2/2]" MAP 0x08064258 RL_FNC_UWORD 0 CM_RAW 0 65535
 /begin AXIS_DESCR COM_AXIS AXIN_06A_N CM_RPM2 10 0 32767.5 AXIS_PTS_REF AX_06A_N /end AXIS_DESCR
 /begin AXIS_DESCR COM_AXIS AXIN_098 CM_RAW 15 0 65535 AXIS_PTS_REF AX_098 /end AXIS_DESCR
/end CHARACTERISTIC
/begin CHARACTERISTIC CAL_3C9_0 "кривая #3C9 6: ? [1/3]" CURVE 0x08064394 RL_FNC_SWORD 0 CM_RAW -32768 32767 /begin AXIS_DESCR COM_AXIS AXIN_064 CM_RAW 6 0 65535 AXIS_PTS_REF AX_064 /end AXIS_DESCR /end CHARACTERISTIC
/begin CHARACTERISTIC CAL_3C9_1 "кривая #3C9 6: ? [2/3]" CURVE 0x080643A0 RL_FNC_SWORD 0 CM_RAW -32768 32767 /begin AXIS_DESCR COM_AXIS AXIN_064 CM_RAW 6 0 65535 AXIS_PTS_REF AX_064 /end AXIS_DESCR /end CHARACTERISTIC
/begin CHARACTERISTIC CAL_3C9_2 "кривая #3C9 6: ? [3/3]" CURVE 0x080643AC RL_FNC_SWORD 0 CM_RAW -32768 32767 /begin AXIS_DESCR COM_AXIS AXIN_064 CM_RAW 6 0 65535 AXIS_PTS_REF AX_064 /end AXIS_DESCR /end CHARACTERISTIC
/begin CHARACTERISTIC CAL_3CA "значение #3CA" VALUE 0x080643B8 RL_FNC_UWORD 0 CM_RAW 0 65535 /end CHARACTERISTIC
/begin CHARACTERISTIC CAL_3CB "карта #3CB 5x5: ? × ?" MAP 0x080640A8 RL_FNC_UWORD 0 CM_RAW 0 65535 /begin AXIS_DESCR COM_AXIS AXIN_06D CM_RAW 5 0 65535 AXIS_PTS_REF AX_06D /end AXIS_DESCR /begin AXIS_DESCR COM_AXIS AXIN_06B CM_RAW 5 0 65535 AXIS_PTS_REF AX_06B /end AXIS_DESCR /end CHARACTERISTIC
/begin CHARACTERISTIC CAL_3CC "значение #3CC" VALUE 0x080657F2 RL_FNC_UWORD 0 CM_RAW 0 65535 /end CHARACTERISTIC
/begin CHARACTERISTIC CAL_3D1 "кривая #3D1 8: TAIR" CURVE 0x080749CC RL_FNC_UWORD 0 CM_RAW 0 65535
 /begin AXIS_DESCR COM_AXIS AXIN_049_TAIR CM_C128 8 -256 255.992 AXIS_PTS_REF AX_049_TAIR /end AXIS_DESCR
/end CHARACTERISTIC
/begin CHARACTERISTIC CAL_3D2 "карта #3D2 10x8: ? × ?" MAP 0x0806AA3C RL_FNC_SBYTE 0 CM_RAW -128 127 /begin AXIS_DESCR COM_AXIS AXIN_04E CM_RAW 8 0 65535 AXIS_PTS_REF AX_04E /end AXIS_DESCR /begin AXIS_DESCR COM_AXIS AXIN_04D CM_RAW 10 0 65535 AXIS_PTS_REF AX_04D /end AXIS_DESCR /end CHARACTERISTIC
/begin CHARACTERISTIC CAL_3D3 "значение #3D3" VALUE 0x0806AA38 RL_FNC_SBYTE 0 CM_RAW -128 127 /end CHARACTERISTIC
/begin CHARACTERISTIC CAL_3D4 "значение #3D4" VALUE 0x0806AC02 RL_FNC_UWORD 0 CM_RAW 0 65535 /end CHARACTERISTIC
/begin CHARACTERISTIC CAL_3D5 "карта #3D5 10x8: N × LOAD" MAP 0x0806AC04 RL_FNC_UWORD 0 CM_RAW 0 65535
 /begin AXIS_DESCR COM_AXIS AXIN_04B_N CM_RPM2 8 0 32767.5 AXIS_PTS_REF AX_04B_N /end AXIS_DESCR
 /begin AXIS_DESCR COM_AXIS AXIN_04C_LOAD CM_RAW 10 0 65535 AXIS_PTS_REF AX_04C_LOAD /end AXIS_DESCR
/end CHARACTERISTIC
/begin CHARACTERISTIC CAL_3D6 "значение #3D6" VALUE 0x0806ACA4 RL_FNC_UWORD 0 CM_RAW 0 65535 /end CHARACTERISTIC
/begin CHARACTERISTIC CAL_3D7 "значение #3D7" VALUE 0x0806AD84 RL_FNC_UWORD 0 CM_RAW 0 65535 /end CHARACTERISTIC
/begin CHARACTERISTIC CAL_3D8 "значение #3D8" VALUE 0x0806AF80 RL_FNC_UWORD 0 CM_RAW 0 65535 /end CHARACTERISTIC
/begin CHARACTERISTIC CAL_3D9 "карта #3D9 10x8: ? × ?" MAP 0x0806B028 RL_FNC_UWORD 0 CM_RAW 0 65535 /begin AXIS_DESCR COM_AXIS AXIN_04E CM_RAW 8 0 65535 AXIS_PTS_REF AX_04E /end AXIS_DESCR /begin AXIS_DESCR COM_AXIS AXIN_04D CM_RAW 10 0 65535 AXIS_PTS_REF AX_04D /end AXIS_DESCR /end CHARACTERISTIC
/begin CHARACTERISTIC CAL_3DA "значение #3DA" VALUE 0x0806B0C8 RL_FNC_UWORD 0 CM_RAW 0 65535 /end CHARACTERISTIC
/begin CHARACTERISTIC CAL_3DB "значение #3DB" VALUE 0x0806B0CA RL_FNC_UWORD 0 CM_RAW 0 65535 /end CHARACTERISTIC
/begin CHARACTERISTIC CAL_3DC "карта #3DC 10x8: ? × ?" MAP 0x0806AF88 RL_FNC_UWORD 0 CM_RAW 0 65535 /begin AXIS_DESCR COM_AXIS AXIN_04E CM_RAW 8 0 65535 AXIS_PTS_REF AX_04E /end AXIS_DESCR /begin AXIS_DESCR COM_AXIS AXIN_04D CM_RAW 10 0 65535 AXIS_PTS_REF AX_04D /end AXIS_DESCR /end CHARACTERISTIC
/begin CHARACTERISTIC CAL_3DD "карта #3DD 10x8: ? × ?" MAP 0x0806B170 RL_FNC_UWORD 0 CM_RAW 0 65535 /begin AXIS_DESCR COM_AXIS AXIN_04E CM_RAW 8 0 65535 AXIS_PTS_REF AX_04E /end AXIS_DESCR /begin AXIS_DESCR COM_AXIS AXIN_04D CM_RAW 10 0 65535 AXIS_PTS_REF AX_04D /end AXIS_DESCR /end CHARACTERISTIC
/begin CHARACTERISTIC CAL_3DE "значение #3DE" VALUE 0x0806B210 RL_FNC_UWORD 0 CM_RAW 0 65535 /end CHARACTERISTIC
/begin CHARACTERISTIC CAL_3DF "значение #3DF" VALUE 0x0806B212 RL_FNC_UWORD 0 CM_RAW 0 65535 /end CHARACTERISTIC
/begin CHARACTERISTIC CAL_3E0 "карта #3E0 10x8: ? × ?" MAP 0x0806B0D0 RL_FNC_UWORD 0 CM_RAW 0 65535 /begin AXIS_DESCR COM_AXIS AXIN_04E CM_RAW 8 0 65535 AXIS_PTS_REF AX_04E /end AXIS_DESCR /begin AXIS_DESCR COM_AXIS AXIN_04D CM_RAW 10 0 65535 AXIS_PTS_REF AX_04D /end AXIS_DESCR /end CHARACTERISTIC
/begin CHARACTERISTIC CAL_3E1 "массив #3E1 [знак по значениям]" VAL_BLK 0x080705B8 RL_FNC_SWORD 0 CM_RAW -32768 32767 MATRIX_DIM 2 1 1 /end CHARACTERISTIC
/begin CHARACTERISTIC CAL_3E2 "кривая #3E2 11: ? [знак по значениям]" CURVE 0x080704AC RL_FNC_SWORD 0 CM_RAW -32768 32767 /begin AXIS_DESCR COM_AXIS AXIN_059 CM_RAW 11 0 65535 AXIS_PTS_REF AX_059 /end AXIS_DESCR /end CHARACTERISTIC
/begin CHARACTERISTIC CAL_3E3 "кривая #3E3 24: N" CURVE 0x080705C8 RL_FNC_UWORD 0 CM_RAW 0 65535
 /begin AXIS_DESCR COM_AXIS AXIN_005_N CM_RPM2 24 0 32767.5 AXIS_PTS_REF AX_005_N /end AXIS_DESCR
/end CHARACTERISTIC
/begin CHARACTERISTIC CAL_3E4 "значение #3E4" VALUE 0x080705B6 RL_FNC_UWORD 0 CM_RAW 0 65535 /end CHARACTERISTIC
/begin CHARACTERISTIC CAL_3E5_0 "кривая #3E5 11: N [1/8]" CURVE 0x08062BBC RL_FNC_UWORD 0 CM_RAW 0 65535
 /begin AXIS_DESCR COM_AXIS AXIN_0B1_N CM_RPM2 11 0 32767.5 AXIS_PTS_REF AX_0B1_N /end AXIS_DESCR
/end CHARACTERISTIC
/begin CHARACTERISTIC CAL_3E5_1 "кривая #3E5 11: N [2/8]" CURVE 0x08062BD2 RL_FNC_UWORD 0 CM_RAW 0 65535
 /begin AXIS_DESCR COM_AXIS AXIN_0B1_N CM_RPM2 11 0 32767.5 AXIS_PTS_REF AX_0B1_N /end AXIS_DESCR
/end CHARACTERISTIC
/begin CHARACTERISTIC CAL_3E5_2 "кривая #3E5 11: N [3/8]" CURVE 0x08062BE8 RL_FNC_UWORD 0 CM_RAW 0 65535
 /begin AXIS_DESCR COM_AXIS AXIN_0B1_N CM_RPM2 11 0 32767.5 AXIS_PTS_REF AX_0B1_N /end AXIS_DESCR
/end CHARACTERISTIC
/begin CHARACTERISTIC CAL_3E5_3 "кривая #3E5 11: N [4/8]" CURVE 0x08062BFE RL_FNC_UWORD 0 CM_RAW 0 65535
 /begin AXIS_DESCR COM_AXIS AXIN_0B1_N CM_RPM2 11 0 32767.5 AXIS_PTS_REF AX_0B1_N /end AXIS_DESCR
/end CHARACTERISTIC
/begin CHARACTERISTIC CAL_3E5_4 "кривая #3E5 11: N [5/8]" CURVE 0x08062C14 RL_FNC_UWORD 0 CM_RAW 0 65535
 /begin AXIS_DESCR COM_AXIS AXIN_0B1_N CM_RPM2 11 0 32767.5 AXIS_PTS_REF AX_0B1_N /end AXIS_DESCR
/end CHARACTERISTIC
/begin CHARACTERISTIC CAL_3E5_5 "кривая #3E5 11: N [6/8]" CURVE 0x08062C2A RL_FNC_UWORD 0 CM_RAW 0 65535
 /begin AXIS_DESCR COM_AXIS AXIN_0B1_N CM_RPM2 11 0 32767.5 AXIS_PTS_REF AX_0B1_N /end AXIS_DESCR
/end CHARACTERISTIC
/begin CHARACTERISTIC CAL_3E5_6 "кривая #3E5 11: N [7/8]" CURVE 0x08062C40 RL_FNC_UWORD 0 CM_RAW 0 65535
 /begin AXIS_DESCR COM_AXIS AXIN_0B1_N CM_RPM2 11 0 32767.5 AXIS_PTS_REF AX_0B1_N /end AXIS_DESCR
/end CHARACTERISTIC
/begin CHARACTERISTIC CAL_3E5_7 "кривая #3E5 11: N [8/8]" CURVE 0x08062C56 RL_FNC_UWORD 0 CM_RAW 0 65535
 /begin AXIS_DESCR COM_AXIS AXIN_0B1_N CM_RPM2 11 0 32767.5 AXIS_PTS_REF AX_0B1_N /end AXIS_DESCR
/end CHARACTERISTIC
/begin CHARACTERISTIC CAL_3E6 "массив #3E6" VAL_BLK 0x08062B8C RL_FNC_UWORD 0 CM_RAW 0 65535 MATRIX_DIM 8 1 1 /end CHARACTERISTIC
/begin CHARACTERISTIC CAL_3E7 "массив #3E7" VAL_BLK 0x08062B9C RL_FNC_UWORD 0 CM_RAW 0 65535 MATRIX_DIM 8 1 1 /end CHARACTERISTIC
/begin CHARACTERISTIC CAL_3E8 "массив #3E8" VAL_BLK 0x08062B4C RL_FNC_UWORD 0 CM_RAW 0 65535 MATRIX_DIM 8 1 1 /end CHARACTERISTIC
/begin CHARACTERISTIC CAL_3E9 "массив #3E9" VAL_BLK 0x08062B2C RL_FNC_UWORD 0 CM_RAW 0 65535 MATRIX_DIM 8 1 1 /end CHARACTERISTIC
/begin CHARACTERISTIC CAL_3EA "массив #3EA" VAL_BLK 0x08062B3C RL_FNC_UWORD 0 CM_RAW 0 65535 MATRIX_DIM 8 1 1 /end CHARACTERISTIC
/begin CHARACTERISTIC CAL_3EB "массив #3EB" VAL_BLK 0x08062B7C RL_FNC_UWORD 0 CM_RAW 0 65535 MATRIX_DIM 8 1 1 /end CHARACTERISTIC
/begin CHARACTERISTIC CAL_3EC "массив #3EC" VAL_BLK 0x08062B5C RL_FNC_UWORD 0 CM_RAW 0 65535 MATRIX_DIM 8 1 1 /end CHARACTERISTIC
/begin CHARACTERISTIC CAL_3ED "массив #3ED" VAL_BLK 0x08062B6C RL_FNC_UWORD 0 CM_RAW 0 65535 MATRIX_DIM 8 1 1 /end CHARACTERISTIC
/begin CHARACTERISTIC CAL_3EE "значение #3EE" VALUE 0x08062C9C RL_FNC_UWORD 0 CM_RAW 0 65535 /end CHARACTERISTIC
/begin CHARACTERISTIC CAL_3EF "значение #3EF" VALUE 0x08062CA0 RL_FNC_UWORD 0 CM_RAW 0 65535 /end CHARACTERISTIC
/begin CHARACTERISTIC CAL_3F0 "значение #3F0" VALUE 0x08062CA2 RL_FNC_UWORD 0 CM_RAW 0 65535 /end CHARACTERISTIC
/begin CHARACTERISTIC CAL_3F1 "значение #3F1" VALUE 0x08062C9E RL_FNC_UWORD 0 CM_RAW 0 65535 /end CHARACTERISTIC
/begin CHARACTERISTIC CAL_3F2_0 "кривая #3F2 10: N [1/2] [знак по значениям]" CURVE 0x08062CA4 RL_FNC_SWORD 0 CM_RAW -32768 32767
 /begin AXIS_DESCR COM_AXIS AXIN_00C_N CM_RPM2 10 0 32767.5 AXIS_PTS_REF AX_00C_N /end AXIS_DESCR
/end CHARACTERISTIC
/begin CHARACTERISTIC CAL_3F2_1 "кривая #3F2 10: N [2/2] [знак по значениям]" CURVE 0x08062CB8 RL_FNC_SWORD 0 CM_RAW -32768 32767
 /begin AXIS_DESCR COM_AXIS AXIN_00C_N CM_RPM2 10 0 32767.5 AXIS_PTS_REF AX_00C_N /end AXIS_DESCR
/end CHARACTERISTIC
/begin CHARACTERISTIC CAL_3F3 "значение #3F3" VALUE 0x08062CD6 RL_FNC_UWORD 0 CM_RAW 0 65535 /end CHARACTERISTIC
/begin CHARACTERISTIC CAL_3F4 "значение #3F4" VALUE 0x08062CCE RL_FNC_UWORD 0 CM_RAW 0 65535 /end CHARACTERISTIC
/begin CHARACTERISTIC CAL_3F5_0 "кривая #3F5 8: ? [1/8]" CURVE 0x08062CE0 RL_FNC_UWORD 0 CM_RAW 0 65535 /begin AXIS_DESCR COM_AXIS AXIN_06F CM_RAW 8 0 65535 AXIS_PTS_REF AX_06F /end AXIS_DESCR /end CHARACTERISTIC
/begin CHARACTERISTIC CAL_3F5_1 "кривая #3F5 8: ? [2/8]" CURVE 0x08062CF0 RL_FNC_UWORD 0 CM_RAW 0 65535 /begin AXIS_DESCR COM_AXIS AXIN_06F CM_RAW 8 0 65535 AXIS_PTS_REF AX_06F /end AXIS_DESCR /end CHARACTERISTIC
/begin CHARACTERISTIC CAL_3F5_2 "кривая #3F5 8: ? [3/8]" CURVE 0x08062D00 RL_FNC_UWORD 0 CM_RAW 0 65535 /begin AXIS_DESCR COM_AXIS AXIN_06F CM_RAW 8 0 65535 AXIS_PTS_REF AX_06F /end AXIS_DESCR /end CHARACTERISTIC
/begin CHARACTERISTIC CAL_3F5_3 "кривая #3F5 8: ? [4/8]" CURVE 0x08062D10 RL_FNC_UWORD 0 CM_RAW 0 65535 /begin AXIS_DESCR COM_AXIS AXIN_06F CM_RAW 8 0 65535 AXIS_PTS_REF AX_06F /end AXIS_DESCR /end CHARACTERISTIC
/begin CHARACTERISTIC CAL_3F5_4 "кривая #3F5 8: ? [5/8]" CURVE 0x08062D20 RL_FNC_UWORD 0 CM_RAW 0 65535 /begin AXIS_DESCR COM_AXIS AXIN_06F CM_RAW 8 0 65535 AXIS_PTS_REF AX_06F /end AXIS_DESCR /end CHARACTERISTIC
/begin CHARACTERISTIC CAL_3F5_5 "кривая #3F5 8: ? [6/8]" CURVE 0x08062D30 RL_FNC_UWORD 0 CM_RAW 0 65535 /begin AXIS_DESCR COM_AXIS AXIN_06F CM_RAW 8 0 65535 AXIS_PTS_REF AX_06F /end AXIS_DESCR /end CHARACTERISTIC
/begin CHARACTERISTIC CAL_3F5_6 "кривая #3F5 8: ? [7/8]" CURVE 0x08062D40 RL_FNC_UWORD 0 CM_RAW 0 65535 /begin AXIS_DESCR COM_AXIS AXIN_06F CM_RAW 8 0 65535 AXIS_PTS_REF AX_06F /end AXIS_DESCR /end CHARACTERISTIC
/begin CHARACTERISTIC CAL_3F5_7 "кривая #3F5 8: ? [8/8]" CURVE 0x08062D50 RL_FNC_UWORD 0 CM_RAW 0 65535 /begin AXIS_DESCR COM_AXIS AXIN_06F CM_RAW 8 0 65535 AXIS_PTS_REF AX_06F /end AXIS_DESCR /end CHARACTERISTIC
/begin CHARACTERISTIC CAL_3F6_0 "кривая #3F6 8: ? [1/8]" CURVE 0x08062D60 RL_FNC_UWORD 0 CM_RAW 0 65535 /begin AXIS_DESCR COM_AXIS AXIN_06F CM_RAW 8 0 65535 AXIS_PTS_REF AX_06F /end AXIS_DESCR /end CHARACTERISTIC
/begin CHARACTERISTIC CAL_3F6_1 "кривая #3F6 8: ? [2/8]" CURVE 0x08062D70 RL_FNC_UWORD 0 CM_RAW 0 65535 /begin AXIS_DESCR COM_AXIS AXIN_06F CM_RAW 8 0 65535 AXIS_PTS_REF AX_06F /end AXIS_DESCR /end CHARACTERISTIC
/begin CHARACTERISTIC CAL_3F6_2 "кривая #3F6 8: ? [3/8]" CURVE 0x08062D80 RL_FNC_UWORD 0 CM_RAW 0 65535 /begin AXIS_DESCR COM_AXIS AXIN_06F CM_RAW 8 0 65535 AXIS_PTS_REF AX_06F /end AXIS_DESCR /end CHARACTERISTIC
/begin CHARACTERISTIC CAL_3F6_3 "кривая #3F6 8: ? [4/8]" CURVE 0x08062D90 RL_FNC_UWORD 0 CM_RAW 0 65535 /begin AXIS_DESCR COM_AXIS AXIN_06F CM_RAW 8 0 65535 AXIS_PTS_REF AX_06F /end AXIS_DESCR /end CHARACTERISTIC
/begin CHARACTERISTIC CAL_3F6_4 "кривая #3F6 8: ? [5/8]" CURVE 0x08062DA0 RL_FNC_UWORD 0 CM_RAW 0 65535 /begin AXIS_DESCR COM_AXIS AXIN_06F CM_RAW 8 0 65535 AXIS_PTS_REF AX_06F /end AXIS_DESCR /end CHARACTERISTIC
/begin CHARACTERISTIC CAL_3F6_5 "кривая #3F6 8: ? [6/8]" CURVE 0x08062DB0 RL_FNC_UWORD 0 CM_RAW 0 65535 /begin AXIS_DESCR COM_AXIS AXIN_06F CM_RAW 8 0 65535 AXIS_PTS_REF AX_06F /end AXIS_DESCR /end CHARACTERISTIC
/begin CHARACTERISTIC CAL_3F6_6 "кривая #3F6 8: ? [7/8]" CURVE 0x08062DC0 RL_FNC_UWORD 0 CM_RAW 0 65535 /begin AXIS_DESCR COM_AXIS AXIN_06F CM_RAW 8 0 65535 AXIS_PTS_REF AX_06F /end AXIS_DESCR /end CHARACTERISTIC
/begin CHARACTERISTIC CAL_3F6_7 "кривая #3F6 8: ? [8/8]" CURVE 0x08062DD0 RL_FNC_UWORD 0 CM_RAW 0 65535 /begin AXIS_DESCR COM_AXIS AXIN_06F CM_RAW 8 0 65535 AXIS_PTS_REF AX_06F /end AXIS_DESCR /end CHARACTERISTIC
/begin CHARACTERISTIC CAL_3F7_0 "кривая #3F7 8: ? [1/8]" CURVE 0x08062DE0 RL_FNC_UWORD 0 CM_RAW 0 65535 /begin AXIS_DESCR COM_AXIS AXIN_06F CM_RAW 8 0 65535 AXIS_PTS_REF AX_06F /end AXIS_DESCR /end CHARACTERISTIC
/begin CHARACTERISTIC CAL_3F7_1 "кривая #3F7 8: ? [2/8]" CURVE 0x08062DF0 RL_FNC_UWORD 0 CM_RAW 0 65535 /begin AXIS_DESCR COM_AXIS AXIN_06F CM_RAW 8 0 65535 AXIS_PTS_REF AX_06F /end AXIS_DESCR /end CHARACTERISTIC
/begin CHARACTERISTIC CAL_3F7_2 "кривая #3F7 8: ? [3/8]" CURVE 0x08062E00 RL_FNC_UWORD 0 CM_RAW 0 65535 /begin AXIS_DESCR COM_AXIS AXIN_06F CM_RAW 8 0 65535 AXIS_PTS_REF AX_06F /end AXIS_DESCR /end CHARACTERISTIC
/begin CHARACTERISTIC CAL_3F7_3 "кривая #3F7 8: ? [4/8]" CURVE 0x08062E10 RL_FNC_UWORD 0 CM_RAW 0 65535 /begin AXIS_DESCR COM_AXIS AXIN_06F CM_RAW 8 0 65535 AXIS_PTS_REF AX_06F /end AXIS_DESCR /end CHARACTERISTIC
/begin CHARACTERISTIC CAL_3F7_4 "кривая #3F7 8: ? [5/8]" CURVE 0x08062E20 RL_FNC_UWORD 0 CM_RAW 0 65535 /begin AXIS_DESCR COM_AXIS AXIN_06F CM_RAW 8 0 65535 AXIS_PTS_REF AX_06F /end AXIS_DESCR /end CHARACTERISTIC
/begin CHARACTERISTIC CAL_3F7_5 "кривая #3F7 8: ? [6/8]" CURVE 0x08062E30 RL_FNC_UWORD 0 CM_RAW 0 65535 /begin AXIS_DESCR COM_AXIS AXIN_06F CM_RAW 8 0 65535 AXIS_PTS_REF AX_06F /end AXIS_DESCR /end CHARACTERISTIC
/begin CHARACTERISTIC CAL_3F7_6 "кривая #3F7 8: ? [7/8]" CURVE 0x08062E40 RL_FNC_UWORD 0 CM_RAW 0 65535 /begin AXIS_DESCR COM_AXIS AXIN_06F CM_RAW 8 0 65535 AXIS_PTS_REF AX_06F /end AXIS_DESCR /end CHARACTERISTIC
/begin CHARACTERISTIC CAL_3F7_7 "кривая #3F7 8: ? [8/8]" CURVE 0x08062E50 RL_FNC_UWORD 0 CM_RAW 0 65535 /begin AXIS_DESCR COM_AXIS AXIN_06F CM_RAW 8 0 65535 AXIS_PTS_REF AX_06F /end AXIS_DESCR /end CHARACTERISTIC
/begin CHARACTERISTIC CAL_3F8 "значение #3F8" VALUE 0x08062E60 RL_FNC_UWORD 0 CM_RAW 0 65535 /end CHARACTERISTIC
/begin CHARACTERISTIC CAL_3F9 "значение #3F9" VALUE 0x08062E62 RL_FNC_UWORD 0 CM_RAW 0 65535 /end CHARACTERISTIC
/begin CHARACTERISTIC CAL_3FA "карта #3FA 2x2: ? × ? [знак по значениям]" MAP 0x0806544C RL_FNC_SWORD 0 CM_RAW -32768 32767 /begin AXIS_DESCR COM_AXIS AXIN_072 CM_RAW 2 -128 127 AXIS_PTS_REF AX_072 /end AXIS_DESCR /begin AXIS_DESCR COM_AXIS AXIN_073 CM_RAW 2 -128 127 AXIS_PTS_REF AX_073 /end AXIS_DESCR /end CHARACTERISTIC
/begin CHARACTERISTIC CAL_3FB "значение #3FB" VALUE 0x08065456 RL_FNC_UWORD 0 CM_RAW 0 65535 /end CHARACTERISTIC
/begin CHARACTERISTIC CAL_3FC "карта #3FC 9x14: N × LOAD" MAP 0x080695A4 RL_FNC_UWORD 0 CM_RAW 0 65535
 /begin AXIS_DESCR COM_AXIS AXIN_075_N CM_RPM2 14 0 32767.5 AXIS_PTS_REF AX_075_N /end AXIS_DESCR
 /begin AXIS_DESCR COM_AXIS AXIN_074_LOAD CM_RAW 9 0 65535 AXIS_PTS_REF AX_074_LOAD /end AXIS_DESCR
/end CHARACTERISTIC
/begin CHARACTERISTIC CAL_3FD "значение #3FD" VALUE 0x080696A0 RL_FNC_SBYTE 0 CM_RAW -128 127 /end CHARACTERISTIC
/begin CHARACTERISTIC CAL_3FE "значение #3FE" VALUE 0x080696A1 RL_FNC_SBYTE 0 CM_RAW -128 127 /end CHARACTERISTIC
/begin CHARACTERISTIC CAL_3FF "значение #3FF" VALUE 0x080696A2 RL_FNC_SWORD 0 CM_RAW -32768 32767 /end CHARACTERISTIC
/begin CHARACTERISTIC CAL_400 "значение #400" VALUE 0x080696A4 RL_FNC_SWORD 0 CM_RAW -32768 32767 /end CHARACTERISTIC
/begin CHARACTERISTIC CAL_401 "значение #401" VALUE 0x080696A6 RL_FNC_SWORD 0 CM_RAW -32768 32767 /end CHARACTERISTIC
/begin CHARACTERISTIC CAL_402 "значение #402" VALUE 0x080696A8 RL_FNC_SWORD 0 CM_RAW -32768 32767 /end CHARACTERISTIC
/begin CHARACTERISTIC CAL_403_0 "кривая #403 14: N [1/2]" CURVE 0x080696AC RL_FNC_SWORD 0 CM_RAW -32768 32767
 /begin AXIS_DESCR COM_AXIS AXIN_075_N CM_RPM2 14 0 32767.5 AXIS_PTS_REF AX_075_N /end AXIS_DESCR
/end CHARACTERISTIC
/begin CHARACTERISTIC CAL_403_1 "кривая #403 14: N [2/2]" CURVE 0x080696C8 RL_FNC_SWORD 0 CM_RAW -32768 32767
 /begin AXIS_DESCR COM_AXIS AXIN_075_N CM_RPM2 14 0 32767.5 AXIS_PTS_REF AX_075_N /end AXIS_DESCR
/end CHARACTERISTIC
/begin CHARACTERISTIC CAL_404 "массив #404" VAL_BLK 0x080696E4 RL_FNC_UWORD 0 CM_RAW 0 65535 MATRIX_DIM 2 1 1 /end CHARACTERISTIC
/begin CHARACTERISTIC CAL_405 "значение #405" VALUE 0x080696E8 RL_FNC_UWORD 0 CM_RAW 0 65535 /end CHARACTERISTIC
/begin CHARACTERISTIC CAL_406 "значение #406" VALUE 0x0806971C RL_FNC_SWORD 0 CM_RAW -32768 32767 /end CHARACTERISTIC
/begin CHARACTERISTIC CAL_407 "значение #407" VALUE 0x08061750 RL_FNC_UWORD 0 CM_RAW 0 65535 /end CHARACTERISTIC
/begin CHARACTERISTIC CAL_408 "значение #408" VALUE 0x08064480 RL_FNC_SBYTE 0 CM_RAW -128 127 /end CHARACTERISTIC
/begin CHARACTERISTIC CAL_409 "значение #409" VALUE 0x08064482 RL_FNC_UWORD 0 CM_RAW 0 65535 /end CHARACTERISTIC
/begin CHARACTERISTIC CAL_40A "массив #40A" VAL_BLK 0x08064484 RL_FNC_UWORD 0 CM_RAW 0 65535 MATRIX_DIM 2 1 1 /end CHARACTERISTIC
/begin CHARACTERISTIC CAL_40B "значение #40B" VALUE 0x08064488 RL_FNC_UWORD 0 CM_RAW 0 65535 /end CHARACTERISTIC
/begin CHARACTERISTIC CAL_40C "значение #40C" VALUE 0x0806448A RL_FNC_UWORD 0 CM_RAW 0 65535 /end CHARACTERISTIC
/begin CHARACTERISTIC CAL_40F "значение #40F" VALUE 0x08064510 RL_FNC_UWORD 0 CM_RAW 0 65535 /end CHARACTERISTIC
/begin CHARACTERISTIC CAL_410 "значение #410" VALUE 0x0806450C RL_FNC_ULONG 0 CM_RAW 0 4.29497e+09 /end CHARACTERISTIC
/begin CHARACTERISTIC CAL_411 "значение #411" VALUE 0x08064518 RL_FNC_UWORD 0 CM_RAW 0 65535 /end CHARACTERISTIC
/begin CHARACTERISTIC CAL_412 "значение #412" VALUE 0x08064514 RL_FNC_ULONG 0 CM_RAW 0 4.29497e+09 /end CHARACTERISTIC
/begin CHARACTERISTIC CAL_413 "значение #413" VALUE 0x08064528 RL_FNC_UWORD 0 CM_RAW 0 65535 /end CHARACTERISTIC
/begin CHARACTERISTIC CAL_414 "значение #414" VALUE 0x0806452A RL_FNC_UWORD 0 CM_RAW 0 65535 /end CHARACTERISTIC
/begin CHARACTERISTIC CAL_415 "значение #415" VALUE 0x0806452C RL_FNC_UWORD 0 CM_RAW 0 65535 /end CHARACTERISTIC
/begin CHARACTERISTIC CAL_416 "значение #416" VALUE 0x0806452E RL_FNC_SWORD 0 CM_RAW -32768 32767 /end CHARACTERISTIC
/begin CHARACTERISTIC CAL_417 "массив #417" VAL_BLK 0x08064530 RL_FNC_SWORD 0 CM_RAW -32768 32767 MATRIX_DIM 2 1 1 /end CHARACTERISTIC
/begin CHARACTERISTIC CAL_418 "массив #418" VAL_BLK 0x080644FC RL_FNC_ULONG 0 CM_RAW 0 4.29497e+09 MATRIX_DIM 2 1 1 /end CHARACTERISTIC
/begin CHARACTERISTIC CAL_419 "массив #419" VAL_BLK 0x08064504 RL_FNC_ULONG 0 CM_RAW 0 4.29497e+09 MATRIX_DIM 2 1 1 /end CHARACTERISTIC
/begin CHARACTERISTIC CAL_41A "значение #41A" VALUE 0x0806451A RL_FNC_SBYTE 0 CM_RAW -128 127 /end CHARACTERISTIC
/begin CHARACTERISTIC CAL_41B "массив #41B" VAL_BLK 0x080644EC RL_FNC_UWORD 0 CM_RAW 0 65535 MATRIX_DIM 8 1 1 /end CHARACTERISTIC
/begin CHARACTERISTIC CAL_41C "массив #41C" VAL_BLK 0x080644DC RL_FNC_UWORD 0 CM_RAW 0 65535 MATRIX_DIM 8 1 1 /end CHARACTERISTIC
/begin CHARACTERISTIC CAL_41D "значение #41D" VALUE 0x08064522 RL_FNC_UWORD 0 CM_RAW 0 65535 /end CHARACTERISTIC
/begin CHARACTERISTIC CAL_41E "значение #41E" VALUE 0x08064520 RL_FNC_UWORD 0 CM_RAW 0 65535 /end CHARACTERISTIC
/begin CHARACTERISTIC CAL_41F "значение #41F" VALUE 0x08064526 RL_FNC_UWORD 0 CM_RAW 0 65535 /end CHARACTERISTIC
/begin CHARACTERISTIC CAL_420 "значение #420" VALUE 0x08064524 RL_FNC_UWORD 0 CM_RAW 0 65535 /end CHARACTERISTIC
/begin CHARACTERISTIC CAL_421 "значение #421" VALUE 0x080749DC RL_FNC_UWORD 0 CM_RAW 0 65535 /end CHARACTERISTIC
/begin CHARACTERISTIC CAL_422 "кривая #422 9: ?" CURVE 0x0806EAEC RL_FNC_UWORD 0 CM_RAW 0 65535 /begin AXIS_DESCR COM_AXIS AXIN_077 CM_RAW 9 0 65535 AXIS_PTS_REF AX_077 /end AXIS_DESCR /end CHARACTERISTIC
/begin CHARACTERISTIC CAL_423 "массив #423" VAL_BLK 0x080748E8 RL_FNC_SWORD 0 CM_RAW -32768 32767 MATRIX_DIM 8 1 1 /end CHARACTERISTIC
/begin CHARACTERISTIC CAL_424_0 "кривая #424 16: ? [1/3]" CURVE 0x0806DA98 RL_FNC_UWORD 0 CM_RAW 0 65535 /begin AXIS_DESCR COM_AXIS AXIN_078 CM_RAW 16 0 65535 AXIS_PTS_REF AX_078 /end AXIS_DESCR /end CHARACTERISTIC
/begin CHARACTERISTIC CAL_424_1 "кривая #424 16: ? [2/3]" CURVE 0x0806DAB8 RL_FNC_UWORD 0 CM_RAW 0 65535 /begin AXIS_DESCR COM_AXIS AXIN_078 CM_RAW 16 0 65535 AXIS_PTS_REF AX_078 /end AXIS_DESCR /end CHARACTERISTIC
/begin CHARACTERISTIC CAL_424_2 "кривая #424 16: ? [3/3]" CURVE 0x0806DAD8 RL_FNC_UWORD 0 CM_RAW 0 65535 /begin AXIS_DESCR COM_AXIS AXIN_078 CM_RAW 16 0 65535 AXIS_PTS_REF AX_078 /end AXIS_DESCR /end CHARACTERISTIC
/begin CHARACTERISTIC CAL_425 "значение #425" VALUE 0x0806D880 RL_FNC_SWORD 0 CM_RAW -32768 32767 /end CHARACTERISTIC
/begin CHARACTERISTIC CAL_426 "значение #426" VALUE 0x0806D882 RL_FNC_SWORD 0 CM_RAW -32768 32767 /end CHARACTERISTIC
/begin CHARACTERISTIC CAL_427 "карта #427 16x16: ? × ?" MAP 0x0806D884 RL_FNC_UWORD 0 CM_RAW 0 65535 /begin AXIS_DESCR COM_AXIS AXIN_078 CM_RAW 16 0 65535 AXIS_PTS_REF AX_078 /end AXIS_DESCR /begin AXIS_DESCR COM_AXIS AXIN_079 CM_RAW 16 0 65535 AXIS_PTS_REF AX_079 /end AXIS_DESCR /end CHARACTERISTIC
/begin CHARACTERISTIC CAL_428 "кривая #428 9: TCOOL" CURVE 0x0806E55C RL_FNC_UWORD 0 CM_RAW 0 65535
 /begin AXIS_DESCR COM_AXIS AXIN_00A_TCOOL CM_C128 9 -256 255.992 AXIS_PTS_REF AX_00A_TCOOL /end AXIS_DESCR
/end CHARACTERISTIC
/begin CHARACTERISTIC CAL_429_0 "кривая #429 16: ? [1/8]" CURVE 0x0806E570 RL_FNC_UWORD 0 CM_RAW 0 65535 /begin AXIS_DESCR COM_AXIS AXIN_078 CM_RAW 16 0 65535 AXIS_PTS_REF AX_078 /end AXIS_DESCR /end CHARACTERISTIC
/begin CHARACTERISTIC CAL_429_1 "кривая #429 16: ? [2/8]" CURVE 0x0806E590 RL_FNC_UWORD 0 CM_RAW 0 65535 /begin AXIS_DESCR COM_AXIS AXIN_078 CM_RAW 16 0 65535 AXIS_PTS_REF AX_078 /end AXIS_DESCR /end CHARACTERISTIC
/begin CHARACTERISTIC CAL_429_2 "кривая #429 16: ? [3/8]" CURVE 0x0806E5B0 RL_FNC_UWORD 0 CM_RAW 0 65535 /begin AXIS_DESCR COM_AXIS AXIN_078 CM_RAW 16 0 65535 AXIS_PTS_REF AX_078 /end AXIS_DESCR /end CHARACTERISTIC
/begin CHARACTERISTIC CAL_429_3 "кривая #429 16: ? [4/8]" CURVE 0x0806E5D0 RL_FNC_UWORD 0 CM_RAW 0 65535 /begin AXIS_DESCR COM_AXIS AXIN_078 CM_RAW 16 0 65535 AXIS_PTS_REF AX_078 /end AXIS_DESCR /end CHARACTERISTIC
/begin CHARACTERISTIC CAL_429_4 "кривая #429 16: ? [5/8]" CURVE 0x0806E5F0 RL_FNC_UWORD 0 CM_RAW 0 65535 /begin AXIS_DESCR COM_AXIS AXIN_078 CM_RAW 16 0 65535 AXIS_PTS_REF AX_078 /end AXIS_DESCR /end CHARACTERISTIC
/begin CHARACTERISTIC CAL_429_5 "кривая #429 16: ? [6/8]" CURVE 0x0806E610 RL_FNC_UWORD 0 CM_RAW 0 65535 /begin AXIS_DESCR COM_AXIS AXIN_078 CM_RAW 16 0 65535 AXIS_PTS_REF AX_078 /end AXIS_DESCR /end CHARACTERISTIC
/begin CHARACTERISTIC CAL_429_6 "кривая #429 16: ? [7/8]" CURVE 0x0806E630 RL_FNC_UWORD 0 CM_RAW 0 65535 /begin AXIS_DESCR COM_AXIS AXIN_078 CM_RAW 16 0 65535 AXIS_PTS_REF AX_078 /end AXIS_DESCR /end CHARACTERISTIC
/begin CHARACTERISTIC CAL_429_7 "кривая #429 16: ? [8/8]" CURVE 0x0806E650 RL_FNC_UWORD 0 CM_RAW 0 65535 /begin AXIS_DESCR COM_AXIS AXIN_078 CM_RAW 16 0 65535 AXIS_PTS_REF AX_078 /end AXIS_DESCR /end CHARACTERISTIC
/begin CHARACTERISTIC CAL_42A_0 "кривая #42A 16: ? [1/8]" CURVE 0x0806E670 RL_FNC_UWORD 0 CM_RAW 0 65535 /begin AXIS_DESCR COM_AXIS AXIN_078 CM_RAW 16 0 65535 AXIS_PTS_REF AX_078 /end AXIS_DESCR /end CHARACTERISTIC
/begin CHARACTERISTIC CAL_42A_1 "кривая #42A 16: ? [2/8]" CURVE 0x0806E690 RL_FNC_UWORD 0 CM_RAW 0 65535 /begin AXIS_DESCR COM_AXIS AXIN_078 CM_RAW 16 0 65535 AXIS_PTS_REF AX_078 /end AXIS_DESCR /end CHARACTERISTIC
/begin CHARACTERISTIC CAL_42A_2 "кривая #42A 16: ? [3/8]" CURVE 0x0806E6B0 RL_FNC_UWORD 0 CM_RAW 0 65535 /begin AXIS_DESCR COM_AXIS AXIN_078 CM_RAW 16 0 65535 AXIS_PTS_REF AX_078 /end AXIS_DESCR /end CHARACTERISTIC
/begin CHARACTERISTIC CAL_42A_3 "кривая #42A 16: ? [4/8]" CURVE 0x0806E6D0 RL_FNC_UWORD 0 CM_RAW 0 65535 /begin AXIS_DESCR COM_AXIS AXIN_078 CM_RAW 16 0 65535 AXIS_PTS_REF AX_078 /end AXIS_DESCR /end CHARACTERISTIC
/begin CHARACTERISTIC CAL_42A_4 "кривая #42A 16: ? [5/8]" CURVE 0x0806E6F0 RL_FNC_UWORD 0 CM_RAW 0 65535 /begin AXIS_DESCR COM_AXIS AXIN_078 CM_RAW 16 0 65535 AXIS_PTS_REF AX_078 /end AXIS_DESCR /end CHARACTERISTIC
/begin CHARACTERISTIC CAL_42A_5 "кривая #42A 16: ? [6/8]" CURVE 0x0806E710 RL_FNC_UWORD 0 CM_RAW 0 65535 /begin AXIS_DESCR COM_AXIS AXIN_078 CM_RAW 16 0 65535 AXIS_PTS_REF AX_078 /end AXIS_DESCR /end CHARACTERISTIC
/begin CHARACTERISTIC CAL_42A_6 "кривая #42A 16: ? [7/8]" CURVE 0x0806E730 RL_FNC_UWORD 0 CM_RAW 0 65535 /begin AXIS_DESCR COM_AXIS AXIN_078 CM_RAW 16 0 65535 AXIS_PTS_REF AX_078 /end AXIS_DESCR /end CHARACTERISTIC
/begin CHARACTERISTIC CAL_42A_7 "кривая #42A 16: ? [8/8]" CURVE 0x0806E750 RL_FNC_UWORD 0 CM_RAW 0 65535 /begin AXIS_DESCR COM_AXIS AXIN_078 CM_RAW 16 0 65535 AXIS_PTS_REF AX_078 /end AXIS_DESCR /end CHARACTERISTIC
/begin CHARACTERISTIC CAL_42B "кривая #42B 16: ?" CURVE 0x0806E770 RL_FNC_UWORD 0 CM_RAW 0 65535 /begin AXIS_DESCR COM_AXIS AXIN_079 CM_RAW 16 0 65535 AXIS_PTS_REF AX_079 /end AXIS_DESCR /end CHARACTERISTIC
/begin CHARACTERISTIC CAL_42C "кривая #42C 16: ?" CURVE 0x0806E790 RL_FNC_UWORD 0 CM_RAW 0 65535 /begin AXIS_DESCR COM_AXIS AXIN_079 CM_RAW 16 0 65535 AXIS_PTS_REF AX_079 /end AXIS_DESCR /end CHARACTERISTIC
/begin CHARACTERISTIC CAL_42D "массив #42D" VAL_BLK 0x0806E7B4 RL_FNC_UWORD 0 CM_RAW 0 65535 MATRIX_DIM 2 1 1 /end CHARACTERISTIC
/begin CHARACTERISTIC CAL_42E "массив #42E" VAL_BLK 0x0806E7BC RL_FNC_SWORD 0 CM_RAW -32768 32767 MATRIX_DIM 2 1 1 /end CHARACTERISTIC
/begin CHARACTERISTIC CAL_430 "массив #430" VAL_BLK 0x0806E554 RL_FNC_UWORD 0 CM_RAW 0 65535 MATRIX_DIM 3 1 1 /end CHARACTERISTIC
/begin CHARACTERISTIC CAL_431_0 "кривая #431 16: ? [1/8]" CURVE 0x0806D3A0 RL_FNC_UWORD 0 CM_RAW 0 65535 /begin AXIS_DESCR COM_AXIS AXIN_079 CM_RAW 16 0 65535 AXIS_PTS_REF AX_079 /end AXIS_DESCR /end CHARACTERISTIC
/begin CHARACTERISTIC CAL_431_1 "кривая #431 16: ? [2/8]" CURVE 0x0806D3C0 RL_FNC_UWORD 0 CM_RAW 0 65535 /begin AXIS_DESCR COM_AXIS AXIN_079 CM_RAW 16 0 65535 AXIS_PTS_REF AX_079 /end AXIS_DESCR /end CHARACTERISTIC
/begin CHARACTERISTIC CAL_431_2 "кривая #431 16: ? [3/8]" CURVE 0x0806D3E0 RL_FNC_UWORD 0 CM_RAW 0 65535 /begin AXIS_DESCR COM_AXIS AXIN_079 CM_RAW 16 0 65535 AXIS_PTS_REF AX_079 /end AXIS_DESCR /end CHARACTERISTIC
/begin CHARACTERISTIC CAL_431_3 "кривая #431 16: ? [4/8]" CURVE 0x0806D400 RL_FNC_UWORD 0 CM_RAW 0 65535 /begin AXIS_DESCR COM_AXIS AXIN_079 CM_RAW 16 0 65535 AXIS_PTS_REF AX_079 /end AXIS_DESCR /end CHARACTERISTIC
/begin CHARACTERISTIC CAL_431_4 "кривая #431 16: ? [5/8]" CURVE 0x0806D420 RL_FNC_UWORD 0 CM_RAW 0 65535 /begin AXIS_DESCR COM_AXIS AXIN_079 CM_RAW 16 0 65535 AXIS_PTS_REF AX_079 /end AXIS_DESCR /end CHARACTERISTIC
/begin CHARACTERISTIC CAL_431_5 "кривая #431 16: ? [6/8]" CURVE 0x0806D440 RL_FNC_UWORD 0 CM_RAW 0 65535 /begin AXIS_DESCR COM_AXIS AXIN_079 CM_RAW 16 0 65535 AXIS_PTS_REF AX_079 /end AXIS_DESCR /end CHARACTERISTIC
/begin CHARACTERISTIC CAL_431_6 "кривая #431 16: ? [7/8]" CURVE 0x0806D460 RL_FNC_UWORD 0 CM_RAW 0 65535 /begin AXIS_DESCR COM_AXIS AXIN_079 CM_RAW 16 0 65535 AXIS_PTS_REF AX_079 /end AXIS_DESCR /end CHARACTERISTIC
/begin CHARACTERISTIC CAL_431_7 "кривая #431 16: ? [8/8]" CURVE 0x0806D480 RL_FNC_UWORD 0 CM_RAW 0 65535 /begin AXIS_DESCR COM_AXIS AXIN_079 CM_RAW 16 0 65535 AXIS_PTS_REF AX_079 /end AXIS_DESCR /end CHARACTERISTIC
/begin CHARACTERISTIC CAL_432 "кривая #432 16: TCOOL" CURVE 0x0806D4C0 RL_FNC_UWORD 0 CM_RAW 0 65535
 /begin AXIS_DESCR COM_AXIS AXIN_004_TCOOL CM_C128 16 -256 255.992 AXIS_PTS_REF AX_004_TCOOL /end AXIS_DESCR
/end CHARACTERISTIC
/begin CHARACTERISTIC CAL_433 "кривая #433 16: TCOOL" CURVE 0x0806D4A0 RL_FNC_UWORD 0 CM_RAW 0 65535
 /begin AXIS_DESCR COM_AXIS AXIN_004_TCOOL CM_C128 16 -256 255.992 AXIS_PTS_REF AX_004_TCOOL /end AXIS_DESCR
/end CHARACTERISTIC
/begin CHARACTERISTIC CAL_434 "массив #434" VAL_BLK 0x0806DE08 RL_FNC_SBYTE 0 CM_RAW -128 127 MATRIX_DIM 8 1 1 /end CHARACTERISTIC
/begin CHARACTERISTIC CAL_435 "карта #435 16x16: ? × ?" MAP 0x0806DF44 RL_FNC_UWORD 0 CM_RAW 0 65535 /begin AXIS_DESCR COM_AXIS AXIN_078 CM_RAW 16 0 65535 AXIS_PTS_REF AX_078 /end AXIS_DESCR /begin AXIS_DESCR COM_AXIS AXIN_079 CM_RAW 16 0 65535 AXIS_PTS_REF AX_079 /end AXIS_DESCR /end CHARACTERISTIC
/begin CHARACTERISTIC CAL_436 "кривая #436 16: ?" CURVE 0x0806DF24 RL_FNC_UWORD 0 CM_RAW 0 65535 /begin AXIS_DESCR COM_AXIS AXIN_078 CM_RAW 16 0 65535 AXIS_PTS_REF AX_078 /end AXIS_DESCR /end CHARACTERISTIC
/begin CHARACTERISTIC CAL_437_0 "кривая #437 16: ? [1/8]" CURVE 0x0806DE24 RL_FNC_UWORD 0 CM_RAW 0 65535 /begin AXIS_DESCR COM_AXIS AXIN_078 CM_RAW 16 0 65535 AXIS_PTS_REF AX_078 /end AXIS_DESCR /end CHARACTERISTIC
/begin CHARACTERISTIC CAL_437_1 "кривая #437 16: ? [2/8]" CURVE 0x0806DE44 RL_FNC_UWORD 0 CM_RAW 0 65535 /begin AXIS_DESCR COM_AXIS AXIN_078 CM_RAW 16 0 65535 AXIS_PTS_REF AX_078 /end AXIS_DESCR /end CHARACTERISTIC
/begin CHARACTERISTIC CAL_437_2 "кривая #437 16: ? [3/8]" CURVE 0x0806DE64 RL_FNC_UWORD 0 CM_RAW 0 65535 /begin AXIS_DESCR COM_AXIS AXIN_078 CM_RAW 16 0 65535 AXIS_PTS_REF AX_078 /end AXIS_DESCR /end CHARACTERISTIC
/begin CHARACTERISTIC CAL_437_3 "кривая #437 16: ? [4/8]" CURVE 0x0806DE84 RL_FNC_UWORD 0 CM_RAW 0 65535 /begin AXIS_DESCR COM_AXIS AXIN_078 CM_RAW 16 0 65535 AXIS_PTS_REF AX_078 /end AXIS_DESCR /end CHARACTERISTIC
/begin CHARACTERISTIC CAL_437_4 "кривая #437 16: ? [5/8]" CURVE 0x0806DEA4 RL_FNC_UWORD 0 CM_RAW 0 65535 /begin AXIS_DESCR COM_AXIS AXIN_078 CM_RAW 16 0 65535 AXIS_PTS_REF AX_078 /end AXIS_DESCR /end CHARACTERISTIC
/begin CHARACTERISTIC CAL_437_5 "кривая #437 16: ? [6/8]" CURVE 0x0806DEC4 RL_FNC_UWORD 0 CM_RAW 0 65535 /begin AXIS_DESCR COM_AXIS AXIN_078 CM_RAW 16 0 65535 AXIS_PTS_REF AX_078 /end AXIS_DESCR /end CHARACTERISTIC
/begin CHARACTERISTIC CAL_437_6 "кривая #437 16: ? [7/8]" CURVE 0x0806DEE4 RL_FNC_UWORD 0 CM_RAW 0 65535 /begin AXIS_DESCR COM_AXIS AXIN_078 CM_RAW 16 0 65535 AXIS_PTS_REF AX_078 /end AXIS_DESCR /end CHARACTERISTIC
/begin CHARACTERISTIC CAL_437_7 "кривая #437 16: ? [8/8]" CURVE 0x0806DF04 RL_FNC_UWORD 0 CM_RAW 0 65535 /begin AXIS_DESCR COM_AXIS AXIN_078 CM_RAW 16 0 65535 AXIS_PTS_REF AX_078 /end AXIS_DESCR /end CHARACTERISTIC
/begin CHARACTERISTIC CAL_438 "карта #438 16x16: ? × ?" MAP 0x0806E264 RL_FNC_UWORD 0 CM_RAW 0 65535 /begin AXIS_DESCR COM_AXIS AXIN_078 CM_RAW 16 0 65535 AXIS_PTS_REF AX_078 /end AXIS_DESCR /begin AXIS_DESCR COM_AXIS AXIN_079 CM_RAW 16 0 65535 AXIS_PTS_REF AX_079 /end AXIS_DESCR /end CHARACTERISTIC
/begin CHARACTERISTIC CAL_439 "кривая #439 16: ?" CURVE 0x0806E244 RL_FNC_UWORD 0 CM_RAW 0 65535 /begin AXIS_DESCR COM_AXIS AXIN_078 CM_RAW 16 0 65535 AXIS_PTS_REF AX_078 /end AXIS_DESCR /end CHARACTERISTIC
/begin CHARACTERISTIC CAL_43A_0 "кривая #43A 16: ? [1/8]" CURVE 0x0806E144 RL_FNC_UWORD 0 CM_RAW 0 65535 /begin AXIS_DESCR COM_AXIS AXIN_078 CM_RAW 16 0 65535 AXIS_PTS_REF AX_078 /end AXIS_DESCR /end CHARACTERISTIC
/begin CHARACTERISTIC CAL_43A_1 "кривая #43A 16: ? [2/8]" CURVE 0x0806E164 RL_FNC_UWORD 0 CM_RAW 0 65535 /begin AXIS_DESCR COM_AXIS AXIN_078 CM_RAW 16 0 65535 AXIS_PTS_REF AX_078 /end AXIS_DESCR /end CHARACTERISTIC
/begin CHARACTERISTIC CAL_43A_2 "кривая #43A 16: ? [3/8]" CURVE 0x0806E184 RL_FNC_UWORD 0 CM_RAW 0 65535 /begin AXIS_DESCR COM_AXIS AXIN_078 CM_RAW 16 0 65535 AXIS_PTS_REF AX_078 /end AXIS_DESCR /end CHARACTERISTIC
/begin CHARACTERISTIC CAL_43A_3 "кривая #43A 16: ? [4/8]" CURVE 0x0806E1A4 RL_FNC_UWORD 0 CM_RAW 0 65535 /begin AXIS_DESCR COM_AXIS AXIN_078 CM_RAW 16 0 65535 AXIS_PTS_REF AX_078 /end AXIS_DESCR /end CHARACTERISTIC
/begin CHARACTERISTIC CAL_43A_4 "кривая #43A 16: ? [5/8]" CURVE 0x0806E1C4 RL_FNC_UWORD 0 CM_RAW 0 65535 /begin AXIS_DESCR COM_AXIS AXIN_078 CM_RAW 16 0 65535 AXIS_PTS_REF AX_078 /end AXIS_DESCR /end CHARACTERISTIC
/begin CHARACTERISTIC CAL_43A_5 "кривая #43A 16: ? [6/8]" CURVE 0x0806E1E4 RL_FNC_UWORD 0 CM_RAW 0 65535 /begin AXIS_DESCR COM_AXIS AXIN_078 CM_RAW 16 0 65535 AXIS_PTS_REF AX_078 /end AXIS_DESCR /end CHARACTERISTIC
/begin CHARACTERISTIC CAL_43A_6 "кривая #43A 16: ? [7/8]" CURVE 0x0806E204 RL_FNC_UWORD 0 CM_RAW 0 65535 /begin AXIS_DESCR COM_AXIS AXIN_078 CM_RAW 16 0 65535 AXIS_PTS_REF AX_078 /end AXIS_DESCR /end CHARACTERISTIC
/begin CHARACTERISTIC CAL_43A_7 "кривая #43A 16: ? [8/8]" CURVE 0x0806E224 RL_FNC_UWORD 0 CM_RAW 0 65535 /begin AXIS_DESCR COM_AXIS AXIN_078 CM_RAW 16 0 65535 AXIS_PTS_REF AX_078 /end AXIS_DESCR /end CHARACTERISTIC
/begin CHARACTERISTIC CAL_43B "значение #43B" VALUE 0x0806D39C RL_FNC_UWORD 0 CM_RAW 0 65535 /end CHARACTERISTIC
/begin CHARACTERISTIC CAL_43C "массив #43C" VAL_BLK 0x0806D644 RL_FNC_UWORD 0 CM_RAW 0 65535 MATRIX_DIM 2 1 1 /end CHARACTERISTIC
/begin CHARACTERISTIC CAL_43D "значение #43D" VALUE 0x0806D64A RL_FNC_UWORD 0 CM_RAW 0 65535 /end CHARACTERISTIC
/begin CHARACTERISTIC CAL_43E "значение #43E" VALUE 0x0806D64C RL_FNC_UWORD 0 CM_RAW 0 65535 /end CHARACTERISTIC
/begin CHARACTERISTIC CAL_43F_0 "кривая #43F 16: ? [1/8]" CURVE 0x0806DAF8 RL_FNC_UWORD 0 CM_RAW 0 65535 /begin AXIS_DESCR COM_AXIS AXIN_079 CM_RAW 16 0 65535 AXIS_PTS_REF AX_079 /end AXIS_DESCR /end CHARACTERISTIC
/begin CHARACTERISTIC CAL_43F_1 "кривая #43F 16: ? [2/8]" CURVE 0x0806DB18 RL_FNC_UWORD 0 CM_RAW 0 65535 /begin AXIS_DESCR COM_AXIS AXIN_079 CM_RAW 16 0 65535 AXIS_PTS_REF AX_079 /end AXIS_DESCR /end CHARACTERISTIC
/begin CHARACTERISTIC CAL_43F_2 "кривая #43F 16: ? [3/8]" CURVE 0x0806DB38 RL_FNC_UWORD 0 CM_RAW 0 65535 /begin AXIS_DESCR COM_AXIS AXIN_079 CM_RAW 16 0 65535 AXIS_PTS_REF AX_079 /end AXIS_DESCR /end CHARACTERISTIC
/begin CHARACTERISTIC CAL_43F_3 "кривая #43F 16: ? [4/8]" CURVE 0x0806DB58 RL_FNC_UWORD 0 CM_RAW 0 65535 /begin AXIS_DESCR COM_AXIS AXIN_079 CM_RAW 16 0 65535 AXIS_PTS_REF AX_079 /end AXIS_DESCR /end CHARACTERISTIC
/begin CHARACTERISTIC CAL_43F_4 "кривая #43F 16: ? [5/8]" CURVE 0x0806DB78 RL_FNC_UWORD 0 CM_RAW 0 65535 /begin AXIS_DESCR COM_AXIS AXIN_079 CM_RAW 16 0 65535 AXIS_PTS_REF AX_079 /end AXIS_DESCR /end CHARACTERISTIC
/begin CHARACTERISTIC CAL_43F_5 "кривая #43F 16: ? [6/8]" CURVE 0x0806DB98 RL_FNC_UWORD 0 CM_RAW 0 65535 /begin AXIS_DESCR COM_AXIS AXIN_079 CM_RAW 16 0 65535 AXIS_PTS_REF AX_079 /end AXIS_DESCR /end CHARACTERISTIC
/begin CHARACTERISTIC CAL_43F_6 "кривая #43F 16: ? [7/8]" CURVE 0x0806DBB8 RL_FNC_UWORD 0 CM_RAW 0 65535 /begin AXIS_DESCR COM_AXIS AXIN_079 CM_RAW 16 0 65535 AXIS_PTS_REF AX_079 /end AXIS_DESCR /end CHARACTERISTIC
/begin CHARACTERISTIC CAL_43F_7 "кривая #43F 16: ? [8/8]" CURVE 0x0806DBD8 RL_FNC_UWORD 0 CM_RAW 0 65535 /begin AXIS_DESCR COM_AXIS AXIN_079 CM_RAW 16 0 65535 AXIS_PTS_REF AX_079 /end AXIS_DESCR /end CHARACTERISTIC
/begin CHARACTERISTIC CAL_440_0 "кривая #440 16: ? [1/8]" CURVE 0x0806DBF8 RL_FNC_UWORD 0 CM_RAW 0 65535 /begin AXIS_DESCR COM_AXIS AXIN_079 CM_RAW 16 0 65535 AXIS_PTS_REF AX_079 /end AXIS_DESCR /end CHARACTERISTIC
/begin CHARACTERISTIC CAL_440_1 "кривая #440 16: ? [2/8]" CURVE 0x0806DC18 RL_FNC_UWORD 0 CM_RAW 0 65535 /begin AXIS_DESCR COM_AXIS AXIN_079 CM_RAW 16 0 65535 AXIS_PTS_REF AX_079 /end AXIS_DESCR /end CHARACTERISTIC
/begin CHARACTERISTIC CAL_440_2 "кривая #440 16: ? [3/8]" CURVE 0x0806DC38 RL_FNC_UWORD 0 CM_RAW 0 65535 /begin AXIS_DESCR COM_AXIS AXIN_079 CM_RAW 16 0 65535 AXIS_PTS_REF AX_079 /end AXIS_DESCR /end CHARACTERISTIC
/begin CHARACTERISTIC CAL_440_3 "кривая #440 16: ? [4/8]" CURVE 0x0806DC58 RL_FNC_UWORD 0 CM_RAW 0 65535 /begin AXIS_DESCR COM_AXIS AXIN_079 CM_RAW 16 0 65535 AXIS_PTS_REF AX_079 /end AXIS_DESCR /end CHARACTERISTIC
/begin CHARACTERISTIC CAL_440_4 "кривая #440 16: ? [5/8]" CURVE 0x0806DC78 RL_FNC_UWORD 0 CM_RAW 0 65535 /begin AXIS_DESCR COM_AXIS AXIN_079 CM_RAW 16 0 65535 AXIS_PTS_REF AX_079 /end AXIS_DESCR /end CHARACTERISTIC
/begin CHARACTERISTIC CAL_440_5 "кривая #440 16: ? [6/8]" CURVE 0x0806DC98 RL_FNC_UWORD 0 CM_RAW 0 65535 /begin AXIS_DESCR COM_AXIS AXIN_079 CM_RAW 16 0 65535 AXIS_PTS_REF AX_079 /end AXIS_DESCR /end CHARACTERISTIC
/begin CHARACTERISTIC CAL_440_6 "кривая #440 16: ? [7/8]" CURVE 0x0806DCB8 RL_FNC_UWORD 0 CM_RAW 0 65535 /begin AXIS_DESCR COM_AXIS AXIN_079 CM_RAW 16 0 65535 AXIS_PTS_REF AX_079 /end AXIS_DESCR /end CHARACTERISTIC
/begin CHARACTERISTIC CAL_440_7 "кривая #440 16: ? [8/8]" CURVE 0x0806DCD8 RL_FNC_UWORD 0 CM_RAW 0 65535 /begin AXIS_DESCR COM_AXIS AXIN_079 CM_RAW 16 0 65535 AXIS_PTS_REF AX_079 /end AXIS_DESCR /end CHARACTERISTIC
/begin CHARACTERISTIC CAL_441_0 "кривая #441 16: ? [1/8]" CURVE 0x0806DCF8 RL_FNC_UWORD 0 CM_RAW 0 65535 /begin AXIS_DESCR COM_AXIS AXIN_079 CM_RAW 16 0 65535 AXIS_PTS_REF AX_079 /end AXIS_DESCR /end CHARACTERISTIC
/begin CHARACTERISTIC CAL_441_1 "кривая #441 16: ? [2/8]" CURVE 0x0806DD18 RL_FNC_UWORD 0 CM_RAW 0 65535 /begin AXIS_DESCR COM_AXIS AXIN_079 CM_RAW 16 0 65535 AXIS_PTS_REF AX_079 /end AXIS_DESCR /end CHARACTERISTIC
/begin CHARACTERISTIC CAL_441_2 "кривая #441 16: ? [3/8]" CURVE 0x0806DD38 RL_FNC_UWORD 0 CM_RAW 0 65535 /begin AXIS_DESCR COM_AXIS AXIN_079 CM_RAW 16 0 65535 AXIS_PTS_REF AX_079 /end AXIS_DESCR /end CHARACTERISTIC
/begin CHARACTERISTIC CAL_441_3 "кривая #441 16: ? [4/8]" CURVE 0x0806DD58 RL_FNC_UWORD 0 CM_RAW 0 65535 /begin AXIS_DESCR COM_AXIS AXIN_079 CM_RAW 16 0 65535 AXIS_PTS_REF AX_079 /end AXIS_DESCR /end CHARACTERISTIC
/begin CHARACTERISTIC CAL_441_4 "кривая #441 16: ? [5/8]" CURVE 0x0806DD78 RL_FNC_UWORD 0 CM_RAW 0 65535 /begin AXIS_DESCR COM_AXIS AXIN_079 CM_RAW 16 0 65535 AXIS_PTS_REF AX_079 /end AXIS_DESCR /end CHARACTERISTIC
/begin CHARACTERISTIC CAL_441_5 "кривая #441 16: ? [6/8]" CURVE 0x0806DD98 RL_FNC_UWORD 0 CM_RAW 0 65535 /begin AXIS_DESCR COM_AXIS AXIN_079 CM_RAW 16 0 65535 AXIS_PTS_REF AX_079 /end AXIS_DESCR /end CHARACTERISTIC
/begin CHARACTERISTIC CAL_441_6 "кривая #441 16: ? [7/8]" CURVE 0x0806DDB8 RL_FNC_UWORD 0 CM_RAW 0 65535 /begin AXIS_DESCR COM_AXIS AXIN_079 CM_RAW 16 0 65535 AXIS_PTS_REF AX_079 /end AXIS_DESCR /end CHARACTERISTIC
/begin CHARACTERISTIC CAL_441_7 "кривая #441 16: ? [8/8]" CURVE 0x0806DDD8 RL_FNC_UWORD 0 CM_RAW 0 65535 /begin AXIS_DESCR COM_AXIS AXIN_079 CM_RAW 16 0 65535 AXIS_PTS_REF AX_079 /end AXIS_DESCR /end CHARACTERISTIC
/begin CHARACTERISTIC CAL_442 "значение #442" VALUE 0x0806E55A RL_FNC_UWORD 0 CM_RAW 0 65535 /end CHARACTERISTIC
/begin CHARACTERISTIC CAL_443 "значение #443" VALUE 0x0806E7B0 RL_FNC_SBYTE 0 CM_RAW -128 127 /end CHARACTERISTIC
/begin CHARACTERISTIC CAL_444 "массив #444" VAL_BLK 0x0806D650 RL_FNC_UWORD 0 CM_RAW 0 65535 MATRIX_DIM 8 1 1 /end CHARACTERISTIC
/begin CHARACTERISTIC CAL_445 "значение #445" VALUE 0x0806D63C RL_FNC_SWORD 0 CM_RAW -32768 32767 /end CHARACTERISTIC
/begin CHARACTERISTIC CAL_446 "кривая #446 8: ?" CURVE 0x0806DDF8 RL_FNC_SWORD 0 CM_RAW -32768 32767 /begin AXIS_DESCR COM_AXIS AXIN_07C CM_RAW 8 0 65535 AXIS_PTS_REF AX_07C /end AXIS_DESCR /end CHARACTERISTIC
/begin CHARACTERISTIC CAL_447 "значение #447" VALUE 0x0806DE18 RL_FNC_UWORD 0 CM_RAW 0 65535 /end CHARACTERISTIC
/begin CHARACTERISTIC CAL_448 "значение #448" VALUE 0x0806D640 RL_FNC_SWORD 0 CM_RAW -32768 32767 /end CHARACTERISTIC
/begin CHARACTERISTIC CAL_449 "значение #449" VALUE 0x0806E7C2 RL_FNC_SWORD 0 CM_RAW -32768 32767 /end CHARACTERISTIC
/begin CHARACTERISTIC CAL_44A "значение #44A" VALUE 0x0806D63E RL_FNC_SWORD 0 CM_RAW -32768 32767 /end CHARACTERISTIC
/begin CHARACTERISTIC CAL_44B "значение #44B" VALUE 0x0806E7C0 RL_FNC_SWORD 0 CM_RAW -32768 32767 /end CHARACTERISTIC
/begin CHARACTERISTIC CAL_44C_0 "кривая #44C 17: N [1/2]" CURVE 0x0806E464 RL_FNC_UWORD 0 CM_RAW 0 65535
 /begin AXIS_DESCR COM_AXIS AXIN_001_N CM_RPM2 17 0 32767.5 AXIS_PTS_REF AX_001_N /end AXIS_DESCR
/end CHARACTERISTIC
/begin CHARACTERISTIC CAL_44C_1 "кривая #44C 17: N [2/2]" CURVE 0x0806E486 RL_FNC_UWORD 0 CM_RAW 0 65535
 /begin AXIS_DESCR COM_AXIS AXIN_001_N CM_RPM2 17 0 32767.5 AXIS_PTS_REF AX_001_N /end AXIS_DESCR
/end CHARACTERISTIC
/begin CHARACTERISTIC CAL_44D "карта #44D 8x10: N × LOAD" MAP 0x0806E4A8 RL_FNC_UWORD 0 CM_RAW 0 65535
 /begin AXIS_DESCR COM_AXIS AXIN_00C_N CM_RPM2 10 0 32767.5 AXIS_PTS_REF AX_00C_N /end AXIS_DESCR
 /begin AXIS_DESCR COM_AXIS AXIN_07B_LOAD CM_RAW 8 0 65535 AXIS_PTS_REF AX_07B_LOAD /end AXIS_DESCR
/end CHARACTERISTIC
/begin CHARACTERISTIC CAL_44E "карта #44E 16x10: N × ?" MAP 0x0806D4E0 RL_FNC_UWORD 0 CM_RAW 0 65535
 /begin AXIS_DESCR COM_AXIS AXIN_00C_N CM_RPM2 10 0 32767.5 AXIS_PTS_REF AX_00C_N /end AXIS_DESCR
 /begin AXIS_DESCR COM_AXIS AXIN_079 CM_RAW 16 0 65535 AXIS_PTS_REF AX_079 /end AXIS_DESCR
/end CHARACTERISTIC
/begin CHARACTERISTIC CAL_44F "карта #44F 16x17: N × LOAD" MAP 0x0806D660 RL_FNC_SWORD 0 CM_RAW -32768 32767
 /begin AXIS_DESCR COM_AXIS AXIN_001_N CM_RPM2 17 0 32767.5 AXIS_PTS_REF AX_001_N /end AXIS_DESCR
 /begin AXIS_DESCR COM_AXIS AXIN_07A_LOAD CM_RAW 16 0 65535 AXIS_PTS_REF AX_07A_LOAD /end AXIS_DESCR
/end CHARACTERISTIC
/begin CHARACTERISTIC CAL_450 "массив #450" VAL_BLK 0x0806DE14 RL_FNC_SBYTE 0 CM_RAW -128 127 MATRIX_DIM 4 1 1 /end CHARACTERISTIC
/begin CHARACTERISTIC CAL_451 "значение #451" VALUE 0x0806E7B8 RL_FNC_SWORD 0 CM_RAW -32768 32767 /end CHARACTERISTIC
/begin CHARACTERISTIC CAL_452 "значение #452" VALUE 0x0806D620 RL_FNC_SBYTE 0 CM_RAW -128 127 /end CHARACTERISTIC
/begin CHARACTERISTIC CAL_453 "значение #453" VALUE 0x0806D622 RL_FNC_UWORD 0 CM_RAW 0 65535 /end CHARACTERISTIC
/begin CHARACTERISTIC CAL_454 "значение #454" VALUE 0x0806D624 RL_FNC_SBYTE 0 CM_RAW -128 127 /end CHARACTERISTIC
/begin CHARACTERISTIC CAL_455 "значение #455" VALUE 0x0806D625 RL_FNC_SBYTE 0 CM_RAW -128 127 /end CHARACTERISTIC
/begin CHARACTERISTIC CAL_456 "кривая #456 9: TCOOL" CURVE 0x0806D628 RL_FNC_UWORD 0 CM_RAW 0 65535
 /begin AXIS_DESCR COM_AXIS AXIN_00A_TCOOL CM_C128 9 -256 255.992 AXIS_PTS_REF AX_00A_TCOOL /end AXIS_DESCR
/end CHARACTERISTIC
/begin CHARACTERISTIC CAL_457 "значение #457" VALUE 0x0806D63A RL_FNC_UWORD 0 CM_RAW 0 65535 /end CHARACTERISTIC
/begin CHARACTERISTIC CAL_458 "значение #458" VALUE 0x0806D648 RL_FNC_UWORD 0 CM_RAW 0 65535 /end CHARACTERISTIC
/begin CHARACTERISTIC CAL_459 "массив #459" VAL_BLK 0x0806DA88 RL_FNC_UWORD 0 CM_RAW 0 65535 MATRIX_DIM 8 1 1 /end CHARACTERISTIC
/begin CHARACTERISTIC CAL_45A "значение #45A" VALUE 0x0806DA84 RL_FNC_SBYTE 0 CM_RAW -128 127 /end CHARACTERISTIC
/begin CHARACTERISTIC CAL_45B "значение #45B" VALUE 0x0806DE10 RL_FNC_SBYTE 0 CM_RAW -128 127 /end CHARACTERISTIC
/begin CHARACTERISTIC CAL_45C "значение #45C" VALUE 0x0806DE11 RL_FNC_SBYTE 0 CM_RAW -128 127 /end CHARACTERISTIC
/begin CHARACTERISTIC CAL_45D "массив #45D" VAL_BLK 0x0806DE1C RL_FNC_UWORD 0 CM_RAW 0 65535 MATRIX_DIM 2 1 1 /end CHARACTERISTIC
/begin CHARACTERISTIC CAL_45E "значение #45E" VALUE 0x0806DE20 RL_FNC_SBYTE 0 CM_RAW -128 127 /end CHARACTERISTIC
/begin CHARACTERISTIC CAL_45F "значение #45F" VALUE 0x0806E548 RL_FNC_SBYTE 0 CM_RAW -128 127 /end CHARACTERISTIC
/begin CHARACTERISTIC CAL_460 "массив #460" VAL_BLK 0x0806E54C RL_FNC_SBYTE 0 CM_RAW -128 127 MATRIX_DIM 8 1 1 /end CHARACTERISTIC
/begin CHARACTERISTIC CAL_461 "массив #461" VAL_BLK 0x0806E7C4 RL_FNC_UWORD 0 CM_RAW 0 65535 MATRIX_DIM 2 1 1 /end CHARACTERISTIC
/begin CHARACTERISTIC CAL_462 "значение #462" VALUE 0x0806E56E RL_FNC_UWORD 0 CM_RAW 0 65535 /end CHARACTERISTIC
/begin CHARACTERISTIC CAL_463 "значение #463" VALUE 0x08070606 RL_FNC_SWORD 0 CM_RAW -32768 32767 /end CHARACTERISTIC
/begin CHARACTERISTIC CAL_464 "значение #464" VALUE 0x0806D290 RL_FNC_UWORD 0 CM_RAW 0 65535 /end CHARACTERISTIC
/begin CHARACTERISTIC CAL_465 "массив #465" VAL_BLK 0x08064384 RL_FNC_SWORD 0 CM_RAW -32768 32767 MATRIX_DIM 3 1 1 /end CHARACTERISTIC
/begin CHARACTERISTIC CAL_466 "массив #466" VAL_BLK 0x0806438C RL_FNC_SWORD 0 CM_RAW -32768 32767 MATRIX_DIM 3 1 1 /end CHARACTERISTIC
/begin CHARACTERISTIC CAL_467 "массив #467 [знак по значениям]" VAL_BLK 0x08069758 RL_FNC_SWORD 0 CM_RAW -32768 32767 MATRIX_DIM 25 1 1 /end CHARACTERISTIC
/begin CHARACTERISTIC CAL_468 "массив #468 [знак по значениям]" VAL_BLK 0x0806978C RL_FNC_SWORD 0 CM_RAW -32768 32767 MATRIX_DIM 25 1 1 /end CHARACTERISTIC
/begin CHARACTERISTIC CAL_469 "массив #469" VAL_BLK 0x080697C8 RL_FNC_UWORD 0 CM_RAW 0 65535 MATRIX_DIM 2 1 1 /end CHARACTERISTIC
/begin CHARACTERISTIC CAL_46A "массив #46A" VAL_BLK 0x0806997C RL_FNC_UWORD 0 CM_RAW 0 65535 MATRIX_DIM 3 1 1 /end CHARACTERISTIC
/begin CHARACTERISTIC CAL_46B "значение #46B" VALUE 0x0806E7D4 RL_FNC_SWORD 0 CM_RAW -32768 32767 /end CHARACTERISTIC
/begin CHARACTERISTIC CAL_46C "массив #46C [знак по значениям]" VAL_BLK 0x08065498 RL_FNC_SWORD 0 CM_RAW -32768 32767 MATRIX_DIM 2 1 1 /end CHARACTERISTIC
/begin CHARACTERISTIC CAL_46D_0 "кривая #46D 14: UBAT [1/2]" CURVE 0x08065528 RL_FNC_UWORD 0 CM_RAW 0 65535
 /begin AXIS_DESCR COM_AXIS AXIN_003_UBAT CM_RAW 14 0 65535 AXIS_PTS_REF AX_003_UBAT /end AXIS_DESCR
/end CHARACTERISTIC
/begin CHARACTERISTIC CAL_46D_1 "кривая #46D 14: UBAT [2/2]" CURVE 0x08065544 RL_FNC_UWORD 0 CM_RAW 0 65535
 /begin AXIS_DESCR COM_AXIS AXIN_003_UBAT CM_RAW 14 0 65535 AXIS_PTS_REF AX_003_UBAT /end AXIS_DESCR
/end CHARACTERISTIC
/begin CHARACTERISTIC CAL_46E "значение #46E" VALUE 0x08065560 RL_FNC_UWORD 0 CM_RAW 0 65535 /end CHARACTERISTIC
/begin CHARACTERISTIC CAL_46F "значение #46F" VALUE 0x08065562 RL_FNC_UWORD 0 CM_RAW 0 65535 /end CHARACTERISTIC
/begin CHARACTERISTIC CAL_470 "значение #470" VALUE 0x08065564 RL_FNC_UWORD 0 CM_RAW 0 65535 /end CHARACTERISTIC
/begin CHARACTERISTIC CAL_471 "массив #471" VAL_BLK 0x08065568 RL_FNC_UWORD 0 CM_RAW 0 65535 MATRIX_DIM 2 1 1 /end CHARACTERISTIC
/begin CHARACTERISTIC CAL_476 "значение #476" VALUE 0x080624EC RL_FNC_UWORD 0 CM_RAW 0 65535 /end CHARACTERISTIC
/begin CHARACTERISTIC CAL_477 "значение #477" VALUE 0x080624F0 RL_FNC_SWORD 0 CM_RAW -32768 32767 /end CHARACTERISTIC
/begin CHARACTERISTIC CAL_478 "значение #478" VALUE 0x080624F2 RL_FNC_SWORD 0 CM_RAW -32768 32767 /end CHARACTERISTIC
/begin CHARACTERISTIC CAL_479 "значение #479" VALUE 0x080624F4 RL_FNC_SBYTE 0 CM_RAW -128 127 /end CHARACTERISTIC
/begin CHARACTERISTIC CAL_47A "массив #47A" VAL_BLK 0x080624F8 RL_FNC_UWORD 0 CM_RAW 0 65535 MATRIX_DIM 3 1 1 /end CHARACTERISTIC
/begin CHARACTERISTIC CAL_47B_0 "карта #47B 8x10: N × GEAR [1/2]" MAP 0x08062508 RL_FNC_UWORD 0 CM_RAW 0 65535
 /begin AXIS_DESCR COM_AXIS AXIN_00C_N CM_RPM2 10 0 32767.5 AXIS_PTS_REF AX_00C_N /end AXIS_DESCR
 /begin AXIS_DESCR COM_AXIS AXIN_05E_GEAR CM_RAW 8 -128 127 AXIS_PTS_REF AX_05E_GEAR /end AXIS_DESCR
/end CHARACTERISTIC
/begin CHARACTERISTIC CAL_47B_1 "карта #47B 8x10: N × GEAR [2/2]" MAP 0x080625A8 RL_FNC_UWORD 0 CM_RAW 0 65535
 /begin AXIS_DESCR COM_AXIS AXIN_00C_N CM_RPM2 10 0 32767.5 AXIS_PTS_REF AX_00C_N /end AXIS_DESCR
 /begin AXIS_DESCR COM_AXIS AXIN_05E_GEAR CM_RAW 8 -128 127 AXIS_PTS_REF AX_05E_GEAR /end AXIS_DESCR
/end CHARACTERISTIC
/begin CHARACTERISTIC CAL_47C "значение #47C" VALUE 0x08062648 RL_FNC_UWORD 0 CM_RAW 0 65535 /end CHARACTERISTIC
/begin CHARACTERISTIC CAL_47D "кривая #47D 6: PEDAL" CURVE 0x0806264C RL_FNC_UWORD 0 CM_RAW 0 65535
 /begin AXIS_DESCR COM_AXIS AXIN_07E_PEDAL CM_P128 6 0 511.992 AXIS_PTS_REF AX_07E_PEDAL /end AXIS_DESCR
/end CHARACTERISTIC
/begin CHARACTERISTIC CAL_47E "массив #47E" VAL_BLK 0x08062658 RL_FNC_UWORD 0 CM_RAW 0 65535 MATRIX_DIM 3 1 1 /end CHARACTERISTIC
/begin CHARACTERISTIC CAL_47F "значение #47F" VALUE 0x0806265E RL_FNC_UWORD 0 CM_RAW 0 65535 /end CHARACTERISTIC
/begin CHARACTERISTIC CAL_480 "массив #480" VAL_BLK 0x08062660 RL_FNC_UWORD 0 CM_RAW 0 65535 MATRIX_DIM 2 1 1 /end CHARACTERISTIC
/begin CHARACTERISTIC CAL_481 "массив #481" VAL_BLK 0x08062664 RL_FNC_UWORD 0 CM_RAW 0 65535 MATRIX_DIM 2 1 1 /end CHARACTERISTIC
/begin CHARACTERISTIC CAL_482 "массив #482" VAL_BLK 0x08062668 RL_FNC_UWORD 0 CM_RAW 0 65535 MATRIX_DIM 2 1 1 /end CHARACTERISTIC
/begin CHARACTERISTIC CAL_483 "значение #483" VALUE 0x0806266C RL_FNC_UWORD 0 CM_RAW 0 65535 /end CHARACTERISTIC
/begin CHARACTERISTIC CAL_484 "значение #484" VALUE 0x080626B4 RL_FNC_UWORD 0 CM_RAW 0 65535 /end CHARACTERISTIC
/begin CHARACTERISTIC CAL_485 "значение #485" VALUE 0x080626A2 RL_FNC_UWORD 0 CM_RAW 0 65535 /end CHARACTERISTIC
/begin CHARACTERISTIC CAL_486 "значение #486" VALUE 0x080626A4 RL_FNC_SBYTE 0 CM_RAW -128 127 /end CHARACTERISTIC
/begin CHARACTERISTIC CAL_487 "значение #487" VALUE 0x080626AA RL_FNC_UWORD 0 CM_RAW 0 65535 /end CHARACTERISTIC
/begin CHARACTERISTIC CAL_488 "значение #488" VALUE 0x080626A6 RL_FNC_UWORD 0 CM_RAW 0 65535 /end CHARACTERISTIC
/begin CHARACTERISTIC CAL_489 "значение #489" VALUE 0x080626A8 RL_FNC_UWORD 0 CM_RAW 0 65535 /end CHARACTERISTIC
/begin CHARACTERISTIC CAL_48A "массив #48A" VAL_BLK 0x080626AC RL_FNC_UWORD 0 CM_RAW 0 65535 MATRIX_DIM 2 1 1 /end CHARACTERISTIC
/begin CHARACTERISTIC CAL_48B "массив #48B" VAL_BLK 0x080626B0 RL_FNC_UWORD 0 CM_RAW 0 65535 MATRIX_DIM 2 1 1 /end CHARACTERISTIC
/begin CHARACTERISTIC CAL_48C "значение #48C" VALUE 0x08065DC6 RL_FNC_UWORD 0 CM_RAW 0 65535 /end CHARACTERISTIC
/begin CHARACTERISTIC CAL_48D "значение #48D" VALUE 0x080697C4 RL_FNC_UWORD 0 CM_RAW 0 65535 /end CHARACTERISTIC
/begin CHARACTERISTIC CAL_48E "значение #48E" VALUE 0x0806A864 RL_FNC_SBYTE 0 CM_RAW -128 127 /end CHARACTERISTIC
/begin CHARACTERISTIC CAL_48F "значение #48F" VALUE 0x080626B8 RL_FNC_SWORD 0 CM_RAW -32768 32767 /end CHARACTERISTIC
/begin CHARACTERISTIC CAL_490 "кривая #490 10: N" CURVE 0x0807069C RL_FNC_UBYTE 0 CM_RAW 0 255
 /begin AXIS_DESCR COM_AXIS AXIN_00C_N CM_RPM2 10 0 32767.5 AXIS_PTS_REF AX_00C_N /end AXIS_DESCR
/end CHARACTERISTIC
/begin CHARACTERISTIC CAL_491 "значение #491" VALUE 0x0806F94E RL_FNC_UWORD 0 CM_RAW 0 65535 /end CHARACTERISTIC
/begin CHARACTERISTIC CAL_492 "массив #492" VAL_BLK 0x0806F950 RL_FNC_SBYTE 0 CM_RAW -128 127 MATRIX_DIM 2 1 1 /end CHARACTERISTIC
/begin CHARACTERISTIC CAL_493 "значение #493" VALUE 0x0806F952 RL_FNC_UWORD 0 CM_RAW 0 65535 /end CHARACTERISTIC
/begin CHARACTERISTIC CAL_494 "массив #494" VAL_BLK 0x0806F954 RL_FNC_UWORD 0 CM_RAW 0 65535 MATRIX_DIM 2 1 1 /end CHARACTERISTIC
/begin CHARACTERISTIC CAL_495 "массив #495" VAL_BLK 0x0806F958 RL_FNC_UWORD 0 CM_RAW 0 65535 MATRIX_DIM 2 1 1 /end CHARACTERISTIC
/begin CHARACTERISTIC CAL_496 "значение #496" VALUE 0x0806F95D RL_FNC_SBYTE 0 CM_RAW -128 127 /end CHARACTERISTIC
/begin CHARACTERISTIC CAL_497 "значение #497" VALUE 0x0806F95C RL_FNC_SBYTE 0 CM_RAW -128 127 /end CHARACTERISTIC
/begin CHARACTERISTIC CAL_498 "значение #498" VALUE 0x0806F95E RL_FNC_SBYTE 0 CM_RAW -128 127 /end CHARACTERISTIC
/begin CHARACTERISTIC CAL_499 "массив #499" VAL_BLK 0x0806F960 RL_FNC_UWORD 0 CM_RAW 0 65535 MATRIX_DIM 2 1 1 /end CHARACTERISTIC
/begin CHARACTERISTIC CAL_49A "значение #49A" VALUE 0x0806F966 RL_FNC_UWORD 0 CM_RAW 0 65535 /end CHARACTERISTIC
/begin CHARACTERISTIC CAL_49B "значение #49B" VALUE 0x080656DA RL_FNC_UWORD 0 CM_RAW 0 65535 /end CHARACTERISTIC
/begin CHARACTERISTIC CAL_49C "кривая #49C 14: ?" CURVE 0x08061A78 RL_FNC_UWORD 0 CM_RAW 0 65535 /begin AXIS_DESCR COM_AXIS AXIN_081 CM_RAW 14 0 65535 AXIS_PTS_REF AX_081 /end AXIS_DESCR /end CHARACTERISTIC
/begin CHARACTERISTIC CAL_49D "массив #49D [знак по значениям]" VAL_BLK 0x08065698 RL_FNC_SWORD 0 CM_RAW -32768 32767 MATRIX_DIM 2 1 1 /end CHARACTERISTIC
/begin CHARACTERISTIC CAL_49E "массив #49E [знак по значениям]" VAL_BLK 0x0806569C RL_FNC_SWORD 0 CM_RAW -32768 32767 MATRIX_DIM 2 1 1 /end CHARACTERISTIC
/begin CHARACTERISTIC CAL_49F "карта #49F 16x17: ? × TCOOL" MAP 0x080647E0 RL_FNC_UWORD 0 CM_RAW 0 65535 /begin AXIS_DESCR COM_AXIS AXIN_082 CM_RAW 17 0 65535 AXIS_PTS_REF AX_082 /end AXIS_DESCR
 /begin AXIS_DESCR COM_AXIS AXIN_004_TCOOL CM_C128 16 -256 255.992 AXIS_PTS_REF AX_004_TCOOL /end AXIS_DESCR
/end CHARACTERISTIC
/begin CHARACTERISTIC CAL_4A0 "значение #4A0" VALUE 0x080748DC RL_FNC_UWORD 0 CM_RAW 0 65535 /end CHARACTERISTIC
/begin CHARACTERISTIC CAL_4A1 "массив #4A1" VAL_BLK 0x080748E0 RL_FNC_UWORD 0 CM_RAW 0 65535 MATRIX_DIM 2 1 1 /end CHARACTERISTIC
/begin CHARACTERISTIC CAL_4A2 "значение #4A2" VALUE 0x080748E4 RL_FNC_UWORD 0 CM_RAW 0 65535 /end CHARACTERISTIC
/begin CHARACTERISTIC CAL_4A3 "значение #4A3" VALUE 0x080748E6 RL_FNC_SBYTE 0 CM_RAW -128 127 /end CHARACTERISTIC
/begin CHARACTERISTIC CAL_4A4 "карта #4A4 5x14: N × ?" MAP 0x08069800 RL_FNC_UWORD 0 CM_RAW 0 65535
 /begin AXIS_DESCR COM_AXIS AXIN_027_N CM_RPM2 14 0 32767.5 AXIS_PTS_REF AX_027_N /end AXIS_DESCR
 /begin AXIS_DESCR COM_AXIS AXIN_029 CM_RAW 5 0 65535 AXIS_PTS_REF AX_029 /end AXIS_DESCR
/end CHARACTERISTIC
/begin CHARACTERISTIC CAL_4A5 "значение #4A5" VALUE 0x08074975 RL_FNC_SBYTE 0 CM_RAW -128 127 /end CHARACTERISTIC
/begin CHARACTERISTIC CAL_4A6 "кривая #4A6 10: LOAD" CURVE 0x080697EC RL_FNC_UWORD 0 CM_RAW 0 65535
 /begin AXIS_DESCR COM_AXIS AXIN_01E_LOAD CM_RAW 10 0 65535 AXIS_PTS_REF AX_01E_LOAD /end AXIS_DESCR
/end CHARACTERISTIC
/begin CHARACTERISTIC CAL_4A7 "карта #4A7 10x9: TCOOL × N" MAP 0x080684A8 RL_FNC_UWORD 0 CM_RAW 0 65535
 /begin AXIS_DESCR COM_AXIS AXIN_00A_TCOOL CM_C128 9 -256 255.992 AXIS_PTS_REF AX_00A_TCOOL /end AXIS_DESCR
 /begin AXIS_DESCR COM_AXIS AXIN_00C_N CM_RPM2 10 0 32767.5 AXIS_PTS_REF AX_00C_N /end AXIS_DESCR
/end CHARACTERISTIC
/begin CHARACTERISTIC CAL_4A8 "массив #4A8" VAL_BLK 0x08068564 RL_FNC_UBYTE 0 CM_RAW 0 255 MATRIX_DIM 2 1 1 /end CHARACTERISTIC
/begin CHARACTERISTIC CAL_4A9 "кривая #4A9 16: TCOOL" CURVE 0x08068568 RL_FNC_UBYTE 0 CM_RAW 0 255
 /begin AXIS_DESCR COM_AXIS AXIN_004_TCOOL CM_C128 16 -256 255.992 AXIS_PTS_REF AX_004_TCOOL /end AXIS_DESCR
/end CHARACTERISTIC
/begin CHARACTERISTIC CAL_4AA_0 "кривая #4AA 16: TCOOL [1/2]" CURVE 0x08068578 RL_FNC_UBYTE 0 CM_RAW 0 255
 /begin AXIS_DESCR COM_AXIS AXIN_004_TCOOL CM_C128 16 -256 255.992 AXIS_PTS_REF AX_004_TCOOL /end AXIS_DESCR
/end CHARACTERISTIC
/begin CHARACTERISTIC CAL_4AA_1 "кривая #4AA 16: TCOOL [2/2]" CURVE 0x08068588 RL_FNC_UBYTE 0 CM_RAW 0 255
 /begin AXIS_DESCR COM_AXIS AXIN_004_TCOOL CM_C128 16 -256 255.992 AXIS_PTS_REF AX_004_TCOOL /end AXIS_DESCR
/end CHARACTERISTIC
/begin CHARACTERISTIC CAL_4AB "массив #4AB" VAL_BLK 0x08068560 RL_FNC_UBYTE 0 CM_RAW 0 255 MATRIX_DIM 2 1 1 /end CHARACTERISTIC
/begin CHARACTERISTIC CAL_4AC "массив #4AC" VAL_BLK 0x0806855C RL_FNC_UBYTE 0 CM_RAW 0 255 MATRIX_DIM 2 1 1 /end CHARACTERISTIC
/begin CHARACTERISTIC CAL_4AD "массив #4AD" VAL_BLK 0x0806859C RL_FNC_UBYTE 0 CM_RAW 0 255 MATRIX_DIM 2 1 1 /end CHARACTERISTIC
/begin CHARACTERISTIC CAL_4AE_0 "карта #4AE 15x10: N × ? [1/4]" MAP 0x080685A4 RL_FNC_UWORD 0 CM_RAW 0 65535
 /begin AXIS_DESCR COM_AXIS AXIN_0FE_N CM_RPM2 10 0 32767.5 AXIS_PTS_REF AX_0FE_N /end AXIS_DESCR
 /begin AXIS_DESCR COM_AXIS AXIN_006 CM_RAW 15 0 65535 AXIS_PTS_REF AX_006 /end AXIS_DESCR
/end CHARACTERISTIC
/begin CHARACTERISTIC CAL_4AE_1 "карта #4AE 15x10: N × ? [2/4]" MAP 0x080686D0 RL_FNC_UWORD 0 CM_RAW 0 65535
 /begin AXIS_DESCR COM_AXIS AXIN_0FE_N CM_RPM2 10 0 32767.5 AXIS_PTS_REF AX_0FE_N /end AXIS_DESCR
 /begin AXIS_DESCR COM_AXIS AXIN_006 CM_RAW 15 0 65535 AXIS_PTS_REF AX_006 /end AXIS_DESCR
/end CHARACTERISTIC
/begin CHARACTERISTIC CAL_4AE_2 "карта #4AE 15x10: N × ? [3/4]" MAP 0x080687FC RL_FNC_UWORD 0 CM_RAW 0 65535
 /begin AXIS_DESCR COM_AXIS AXIN_0FE_N CM_RPM2 10 0 32767.5 AXIS_PTS_REF AX_0FE_N /end AXIS_DESCR
 /begin AXIS_DESCR COM_AXIS AXIN_006 CM_RAW 15 0 65535 AXIS_PTS_REF AX_006 /end AXIS_DESCR
/end CHARACTERISTIC
/begin CHARACTERISTIC CAL_4AE_3 "карта #4AE 15x10: N × ? [4/4]" MAP 0x08068928 RL_FNC_UWORD 0 CM_RAW 0 65535
 /begin AXIS_DESCR COM_AXIS AXIN_0FE_N CM_RPM2 10 0 32767.5 AXIS_PTS_REF AX_0FE_N /end AXIS_DESCR
 /begin AXIS_DESCR COM_AXIS AXIN_006 CM_RAW 15 0 65535 AXIS_PTS_REF AX_006 /end AXIS_DESCR
/end CHARACTERISTIC
/begin CHARACTERISTIC CAL_4AF_0 "кривая #4AF 17: N [1/2]" CURVE 0x08068A54 RL_FNC_UWORD 0 CM_RAW 0 65535
 /begin AXIS_DESCR COM_AXIS AXIN_001_N CM_RPM2 17 0 32767.5 AXIS_PTS_REF AX_001_N /end AXIS_DESCR
/end CHARACTERISTIC
/begin CHARACTERISTIC CAL_4AF_1 "кривая #4AF 17: N [2/2]" CURVE 0x08068A76 RL_FNC_UWORD 0 CM_RAW 0 65535
 /begin AXIS_DESCR COM_AXIS AXIN_001_N CM_RPM2 17 0 32767.5 AXIS_PTS_REF AX_001_N /end AXIS_DESCR
/end CHARACTERISTIC
/begin CHARACTERISTIC CAL_4B0 "значение #4B0" VALUE 0x0806859E RL_FNC_UWORD 0 CM_RAW 0 65535 /end CHARACTERISTIC
/begin CHARACTERISTIC CAL_4B1 "значение #4B1" VALUE 0x080685A0 RL_FNC_UWORD 0 CM_RAW 0 65535 /end CHARACTERISTIC
/begin CHARACTERISTIC CAL_4B4 "кривая #4B4 6: ?" CURVE 0x08063F40 RL_FNC_SBYTE 0 CM_RAW -128 127 /begin AXIS_DESCR COM_AXIS AXIN_088 CM_RAW 6 0 65535 AXIS_PTS_REF AX_088 /end AXIS_DESCR /end CHARACTERISTIC
/begin CHARACTERISTIC CAL_4B5 "карта #4B5 2x10: ? × ?" MAP 0x08063F4C RL_FNC_SBYTE 0 CM_RAW -128 127 /begin AXIS_DESCR COM_AXIS AXIN_086 CM_RAW 10 0 255 AXIS_PTS_REF AX_086 /end AXIS_DESCR /begin AXIS_DESCR COM_AXIS AXIN_013 CM_RAW 2 0 255 AXIS_PTS_REF AX_013 /end AXIS_DESCR /end CHARACTERISTIC
/begin CHARACTERISTIC CAL_4B6 "массив #4B6" VAL_BLK 0x08063F48 RL_FNC_SBYTE 0 CM_RAW -128 127 MATRIX_DIM 2 1 1 /end CHARACTERISTIC
/begin CHARACTERISTIC CAL_4B7 "карта #4B7 2x10: ? × ?" MAP 0x08063F60 RL_FNC_SBYTE 0 CM_RAW -128 127 /begin AXIS_DESCR COM_AXIS AXIN_086 CM_RAW 10 0 255 AXIS_PTS_REF AX_086 /end AXIS_DESCR /begin AXIS_DESCR COM_AXIS AXIN_013 CM_RAW 2 0 255 AXIS_PTS_REF AX_013 /end AXIS_DESCR /end CHARACTERISTIC
/begin CHARACTERISTIC CAL_4B8 "карта #4B8 2x10: ? × ?" MAP 0x08063F78 RL_FNC_SWORD 0 CM_RAW -32768 32767 /begin AXIS_DESCR COM_AXIS AXIN_086 CM_RAW 10 0 255 AXIS_PTS_REF AX_086 /end AXIS_DESCR /begin AXIS_DESCR COM_AXIS AXIN_013 CM_RAW 2 0 255 AXIS_PTS_REF AX_013 /end AXIS_DESCR /end CHARACTERISTIC
/begin CHARACTERISTIC CAL_4B9 "массив #4B9" VAL_BLK 0x08063FA0 RL_FNC_SBYTE 0 CM_RAW -128 127 MATRIX_DIM 2 1 1 /end CHARACTERISTIC
/begin CHARACTERISTIC CAL_4BA "карта #4BA 2x10: ? × ?" MAP 0x08063FA4 RL_FNC_SBYTE 0 CM_RAW -128 127 /begin AXIS_DESCR COM_AXIS AXIN_086 CM_RAW 10 0 255 AXIS_PTS_REF AX_086 /end AXIS_DESCR /begin AXIS_DESCR COM_AXIS AXIN_013 CM_RAW 2 0 255 AXIS_PTS_REF AX_013 /end AXIS_DESCR /end CHARACTERISTIC
/begin CHARACTERISTIC CAL_4BB "карта #4BB 2x10: ? × ?" MAP 0x08063FB8 RL_FNC_SBYTE 0 CM_RAW -128 127 /begin AXIS_DESCR COM_AXIS AXIN_086 CM_RAW 10 0 255 AXIS_PTS_REF AX_086 /end AXIS_DESCR /begin AXIS_DESCR COM_AXIS AXIN_013 CM_RAW 2 0 255 AXIS_PTS_REF AX_013 /end AXIS_DESCR /end CHARACTERISTIC
/begin CHARACTERISTIC CAL_4BC "массив #4BC" VAL_BLK 0x08063FCC RL_FNC_SBYTE 0 CM_RAW -128 127 MATRIX_DIM 2 1 1 /end CHARACTERISTIC
/begin CHARACTERISTIC CAL_4BD "массив #4BD" VAL_BLK 0x08063ED0 RL_FNC_SBYTE 0 CM_RAW -128 127 MATRIX_DIM 2 1 1 /end CHARACTERISTIC
/begin CHARACTERISTIC CAL_4BE "значение #4BE" VALUE 0x08063ED2 RL_FNC_UBYTE 0 CM_RAW 0 255 /end CHARACTERISTIC
/begin CHARACTERISTIC CAL_4C1 "карта #4C1 2x4: ? × ?" MAP 0x08063ED4 RL_FNC_UBYTE 0 CM_RAW 0 255 /begin AXIS_DESCR COM_AXIS AXIN_084 CM_RAW 4 0 255 AXIS_PTS_REF AX_084 /end AXIS_DESCR /begin AXIS_DESCR COM_AXIS AXIN_013 CM_RAW 2 0 255 AXIS_PTS_REF AX_013 /end AXIS_DESCR /end CHARACTERISTIC
/begin CHARACTERISTIC CAL_4C2 "карта #4C2 2x4: ? × ?" MAP 0x08063EDC RL_FNC_UBYTE 0 CM_RAW 0 255 /begin AXIS_DESCR COM_AXIS AXIN_084 CM_RAW 4 0 255 AXIS_PTS_REF AX_084 /end AXIS_DESCR /begin AXIS_DESCR COM_AXIS AXIN_013 CM_RAW 2 0 255 AXIS_PTS_REF AX_013 /end AXIS_DESCR /end CHARACTERISTIC
/begin CHARACTERISTIC CAL_4C3 "массив #4C3" VAL_BLK 0x08063EE4 RL_FNC_UBYTE 0 CM_RAW 0 255 MATRIX_DIM 2 1 1 /end CHARACTERISTIC
/begin CHARACTERISTIC CAL_4C4 "массив #4C4" VAL_BLK 0x08063EEC RL_FNC_UWORD 0 CM_RAW 0 65535 MATRIX_DIM 2 1 1 /end CHARACTERISTIC
/begin CHARACTERISTIC CAL_4C5 "карта #4C5 2x4: ? × ?" MAP 0x08063EF8 RL_FNC_SBYTE 0 CM_RAW -128 127 /begin AXIS_DESCR COM_AXIS AXIN_084 CM_RAW 4 0 255 AXIS_PTS_REF AX_084 /end AXIS_DESCR /begin AXIS_DESCR COM_AXIS AXIN_013 CM_RAW 2 0 255 AXIS_PTS_REF AX_013 /end AXIS_DESCR /end CHARACTERISTIC
/begin CHARACTERISTIC CAL_4C6 "карта #4C6 2x2: ? × ? [знак по значениям]" MAP 0x08063F00 RL_FNC_SWORD 0 CM_RAW -32768 32767 /begin AXIS_DESCR COM_AXIS AXIN_087 CM_RAW 2 -128 127 AXIS_PTS_REF AX_087 /end AXIS_DESCR /begin AXIS_DESCR COM_AXIS AXIN_013 CM_RAW 2 0 255 AXIS_PTS_REF AX_013 /end AXIS_DESCR /end CHARACTERISTIC
/begin CHARACTERISTIC CAL_4C7 "массив #4C7" VAL_BLK 0x08063F08 RL_FNC_SBYTE 0 CM_RAW -128 127 MATRIX_DIM 2 1 1 /end CHARACTERISTIC
/begin CHARACTERISTIC CAL_4C8 "массив #4C8" VAL_BLK 0x08063F0C RL_FNC_SBYTE 0 CM_RAW -128 127 MATRIX_DIM 2 1 1 /end CHARACTERISTIC
/begin CHARACTERISTIC CAL_4C9 "массив #4C9" VAL_BLK 0x08063F10 RL_FNC_SBYTE 0 CM_RAW -128 127 MATRIX_DIM 2 1 1 /end CHARACTERISTIC
/begin CHARACTERISTIC CAL_4CA "карта #4CA 2x4: ? × ?" MAP 0x08063F14 RL_FNC_UBYTE 0 CM_RAW 0 255 /begin AXIS_DESCR COM_AXIS AXIN_084 CM_RAW 4 0 255 AXIS_PTS_REF AX_084 /end AXIS_DESCR /begin AXIS_DESCR COM_AXIS AXIN_013 CM_RAW 2 0 255 AXIS_PTS_REF AX_013 /end AXIS_DESCR /end CHARACTERISTIC
/begin CHARACTERISTIC CAL_4CB "карта #4CB 2x4: ? × ?" MAP 0x08063F1C RL_FNC_UBYTE 0 CM_RAW 0 255 /begin AXIS_DESCR COM_AXIS AXIN_084 CM_RAW 4 0 255 AXIS_PTS_REF AX_084 /end AXIS_DESCR /begin AXIS_DESCR COM_AXIS AXIN_013 CM_RAW 2 0 255 AXIS_PTS_REF AX_013 /end AXIS_DESCR /end CHARACTERISTIC
/begin CHARACTERISTIC CAL_4CC "массив #4CC" VAL_BLK 0x08063F24 RL_FNC_UWORD 0 CM_RAW 0 65535 MATRIX_DIM 2 1 1 /end CHARACTERISTIC
/begin CHARACTERISTIC CAL_4CD "карта #4CD 2x4: ? × ?" MAP 0x08063F28 RL_FNC_SBYTE 0 CM_RAW -128 127 /begin AXIS_DESCR COM_AXIS AXIN_084 CM_RAW 4 0 255 AXIS_PTS_REF AX_084 /end AXIS_DESCR /begin AXIS_DESCR COM_AXIS AXIN_013 CM_RAW 2 0 255 AXIS_PTS_REF AX_013 /end AXIS_DESCR /end CHARACTERISTIC
/begin CHARACTERISTIC CAL_4CE "карта #4CE 2x4: ? × ?" MAP 0x08063F30 RL_FNC_SBYTE 0 CM_RAW -128 127 /begin AXIS_DESCR COM_AXIS AXIN_084 CM_RAW 4 0 255 AXIS_PTS_REF AX_084 /end AXIS_DESCR /begin AXIS_DESCR COM_AXIS AXIN_013 CM_RAW 2 0 255 AXIS_PTS_REF AX_013 /end AXIS_DESCR /end CHARACTERISTIC
/begin CHARACTERISTIC CAL_4CF "массив #4CF" VAL_BLK 0x08063F38 RL_FNC_SBYTE 0 CM_RAW -128 127 MATRIX_DIM 2 1 1 /end CHARACTERISTIC
/begin CHARACTERISTIC CAL_4D1 "массив #4D1" VAL_BLK 0x08063F3C RL_FNC_SBYTE 0 CM_RAW -128 127 MATRIX_DIM 2 1 1 /end CHARACTERISTIC
/begin CHARACTERISTIC CAL_4D2 "значение #4D2" VALUE 0x08063E22 RL_FNC_SWORD 0 CM_RAW -32768 32767 /end CHARACTERISTIC
/begin CHARACTERISTIC CAL_4D3 "массив #4D3" VAL_BLK 0x08063E90 RL_FNC_SBYTE 0 CM_RAW -128 127 MATRIX_DIM 2 1 1 /end CHARACTERISTIC
/begin CHARACTERISTIC CAL_4D4 "массив #4D4" VAL_BLK 0x08063E94 RL_FNC_SBYTE 0 CM_RAW -128 127 MATRIX_DIM 2 1 1 /end CHARACTERISTIC
/begin CHARACTERISTIC CAL_4D5 "карта #4D5 2x10: ? × ?" MAP 0x08063EA4 RL_FNC_UWORD 0 CM_RAW 0 65535 /begin AXIS_DESCR COM_AXIS AXIN_086 CM_RAW 10 0 255 AXIS_PTS_REF AX_086 /end AXIS_DESCR /begin AXIS_DESCR COM_AXIS AXIN_013 CM_RAW 2 0 255 AXIS_PTS_REF AX_013 /end AXIS_DESCR /end CHARACTERISTIC
/begin CHARACTERISTIC CAL_4D6 "массив #4D6" VAL_BLK 0x08063ECC RL_FNC_SBYTE 0 CM_RAW -128 127 MATRIX_DIM 2 1 1 /end CHARACTERISTIC
/begin CHARACTERISTIC CAL_4DC "значение #4DC" VALUE 0x08063E92 RL_FNC_SBYTE 0 CM_RAW -128 127 /end CHARACTERISTIC
/begin CHARACTERISTIC CAL_4DD "кривая #4DD 6: ?" CURVE 0x08063E98 RL_FNC_SWORD 0 CM_RAW -32768 32767 /begin AXIS_DESCR COM_AXIS AXIN_088 CM_RAW 6 0 65535 AXIS_PTS_REF AX_088 /end AXIS_DESCR /end CHARACTERISTIC
/begin CHARACTERISTIC CAL_4E3 "значение #4E3" VALUE 0x08063E76 RL_FNC_UWORD 0 CM_RAW 0 65535 /end CHARACTERISTIC
/begin CHARACTERISTIC CAL_4E4 "массив #4E4" VAL_BLK 0x08063E78 RL_FNC_UWORD 0 CM_RAW 0 65535 MATRIX_DIM 2 1 1 /end CHARACTERISTIC
/begin CHARACTERISTIC CAL_4E5 "массив #4E5" VAL_BLK 0x08063E7C RL_FNC_UWORD 0 CM_RAW 0 65535 MATRIX_DIM 2 1 1 /end CHARACTERISTIC
/begin CHARACTERISTIC CAL_4E6 "значение #4E6" VALUE 0x08063E80 RL_FNC_UWORD 0 CM_RAW 0 65535 /end CHARACTERISTIC
/begin CHARACTERISTIC CAL_4E7 "массив #4E7" VAL_BLK 0x08063E84 RL_FNC_SBYTE 0 CM_RAW -128 127 MATRIX_DIM 2 1 1 /end CHARACTERISTIC
/begin CHARACTERISTIC CAL_4E8 "значение #4E8" VALUE 0x08063E86 RL_FNC_UWORD 0 CM_RAW 0 65535 /end CHARACTERISTIC
/begin CHARACTERISTIC CAL_4E9 "значение #4E9" VALUE 0x08063E88 RL_FNC_SBYTE 0 CM_RAW -128 127 /end CHARACTERISTIC
/begin CHARACTERISTIC CAL_4EA "массив #4EA" VAL_BLK 0x08063E8C RL_FNC_SBYTE 0 CM_RAW -128 127 MATRIX_DIM 2 1 1 /end CHARACTERISTIC
/begin CHARACTERISTIC CAL_4EB "значение #4EB" VALUE 0x08074971 RL_FNC_SBYTE 0 CM_RAW -128 127 /end CHARACTERISTIC
/begin CHARACTERISTIC CAL_4EC "кривая #4EC 16: TCOOL" CURVE 0x08074704 RL_FNC_UWORD 0 CM_RAW 0 65535
 /begin AXIS_DESCR COM_AXIS AXIN_004_TCOOL CM_C128 16 -256 255.992 AXIS_PTS_REF AX_004_TCOOL /end AXIS_DESCR
/end CHARACTERISTIC
/begin CHARACTERISTIC CAL_4ED "карта #4ED 8x8: LOAD × TCOOL" MAP 0x08066AA8 RL_FNC_UWORD 0 CM_RAW 0 65535
 /begin AXIS_DESCR COM_AXIS AXIN_089_LOAD CM_RAW 8 0 65535 AXIS_PTS_REF AX_089_LOAD /end AXIS_DESCR
 /begin AXIS_DESCR COM_AXIS AXIN_08A_TCOOL CM_C128 8 -256 255.992 AXIS_PTS_REF AX_08A_TCOOL /end AXIS_DESCR
/end CHARACTERISTIC
/begin CHARACTERISTIC CAL_4EE "массив #4EE" VAL_BLK 0x080748F8 RL_FNC_SWORD 0 CM_RAW -32768 32767 MATRIX_DIM 2 1 1 /end CHARACTERISTIC
/begin CHARACTERISTIC CAL_4EF "значение #4EF" VALUE 0x080644DA RL_FNC_UWORD 0 CM_RAW 0 65535 /end CHARACTERISTIC
/begin CHARACTERISTIC CAL_4F0 "значение #4F0" VALUE 0x080644D8 RL_FNC_SBYTE 0 CM_RAW -128 127 /end CHARACTERISTIC
/begin CHARACTERISTIC CAL_4F1 "значение #4F1" VALUE 0x08063ECE RL_FNC_SBYTE 0 CM_RAW -128 127 /end CHARACTERISTIC
/begin CHARACTERISTIC CAL_4F2 "значение #4F2" VALUE 0x0806E7D3 RL_FNC_SBYTE 0 CM_RAW -128 127 /end CHARACTERISTIC
/begin CHARACTERISTIC CAL_4F3 "массив #4F3" VAL_BLK 0x0806D2C0 RL_FNC_UWORD 0 CM_RAW 0 65535 MATRIX_DIM 2 1 1 /end CHARACTERISTIC
/begin CHARACTERISTIC CAL_4F4 "массив #4F4" VAL_BLK 0x0806D2C4 RL_FNC_UWORD 0 CM_RAW 0 65535 MATRIX_DIM 2 1 1 /end CHARACTERISTIC
/begin CHARACTERISTIC CAL_4F5 "массив #4F5" VAL_BLK 0x0806D2C8 RL_FNC_UWORD 0 CM_RAW 0 65535 MATRIX_DIM 2 1 1 /end CHARACTERISTIC
/begin CHARACTERISTIC CAL_4F6 "массив #4F6" VAL_BLK 0x0806D2CC RL_FNC_UWORD 0 CM_RAW 0 65535 MATRIX_DIM 2 1 1 /end CHARACTERISTIC
/begin CHARACTERISTIC CAL_4F7 "массив #4F7" VAL_BLK 0x0806D2DC RL_FNC_UWORD 0 CM_RAW 0 65535 MATRIX_DIM 5 1 1 /end CHARACTERISTIC
/begin CHARACTERISTIC CAL_4F8 "значение #4F8" VALUE 0x0806D2E6 RL_FNC_SWORD 0 CM_RAW -32768 32767 /end CHARACTERISTIC
/begin CHARACTERISTIC CAL_4F9 "массив #4F9" VAL_BLK 0x0806D2E8 RL_FNC_UWORD 0 CM_RAW 0 65535 MATRIX_DIM 4 1 1 /end CHARACTERISTIC
/begin CHARACTERISTIC CAL_4FA "значение #4FA" VALUE 0x0806D2F0 RL_FNC_UWORD 0 CM_RAW 0 65535 /end CHARACTERISTIC
/begin CHARACTERISTIC CAL_4FB "значение #4FB" VALUE 0x0806D2F2 RL_FNC_UWORD 0 CM_RAW 0 65535 /end CHARACTERISTIC
/begin CHARACTERISTIC CAL_4FC "значение #4FC" VALUE 0x0806D2DA RL_FNC_SBYTE 0 CM_RAW -128 127 /end CHARACTERISTIC
/begin CHARACTERISTIC CAL_4FD "значение #4FD" VALUE 0x0806D2D0 RL_FNC_UWORD 0 CM_RAW 0 65535 /end CHARACTERISTIC
/begin CHARACTERISTIC CAL_4FE "значение #4FE" VALUE 0x08065364 RL_FNC_SBYTE 0 CM_RAW -128 127 /end CHARACTERISTIC
/begin CHARACTERISTIC CAL_4FF "значение #4FF" VALUE 0x08069D5C RL_FNC_UWORD 0 CM_RAW 0 65535 /end CHARACTERISTIC
/begin CHARACTERISTIC CAL_500 "массив #500" VAL_BLK 0x0806A29C RL_FNC_UWORD 0 CM_RAW 0 65535 MATRIX_DIM 2 1 1 /end CHARACTERISTIC
/begin CHARACTERISTIC CAL_501 "кривая #501 10: N" CURVE 0x08070684 RL_FNC_UWORD 0 CM_RAW 0 65535
 /begin AXIS_DESCR COM_AXIS AXIN_00C_N CM_RPM2 10 0 32767.5 AXIS_PTS_REF AX_00C_N /end AXIS_DESCR
/end CHARACTERISTIC
/begin CHARACTERISTIC CAL_502 "значение #502" VALUE 0x080654FE RL_FNC_UWORD 0 CM_RAW 0 65535 /end CHARACTERISTIC
/begin CHARACTERISTIC CAL_503 "значение #503" VALUE 0x08065500 RL_FNC_UWORD 0 CM_RAW 0 65535 /end CHARACTERISTIC
/begin CHARACTERISTIC CAL_504 "значение #504" VALUE 0x08065502 RL_FNC_SBYTE 0 CM_RAW -128 127 /end CHARACTERISTIC
/begin CHARACTERISTIC CAL_505 "значение #505" VALUE 0x0806550A RL_FNC_UWORD 0 CM_RAW 0 65535 /end CHARACTERISTIC
/begin CHARACTERISTIC CAL_506 "массив #506" VAL_BLK 0x08065504 RL_FNC_UWORD 0 CM_RAW 0 65535 MATRIX_DIM 3 1 1 /end CHARACTERISTIC
/begin CHARACTERISTIC CAL_507 "значение #507" VALUE 0x0806550C RL_FNC_SWORD 0 CM_RAW -32768 32767 /end CHARACTERISTIC
/begin CHARACTERISTIC CAL_508 "массив #508" VAL_BLK 0x08065510 RL_FNC_UWORD 0 CM_RAW 0 65535 MATRIX_DIM 2 1 1 /end CHARACTERISTIC
/begin CHARACTERISTIC CAL_509 "значение #509" VALUE 0x08065514 RL_FNC_SBYTE 0 CM_RAW -128 127 /end CHARACTERISTIC
/begin CHARACTERISTIC CAL_50A "массив #50A" VAL_BLK 0x08065518 RL_FNC_UWORD 0 CM_RAW 0 65535 MATRIX_DIM 3 1 1 /end CHARACTERISTIC
/begin CHARACTERISTIC CAL_50B "массив #50B" VAL_BLK 0x08065520 RL_FNC_SWORD 0 CM_RAW -32768 32767 MATRIX_DIM 3 1 1 /end CHARACTERISTIC
/begin CHARACTERISTIC CAL_50C "значение #50C" VALUE 0x08065526 RL_FNC_UWORD 0 CM_RAW 0 65535 /end CHARACTERISTIC
/begin CHARACTERISTIC CAL_50E "значение #50E" VALUE 0x0807487C RL_FNC_SBYTE 0 CM_RAW -128 127 /end CHARACTERISTIC
/begin CHARACTERISTIC CAL_50F_0 "кривая #50F 9: TCOOL [1/2] [знак по значениям]" CURVE 0x08074880 RL_FNC_SWORD 0 CM_RAW -32768 32767
 /begin AXIS_DESCR COM_AXIS AXIN_00A_TCOOL CM_C128 9 -256 255.992 AXIS_PTS_REF AX_00A_TCOOL /end AXIS_DESCR
/end CHARACTERISTIC
/begin CHARACTERISTIC CAL_50F_1 "кривая #50F 9: TCOOL [2/2] [знак по значениям]" CURVE 0x08074892 RL_FNC_SWORD 0 CM_RAW -32768 32767
 /begin AXIS_DESCR COM_AXIS AXIN_00A_TCOOL CM_C128 9 -256 255.992 AXIS_PTS_REF AX_00A_TCOOL /end AXIS_DESCR
/end CHARACTERISTIC
/begin CHARACTERISTIC CAL_510 "массив #510" VAL_BLK 0x080748A4 RL_FNC_UWORD 0 CM_RAW 0 65535 MATRIX_DIM 2 1 1 /end CHARACTERISTIC
/begin CHARACTERISTIC CAL_511 "массив #511" VAL_BLK 0x080748A8 RL_FNC_UWORD 0 CM_RAW 0 65535 MATRIX_DIM 2 1 1 /end CHARACTERISTIC
/begin CHARACTERISTIC CAL_512 "массив #512" VAL_BLK 0x080748AC RL_FNC_UWORD 0 CM_RAW 0 65535 MATRIX_DIM 2 1 1 /end CHARACTERISTIC
/begin CHARACTERISTIC CAL_513 "значение #513" VALUE 0x080748B0 RL_FNC_UWORD 0 CM_RAW 0 65535 /end CHARACTERISTIC
/begin CHARACTERISTIC CAL_514 "значение #514" VALUE 0x080748B2 RL_FNC_UWORD 0 CM_RAW 0 65535 /end CHARACTERISTIC
/begin CHARACTERISTIC CAL_515 "значение #515" VALUE 0x08074974 RL_FNC_SBYTE 0 CM_RAW -128 127 /end CHARACTERISTIC
/begin CHARACTERISTIC CAL_516 "кривая #516 9: TCOOL" CURVE 0x0806ABCC RL_FNC_UWORD 0 CM_RAW 0 65535
 /begin AXIS_DESCR COM_AXIS AXIN_00A_TCOOL CM_C128 9 -256 255.992 AXIS_PTS_REF AX_00A_TCOOL /end AXIS_DESCR
/end CHARACTERISTIC
/begin CHARACTERISTIC CAL_517 "кривая #517 8: TAIR" CURVE 0x0806ABE0 RL_FNC_UWORD 0 CM_RAW 0 65535
 /begin AXIS_DESCR COM_AXIS AXIN_049_TAIR CM_C128 8 -256 255.992 AXIS_PTS_REF AX_049_TAIR /end AXIS_DESCR
/end CHARACTERISTIC
/begin CHARACTERISTIC CAL_518 "значение #518" VALUE 0x0806B0CE RL_FNC_UWORD 0 CM_RAW 0 65535 /end CHARACTERISTIC
/begin CHARACTERISTIC CAL_519 "значение #519" VALUE 0x08074979 RL_FNC_SBYTE 0 CM_RAW -128 127 /end CHARACTERISTIC
/begin CHARACTERISTIC CAL_51A "значение #51A" VALUE 0x0806F91A RL_FNC_SBYTE 0 CM_RAW -128 127 /end CHARACTERISTIC
/begin CHARACTERISTIC CAL_51B "значение #51B" VALUE 0x08062E64 RL_FNC_SBYTE 0 CM_RAW -128 127 /end CHARACTERISTIC
/begin CHARACTERISTIC CAL_51C "значение #51C" VALUE 0x08062CCC RL_FNC_UWORD 0 CM_RAW 0 65535 /end CHARACTERISTIC
/begin CHARACTERISTIC CAL_51D "кривая #51D 10: N" CURVE 0x08062C88 RL_FNC_UWORD 0 CM_RAW 0 65535
 /begin AXIS_DESCR COM_AXIS AXIN_00C_N CM_RPM2 10 0 32767.5 AXIS_PTS_REF AX_00C_N /end AXIS_DESCR
/end CHARACTERISTIC
/begin CHARACTERISTIC CAL_51F "значение #51F" VALUE 0x080654B7 RL_FNC_SBYTE 0 CM_RAW -128 127 /end CHARACTERISTIC
/begin CHARACTERISTIC CAL_520 "карта #520 3x9: ? × ?" MAP 0x0806549C RL_FNC_SBYTE 0 CM_RAW -128 127 /begin AXIS_DESCR COM_AXIS AXIN_070 CM_RAW 9 -128 127 AXIS_PTS_REF AX_070 /end AXIS_DESCR /begin AXIS_DESCR COM_AXIS AXIN_094 CM_RAW 3 -128 127 AXIS_PTS_REF AX_094 /end AXIS_DESCR /end CHARACTERISTIC
/begin CHARACTERISTIC CAL_521 "карта #521 3x6: ? × ?" MAP 0x080654B8 RL_FNC_SBYTE 0 CM_RAW -128 127 /begin AXIS_DESCR COM_AXIS AXIN_071 CM_RAW 6 -128 127 AXIS_PTS_REF AX_071 /end AXIS_DESCR /begin AXIS_DESCR COM_AXIS AXIN_094 CM_RAW 3 -128 127 AXIS_PTS_REF AX_094 /end AXIS_DESCR /end CHARACTERISTIC
/begin CHARACTERISTIC CAL_523 "значение #523" VALUE 0x080654EB RL_FNC_SBYTE 0 CM_RAW -128 127 /end CHARACTERISTIC
/begin CHARACTERISTIC CAL_524 "карта #524 3x9: ? × ?" MAP 0x080654D0 RL_FNC_SBYTE 0 CM_RAW -128 127 /begin AXIS_DESCR COM_AXIS AXIN_070 CM_RAW 9 -128 127 AXIS_PTS_REF AX_070 /end AXIS_DESCR /begin AXIS_DESCR COM_AXIS AXIN_095 CM_RAW 3 -128 127 AXIS_PTS_REF AX_095 /end AXIS_DESCR /end CHARACTERISTIC
/begin CHARACTERISTIC CAL_525 "карта #525 3x6: ? × ?" MAP 0x080654EC RL_FNC_SBYTE 0 CM_RAW -128 127 /begin AXIS_DESCR COM_AXIS AXIN_071 CM_RAW 6 -128 127 AXIS_PTS_REF AX_071 /end AXIS_DESCR /begin AXIS_DESCR COM_AXIS AXIN_095 CM_RAW 3 -128 127 AXIS_PTS_REF AX_095 /end AXIS_DESCR /end CHARACTERISTIC
/begin CHARACTERISTIC CAL_526 "значение #526" VALUE 0x080653A6 RL_FNC_UWORD 0 CM_RAW 0 65535 /end CHARACTERISTIC
/begin CHARACTERISTIC CAL_527 "значение #527" VALUE 0x080653A4 RL_FNC_UWORD 0 CM_RAW 0 65535 /end CHARACTERISTIC
/begin CHARACTERISTIC CAL_528 "значение #528" VALUE 0x080653B6 RL_FNC_UWORD 0 CM_RAW 0 65535 /end CHARACTERISTIC
/begin CHARACTERISTIC CAL_529 "значение #529" VALUE 0x080653B8 RL_FNC_UWORD 0 CM_RAW 0 65535 /end CHARACTERISTIC
/begin CHARACTERISTIC CAL_52A "значение #52A" VALUE 0x080653BA RL_FNC_UWORD 0 CM_RAW 0 65535 /end CHARACTERISTIC
/begin CHARACTERISTIC CAL_52B "значение #52B" VALUE 0x0806539E RL_FNC_SBYTE 0 CM_RAW -128 127 /end CHARACTERISTIC
/begin CHARACTERISTIC CAL_52C "значение #52C" VALUE 0x080653A0 RL_FNC_UWORD 0 CM_RAW 0 65535 /end CHARACTERISTIC
/begin CHARACTERISTIC CAL_52D "массив #52D" VAL_BLK 0x080653AC RL_FNC_UWORD 0 CM_RAW 0 65535 MATRIX_DIM 5 1 1 /end CHARACTERISTIC
/begin CHARACTERISTIC CAL_52E "значение #52E" VALUE 0x0806539C RL_FNC_UWORD 0 CM_RAW 0 65535 /end CHARACTERISTIC
/begin CHARACTERISTIC CAL_52F "кривая #52F 8: N" CURVE 0x08074984 RL_FNC_UWORD 0 CM_RAW 0 65535
 /begin AXIS_DESCR COM_AXIS AXIN_050_N CM_RPM2 8 0 32767.5 AXIS_PTS_REF AX_050_N /end AXIS_DESCR
/end CHARACTERISTIC
/begin CHARACTERISTIC CAL_530 "значение #530" VALUE 0x080653A2 RL_FNC_UWORD 0 CM_RAW 0 65535 /end CHARACTERISTIC
/begin CHARACTERISTIC CAL_531 "значение #531" VALUE 0x0806539A RL_FNC_UWORD 0 CM_RAW 0 65535 /end CHARACTERISTIC
/begin CHARACTERISTIC CAL_532 "значение #532" VALUE 0x080653A8 RL_FNC_UWORD 0 CM_RAW 0 65535 /end CHARACTERISTIC
/begin CHARACTERISTIC CAL_534 "карта #534 4x9: ? × ?" MAP 0x08065458 RL_FNC_SBYTE 0 CM_RAW -128 127 /begin AXIS_DESCR COM_AXIS AXIN_070 CM_RAW 9 -128 127 AXIS_PTS_REF AX_070 /end AXIS_DESCR /begin AXIS_DESCR COM_AXIS AXIN_096 CM_RAW 4 -128 127 AXIS_PTS_REF AX_096 /end AXIS_DESCR /end CHARACTERISTIC
/begin CHARACTERISTIC CAL_535 "значение #535" VALUE 0x0806547C RL_FNC_SBYTE 0 CM_RAW -128 127 /end CHARACTERISTIC
/begin CHARACTERISTIC CAL_536 "карта #536 4x6: ? × ?" MAP 0x08065480 RL_FNC_SBYTE 0 CM_RAW -128 127 /begin AXIS_DESCR COM_AXIS AXIN_071 CM_RAW 6 -128 127 AXIS_PTS_REF AX_071 /end AXIS_DESCR /begin AXIS_DESCR COM_AXIS AXIN_096 CM_RAW 4 -128 127 AXIS_PTS_REF AX_096 /end AXIS_DESCR /end CHARACTERISTIC
/begin CHARACTERISTIC CAL_537 "значение #537" VALUE 0x0806997A RL_FNC_SBYTE 0 CM_RAW -128 127 /end CHARACTERISTIC
/begin CHARACTERISTIC CAL_538 "значение #538" VALUE 0x0806A49A RL_FNC_UWORD 0 CM_RAW 0 65535 /end CHARACTERISTIC
/begin CHARACTERISTIC CAL_539 "карта #539 9x14: N × LOAD" MAP 0x0806A664 RL_FNC_UWORD 0 CM_RAW 0 65535
 /begin AXIS_DESCR COM_AXIS AXIN_027_N CM_RPM2 14 0 32767.5 AXIS_PTS_REF AX_027_N /end AXIS_DESCR
 /begin AXIS_DESCR COM_AXIS AXIN_039_LOAD CM_RAW 9 0 65535 AXIS_PTS_REF AX_039_LOAD /end AXIS_DESCR
/end CHARACTERISTIC
/begin CHARACTERISTIC CAL_53A "карта #53A 9x14: N × LOAD" MAP 0x0806A768 RL_FNC_UWORD 0 CM_RAW 0 65535
 /begin AXIS_DESCR COM_AXIS AXIN_027_N CM_RPM2 14 0 32767.5 AXIS_PTS_REF AX_027_N /end AXIS_DESCR
 /begin AXIS_DESCR COM_AXIS AXIN_039_LOAD CM_RAW 9 0 65535 AXIS_PTS_REF AX_039_LOAD /end AXIS_DESCR
/end CHARACTERISTIC
/begin CHARACTERISTIC CAL_53B "значение #53B" VALUE 0x0806A865 RL_FNC_SBYTE 0 CM_RAW -128 127 /end CHARACTERISTIC
/begin CHARACTERISTIC CAL_53C "карта #53C 9x14: N × LOAD" MAP 0x0806A2A0 RL_FNC_UWORD 0 CM_RAW 0 65535
 /begin AXIS_DESCR COM_AXIS AXIN_027_N CM_RPM2 14 0 32767.5 AXIS_PTS_REF AX_027_N /end AXIS_DESCR
 /begin AXIS_DESCR COM_AXIS AXIN_039_LOAD CM_RAW 9 0 65535 AXIS_PTS_REF AX_039_LOAD /end AXIS_DESCR
/end CHARACTERISTIC
/begin CHARACTERISTIC CAL_53E "значение #53E" VALUE 0x080675FC RL_FNC_UWORD 0 CM_RAW 0 65535 /end CHARACTERISTIC
/begin CHARACTERISTIC CAL_53F "кривая #53F 10: ?" CURVE 0x0806635C RL_FNC_UWORD 0 CM_RAW 0 65535 /begin AXIS_DESCR COM_AXIS AXIN_097 CM_RAW 10 0 65535 AXIS_PTS_REF AX_097 /end AXIS_DESCR /end CHARACTERISTIC
/begin CHARACTERISTIC CAL_540 "карта #540 10x12: LOAD × N" MAP 0x08066370 RL_FNC_UWORD 0 CM_RAW 0 65535
 /begin AXIS_DESCR COM_AXIS AXIN_07F_LOAD CM_RAW 12 0 65535 AXIS_PTS_REF AX_07F_LOAD /end AXIS_DESCR
 /begin AXIS_DESCR COM_AXIS AXIN_00C_N CM_RPM2 10 0 32767.5 AXIS_PTS_REF AX_00C_N /end AXIS_DESCR
/end CHARACTERISTIC
/begin CHARACTERISTIC CAL_541 "значение #541" VALUE 0x08074980 RL_FNC_SBYTE 0 CM_RAW -128 127 /end CHARACTERISTIC
/begin CHARACTERISTIC CAL_542 "карта #542 7x10: N × ?" MAP 0x08067544 RL_FNC_UWORD 0 CM_RAW 0 65535
 /begin AXIS_DESCR COM_AXIS AXIN_00C_N CM_RPM2 10 0 32767.5 AXIS_PTS_REF AX_00C_N /end AXIS_DESCR
 /begin AXIS_DESCR COM_AXIS AXIN_036 CM_RAW 7 0 65535 AXIS_PTS_REF AX_036 /end AXIS_DESCR
/end CHARACTERISTIC
/begin CHARACTERISTIC CAL_543 "значение #543" VALUE 0x0806753C RL_FNC_UWORD 0 CM_RAW 0 65535 /end CHARACTERISTIC
/begin CHARACTERISTIC CAL_544 "массив #544 [знак по значениям]" VAL_BLK 0x08067540 RL_FNC_SWORD 0 CM_RAW -32768 32767 MATRIX_DIM 2 1 1 /end CHARACTERISTIC
/begin CHARACTERISTIC CAL_545 "карта #545 16x24: N × ?" MAP 0x08065064 RL_FNC_UWORD 0 CM_RAW 0 65535
 /begin AXIS_DESCR COM_AXIS AXIN_0CD_N CM_RPM2 24 0 32767.5 AXIS_PTS_REF AX_0CD_N /end AXIS_DESCR
 /begin AXIS_DESCR COM_AXIS AXIN_00F CM_RAW 16 0 65535 AXIS_PTS_REF AX_00F /end AXIS_DESCR
/end CHARACTERISTIC
/begin CHARACTERISTIC CAL_546 "карта #546 9x24: N × ?" MAP 0x08064A04 RL_FNC_UWORD 0 CM_RAW 0 65535
 /begin AXIS_DESCR COM_AXIS AXIN_005_N CM_RPM2 24 0 32767.5 AXIS_PTS_REF AX_005_N /end AXIS_DESCR
 /begin AXIS_DESCR COM_AXIS AXIN_00B CM_RAW 9 0 65535 AXIS_PTS_REF AX_00B /end AXIS_DESCR
/end CHARACTERISTIC
/begin CHARACTERISTIC CAL_547 "значение #547" VALUE 0x08074999 RL_FNC_SBYTE 0 CM_RAW -128 127 /end CHARACTERISTIC
/begin CHARACTERISTIC CAL_548 "массив #548" VAL_BLK 0x080694B4 RL_FNC_UWORD 0 CM_RAW 0 65535 MATRIX_DIM 2 1 1 /end CHARACTERISTIC
/begin CHARACTERISTIC CAL_549 "массив #549" VAL_BLK 0x080694BC RL_FNC_UWORD 0 CM_RAW 0 65535 MATRIX_DIM 2 1 1 /end CHARACTERISTIC
/begin CHARACTERISTIC CAL_54A "карта #54A 9x24: N × LOAD" MAP 0x0806A49C RL_FNC_SBYTE 0 CM_RAW -128 127
 /begin AXIS_DESCR COM_AXIS AXIN_03A_N CM_RPM2 24 0 32767.5 AXIS_PTS_REF AX_03A_N /end AXIS_DESCR
 /begin AXIS_DESCR COM_AXIS AXIN_039_LOAD CM_RAW 9 0 65535 AXIS_PTS_REF AX_039_LOAD /end AXIS_DESCR
/end CHARACTERISTIC
/begin CHARACTERISTIC CAL_54B "значение #54B" VALUE 0x0806EAE2 RL_FNC_UWORD 0 CM_RAW 0 65535 /end CHARACTERISTIC
/begin CHARACTERISTIC CAL_54C "значение #54C" VALUE 0x0807496F RL_FNC_SBYTE 0 CM_RAW -128 127 /end CHARACTERISTIC
/begin CHARACTERISTIC CAL_54E "кривая #54E 2: ?" CURVE 0x080703BC RL_FNC_UWORD 0 CM_RAW 0 65535 /begin AXIS_DESCR COM_AXIS AXIN_099 CM_RAW 2 0 65535 AXIS_PTS_REF AX_099 /end AXIS_DESCR /end CHARACTERISTIC
/begin CHARACTERISTIC CAL_54F "значение #54F" VALUE 0x080703C2 RL_FNC_UWORD 0 CM_RAW 0 65535 /end CHARACTERISTIC
/begin CHARACTERISTIC CAL_550 "значение #550" VALUE 0x080703C0 RL_FNC_UWORD 0 CM_RAW 0 65535 /end CHARACTERISTIC
/begin CHARACTERISTIC CAL_551 "карта #551 10x8: N × LOAD" MAP 0x080628A8 RL_FNC_UWORD 0 CM_RAW 0 65535
 /begin AXIS_DESCR COM_AXIS AXIN_04B_N CM_RPM2 8 0 32767.5 AXIS_PTS_REF AX_04B_N /end AXIS_DESCR
 /begin AXIS_DESCR COM_AXIS AXIN_04C_LOAD CM_RAW 10 0 65535 AXIS_PTS_REF AX_04C_LOAD /end AXIS_DESCR
/end CHARACTERISTIC
/begin CHARACTERISTIC CAL_552 "карта #552 10x8: N × LOAD" MAP 0x08062948 RL_FNC_UWORD 0 CM_RAW 0 65535
 /begin AXIS_DESCR COM_AXIS AXIN_04B_N CM_RPM2 8 0 32767.5 AXIS_PTS_REF AX_04B_N /end AXIS_DESCR
 /begin AXIS_DESCR COM_AXIS AXIN_04C_LOAD CM_RAW 10 0 65535 AXIS_PTS_REF AX_04C_LOAD /end AXIS_DESCR
/end CHARACTERISTIC
/begin CHARACTERISTIC CAL_553 "значение #553" VALUE 0x080628A4 RL_FNC_UWORD 0 CM_RAW 0 65535 /end CHARACTERISTIC
/begin CHARACTERISTIC CAL_554 "значение #554" VALUE 0x080628A6 RL_FNC_UWORD 0 CM_RAW 0 65535 /end CHARACTERISTIC
/begin CHARACTERISTIC CAL_555 "карта #555 10x8: N × LOAD" MAP 0x080629EC RL_FNC_UWORD 0 CM_RAW 0 65535
 /begin AXIS_DESCR COM_AXIS AXIN_04B_N CM_RPM2 8 0 32767.5 AXIS_PTS_REF AX_04B_N /end AXIS_DESCR
 /begin AXIS_DESCR COM_AXIS AXIN_04C_LOAD CM_RAW 10 0 65535 AXIS_PTS_REF AX_04C_LOAD /end AXIS_DESCR
/end CHARACTERISTIC
/begin CHARACTERISTIC CAL_556 "карта #556 10x8: N × LOAD" MAP 0x08062A8C RL_FNC_UWORD 0 CM_RAW 0 65535
 /begin AXIS_DESCR COM_AXIS AXIN_04B_N CM_RPM2 8 0 32767.5 AXIS_PTS_REF AX_04B_N /end AXIS_DESCR
 /begin AXIS_DESCR COM_AXIS AXIN_04C_LOAD CM_RAW 10 0 65535 AXIS_PTS_REF AX_04C_LOAD /end AXIS_DESCR
/end CHARACTERISTIC
/begin CHARACTERISTIC CAL_557 "значение #557" VALUE 0x080629E8 RL_FNC_UWORD 0 CM_RAW 0 65535 /end CHARACTERISTIC
/begin CHARACTERISTIC CAL_558 "значение #558" VALUE 0x080629EA RL_FNC_UWORD 0 CM_RAW 0 65535 /end CHARACTERISTIC
/begin CHARACTERISTIC CAL_559 "значение #559" VALUE 0x080626CC RL_FNC_ULONG 0 CM_RAW 0 4.29497e+09 /end CHARACTERISTIC
/begin CHARACTERISTIC CAL_55A "кривая #55A 10: ?" CURVE 0x080626D0 RL_FNC_ULONG 0 CM_RAW 0 4.29497e+09 /begin AXIS_DESCR COM_AXIS AXIN_069 CM_RAW 10 0 65535 AXIS_PTS_REF AX_069 /end AXIS_DESCR /end CHARACTERISTIC
/begin CHARACTERISTIC CAL_55B "значение #55B" VALUE 0x08064072 RL_FNC_UWORD 0 CM_RAW 0 65535 /end CHARACTERISTIC
/begin CHARACTERISTIC CAL_55C "массив #55C" VAL_BLK 0x08064078 RL_FNC_UWORD 0 CM_RAW 0 65535 MATRIX_DIM 2 1 1 /end CHARACTERISTIC
/begin CHARACTERISTIC CAL_55D "массив #55D" VAL_BLK 0x08064074 RL_FNC_UWORD 0 CM_RAW 0 65535 MATRIX_DIM 2 1 1 /end CHARACTERISTIC
/begin CHARACTERISTIC CAL_55E "массив #55E" VAL_BLK 0x08064080 RL_FNC_UWORD 0 CM_RAW 0 65535 MATRIX_DIM 2 1 1 /end CHARACTERISTIC
/begin CHARACTERISTIC CAL_55F "массив #55F" VAL_BLK 0x0806407C RL_FNC_UWORD 0 CM_RAW 0 65535 MATRIX_DIM 2 1 1 /end CHARACTERISTIC
/begin CHARACTERISTIC CAL_560 "массив #560" VAL_BLK 0x08064084 RL_FNC_UWORD 0 CM_RAW 0 65535 MATRIX_DIM 2 1 1 /end CHARACTERISTIC
/begin CHARACTERISTIC CAL_561 "значение #561" VALUE 0x08064070 RL_FNC_UWORD 0 CM_RAW 0 65535 /end CHARACTERISTIC
/begin CHARACTERISTIC CAL_562 "значение #562" VALUE 0x08062C6C RL_FNC_UWORD 0 CM_RAW 0 65535 /end CHARACTERISTIC
/begin CHARACTERISTIC CAL_563 "кривая #563 9: TCOOL" CURVE 0x0806D218 RL_FNC_UWORD 0 CM_RAW 0 65535
 /begin AXIS_DESCR COM_AXIS AXIN_00A_TCOOL CM_C128 9 -256 255.992 AXIS_PTS_REF AX_00A_TCOOL /end AXIS_DESCR
/end CHARACTERISTIC
/begin CHARACTERISTIC CAL_564 "значение #564" VALUE 0x08063DFA RL_FNC_UWORD 0 CM_RAW 0 65535 /end CHARACTERISTIC
/begin CHARACTERISTIC CAL_565 "массив #565" VAL_BLK 0x08063E00 RL_FNC_UWORD 0 CM_RAW 0 65535 MATRIX_DIM 2 1 1 /end CHARACTERISTIC
/begin CHARACTERISTIC CRUISE_BTN_WIN_IDLE "кнопки круиза: окно [мин, макс] АЦП x4" VAL_BLK 0x08063CFC RL_FNC_UWORD 0 CM_RAW 0 65535 MATRIX_DIM 2 1 1 /end CHARACTERISTIC
/begin CHARACTERISTIC CRUISE_BTN_WIN_5 "кнопки круиза: окно [мин, макс] АЦП x4" VAL_BLK 0x08063D00 RL_FNC_UWORD 0 CM_RAW 0 65535 MATRIX_DIM 2 1 1 /end CHARACTERISTIC
/begin CHARACTERISTIC CRUISE_BTN_WIN_3 "кнопки круиза: окно [мин, макс] АЦП x4" VAL_BLK 0x08063D0C RL_FNC_UWORD 0 CM_RAW 0 65535 MATRIX_DIM 2 1 1 /end CHARACTERISTIC
/begin CHARACTERISTIC CAL_569 "массив #569 [знак по значениям]" VAL_BLK 0x08063DFC RL_FNC_SWORD 0 CM_RAW -32768 32767 MATRIX_DIM 2 1 1 /end CHARACTERISTIC
/begin CHARACTERISTIC CAL_56A "значение #56A" VALUE 0x08063BFC RL_FNC_SBYTE 0 CM_RAW -128 127 /end CHARACTERISTIC
/begin CHARACTERISTIC CAL_56B "значение #56B" VALUE 0x08063BF8 RL_FNC_UWORD 0 CM_RAW 0 65535 /end CHARACTERISTIC
/begin CHARACTERISTIC CAL_56C "значение #56C" VALUE 0x080633B8 RL_FNC_UWORD 0 CM_RAW 0 65535 /end CHARACTERISTIC
/begin CHARACTERISTIC CAL_56D "значение #56D" VALUE 0x08063CEA RL_FNC_UWORD 0 CM_RAW 0 65535 /end CHARACTERISTIC
/begin CHARACTERISTIC CAL_56E "значение #56E" VALUE 0x08063DF4 RL_FNC_UWORD 0 CM_RAW 0 65535 /end CHARACTERISTIC
/begin CHARACTERISTIC CAL_56F "массив #56F" VAL_BLK 0x08063CEC RL_FNC_SBYTE 0 CM_RAW -128 127 MATRIX_DIM 8 1 1 /end CHARACTERISTIC
/begin CHARACTERISTIC CAL_570 "значение #570" VALUE 0x08063D12 RL_FNC_UWORD 0 CM_RAW 0 65535 /end CHARACTERISTIC
/begin CHARACTERISTIC CAL_571 "значение #571" VALUE 0x08063D34 RL_FNC_UWORD 0 CM_RAW 0 65535 /end CHARACTERISTIC
/begin CHARACTERISTIC CAL_572_0 "кривая #572 8: GEAR [1/2]" CURVE 0x08063D38 RL_FNC_UWORD 0 CM_RAW 0 65535
 /begin AXIS_DESCR COM_AXIS AXIN_09E_GEAR CM_RAW 8 0 255 AXIS_PTS_REF AX_09E_GEAR /end AXIS_DESCR
/end CHARACTERISTIC
/begin CHARACTERISTIC CAL_572_1 "кривая #572 8: GEAR [2/2]" CURVE 0x08063D48 RL_FNC_UWORD 0 CM_RAW 0 65535
 /begin AXIS_DESCR COM_AXIS AXIN_09E_GEAR CM_RAW 8 0 255 AXIS_PTS_REF AX_09E_GEAR /end AXIS_DESCR
/end CHARACTERISTIC
/begin CHARACTERISTIC CAL_573_0 "кривая #573 8: GEAR [1/2]" CURVE 0x08063D58 RL_FNC_UWORD 0 CM_RAW 0 65535
 /begin AXIS_DESCR COM_AXIS AXIN_09E_GEAR CM_RAW 8 0 255 AXIS_PTS_REF AX_09E_GEAR /end AXIS_DESCR
/end CHARACTERISTIC
/begin CHARACTERISTIC CAL_573_1 "кривая #573 8: GEAR [2/2]" CURVE 0x08063D68 RL_FNC_UWORD 0 CM_RAW 0 65535
 /begin AXIS_DESCR COM_AXIS AXIN_09E_GEAR CM_RAW 8 0 255 AXIS_PTS_REF AX_09E_GEAR /end AXIS_DESCR
/end CHARACTERISTIC
/begin CHARACTERISTIC CRUISE_ENABLE "круиз-контроль включён (1)" VALUE 0x08063BFA RL_FNC_SBYTE 0 CM_RAW -128 127 /end CHARACTERISTIC
/begin CHARACTERISTIC CAL_575 "массив #575 [знак по значениям]" VAL_BLK 0x08063BF0 RL_FNC_SWORD 0 CM_RAW -32768 32767 MATRIX_DIM 4 1 1 /end CHARACTERISTIC
/begin CHARACTERISTIC CAL_576 "значение #576" VALUE 0x08063D10 RL_FNC_UWORD 0 CM_RAW 0 65535 /end CHARACTERISTIC
/begin CHARACTERISTIC CAL_577 "значение #577" VALUE 0x08063D1E RL_FNC_UWORD 0 CM_RAW 0 65535 /end CHARACTERISTIC
/begin CHARACTERISTIC CAL_578 "значение #578" VALUE 0x080633BB RL_FNC_SBYTE 0 CM_RAW -128 127 /end CHARACTERISTIC
/begin CHARACTERISTIC CAL_579 "значение #579" VALUE 0x08063BE6 RL_FNC_SBYTE 0 CM_RAW -128 127 /end CHARACTERISTIC
/begin CHARACTERISTIC CAL_57A "значение #57A" VALUE 0x08063BFD RL_FNC_SBYTE 0 CM_RAW -128 127 /end CHARACTERISTIC
/begin CHARACTERISTIC CAL_57B "кривая #57B 8: GEAR" CURVE 0x080633C0 RL_FNC_UWORD 0 CM_RAW 0 65535
 /begin AXIS_DESCR COM_AXIS AXIN_09E_GEAR CM_RAW 8 0 255 AXIS_PTS_REF AX_09E_GEAR /end AXIS_DESCR
/end CHARACTERISTIC
/begin CHARACTERISTIC CAL_57C "карта #57C 15x17: ? × ? [знак по значениям]" MAP 0x080633D0 RL_FNC_SWORD 0 CM_RAW -32768 32767 /begin AXIS_DESCR COM_AXIS AXIN_09C CM_RAW 17 0 65535 AXIS_PTS_REF AX_09C /end AXIS_DESCR /begin AXIS_DESCR COM_AXIS AXIN_09B CM_RAW 15 0 65535 AXIS_PTS_REF AX_09B /end AXIS_DESCR /end CHARACTERISTIC
/begin CHARACTERISTIC CAL_57D "карта #57D 15x17: ? × ? [знак по значениям]" MAP 0x080635D0 RL_FNC_SWORD 0 CM_RAW -32768 32767 /begin AXIS_DESCR COM_AXIS AXIN_09C CM_RAW 17 0 65535 AXIS_PTS_REF AX_09C /end AXIS_DESCR /begin AXIS_DESCR COM_AXIS AXIN_09B CM_RAW 15 0 65535 AXIS_PTS_REF AX_09B /end AXIS_DESCR /end CHARACTERISTIC
/begin CHARACTERISTIC CAL_57E "карта #57E 15x17: ? × ? [знак по значениям]" MAP 0x080637D0 RL_FNC_SWORD 0 CM_RAW -32768 32767 /begin AXIS_DESCR COM_AXIS AXIN_09D CM_RAW 17 0 65535 AXIS_PTS_REF AX_09D /end AXIS_DESCR /begin AXIS_DESCR COM_AXIS AXIN_09B CM_RAW 15 0 65535 AXIS_PTS_REF AX_09B /end AXIS_DESCR /end CHARACTERISTIC
/begin CHARACTERISTIC CAL_57F "карта #57F 15x17: ? × ? [знак по значениям]" MAP 0x080639D0 RL_FNC_SWORD 0 CM_RAW -32768 32767 /begin AXIS_DESCR COM_AXIS AXIN_09D CM_RAW 17 0 65535 AXIS_PTS_REF AX_09D /end AXIS_DESCR /begin AXIS_DESCR COM_AXIS AXIN_09B CM_RAW 15 0 65535 AXIS_PTS_REF AX_09B /end AXIS_DESCR /end CHARACTERISTIC
/begin CHARACTERISTIC CAL_580 "массив #580" VAL_BLK 0x08063CE0 RL_FNC_UWORD 0 CM_RAW 0 65535 MATRIX_DIM 3 1 1 /end CHARACTERISTIC
/begin CHARACTERISTIC CAL_581_0 "кривая #581 8: GEAR [1/2]" CURVE 0x08063D80 RL_FNC_UWORD 0 CM_RAW 0 65535
 /begin AXIS_DESCR COM_AXIS AXIN_09E_GEAR CM_RAW 8 0 255 AXIS_PTS_REF AX_09E_GEAR /end AXIS_DESCR
/end CHARACTERISTIC
/begin CHARACTERISTIC CAL_581_1 "кривая #581 8: GEAR [2/2]" CURVE 0x08063D90 RL_FNC_UWORD 0 CM_RAW 0 65535
 /begin AXIS_DESCR COM_AXIS AXIN_09E_GEAR CM_RAW 8 0 255 AXIS_PTS_REF AX_09E_GEAR /end AXIS_DESCR
/end CHARACTERISTIC
/begin CHARACTERISTIC CAL_582 "массив #582 [знак по значениям]" VAL_BLK 0x08063DA0 RL_FNC_SWORD 0 CM_RAW -32768 32767 MATRIX_DIM 2 1 1 /end CHARACTERISTIC
/begin CHARACTERISTIC CAL_583 "массив #583" VAL_BLK 0x08063CDC RL_FNC_UWORD 0 CM_RAW 0 65535 MATRIX_DIM 2 1 1 /end CHARACTERISTIC
/begin CHARACTERISTIC CAL_584 "значение #584" VALUE 0x08063D14 RL_FNC_SBYTE 0 CM_RAW -128 127 /end CHARACTERISTIC
/begin CHARACTERISTIC CAL_585_0 "кривая #585 8: GEAR [1/2]" CURVE 0x08063DC8 RL_FNC_UWORD 0 CM_RAW 0 65535
 /begin AXIS_DESCR COM_AXIS AXIN_09E_GEAR CM_RAW 8 0 255 AXIS_PTS_REF AX_09E_GEAR /end AXIS_DESCR
/end CHARACTERISTIC
/begin CHARACTERISTIC CAL_585_1 "кривая #585 8: GEAR [2/2]" CURVE 0x08063DD8 RL_FNC_UWORD 0 CM_RAW 0 65535
 /begin AXIS_DESCR COM_AXIS AXIN_09E_GEAR CM_RAW 8 0 255 AXIS_PTS_REF AX_09E_GEAR /end AXIS_DESCR
/end CHARACTERISTIC
/begin CHARACTERISTIC CAL_586 "значение #586" VALUE 0x08063E0C RL_FNC_UWORD 0 CM_RAW 0 65535 /end CHARACTERISTIC
/begin CHARACTERISTIC CAL_587_0 "кривая #587 8: GEAR [1/2] [знак по значениям]" CURVE 0x08063C00 RL_FNC_SWORD 0 CM_RAW -32768 32767
 /begin AXIS_DESCR COM_AXIS AXIN_09E_GEAR CM_RAW 8 0 255 AXIS_PTS_REF AX_09E_GEAR /end AXIS_DESCR
/end CHARACTERISTIC
/begin CHARACTERISTIC CAL_587_1 "кривая #587 8: GEAR [2/2] [знак по значениям]" CURVE 0x08063C10 RL_FNC_SWORD 0 CM_RAW -32768 32767
 /begin AXIS_DESCR COM_AXIS AXIN_09E_GEAR CM_RAW 8 0 255 AXIS_PTS_REF AX_09E_GEAR /end AXIS_DESCR
/end CHARACTERISTIC
/begin CHARACTERISTIC CAL_588 "кривая #588 8: GEAR" CURVE 0x08063CCC RL_FNC_UWORD 0 CM_RAW 0 65535
 /begin AXIS_DESCR COM_AXIS AXIN_09E_GEAR CM_RAW 8 0 255 AXIS_PTS_REF AX_09E_GEAR /end AXIS_DESCR
/end CHARACTERISTIC
/begin CHARACTERISTIC CAL_589 "значение #589" VALUE 0x08063CC8 RL_FNC_UWORD 0 CM_RAW 0 65535 /end CHARACTERISTIC
/begin CHARACTERISTIC CAL_58A "карта #58A 8x10: ? × GEAR" MAP 0x08063C28 RL_FNC_UWORD 0 CM_RAW 0 65535 /begin AXIS_DESCR COM_AXIS AXIN_09F CM_RAW 10 0 65535 AXIS_PTS_REF AX_09F /end AXIS_DESCR
 /begin AXIS_DESCR COM_AXIS AXIN_09E_GEAR CM_RAW 8 0 255 AXIS_PTS_REF AX_09E_GEAR /end AXIS_DESCR
/end CHARACTERISTIC
/begin CHARACTERISTIC CAL_58B "массив #58B" VAL_BLK 0x08063CF4 RL_FNC_UWORD 0 CM_RAW 0 65535 MATRIX_DIM 3 1 1 /end CHARACTERISTIC
/begin CHARACTERISTIC CAL_58C "значение #58C" VALUE 0x08063CFA RL_FNC_UWORD 0 CM_RAW 0 65535 /end CHARACTERISTIC
/begin CHARACTERISTIC CAL_58D "массив #58D [знак по значениям]" VAL_BLK 0x08063D7C RL_FNC_SWORD 0 CM_RAW -32768 32767 MATRIX_DIM 2 1 1 /end CHARACTERISTIC
/begin CHARACTERISTIC CAL_58E_0 "кривая #58E 8: GEAR [1/2]" CURVE 0x08063DA8 RL_FNC_UWORD 0 CM_RAW 0 65535
 /begin AXIS_DESCR COM_AXIS AXIN_09E_GEAR CM_RAW 8 0 255 AXIS_PTS_REF AX_09E_GEAR /end AXIS_DESCR
/end CHARACTERISTIC
/begin CHARACTERISTIC CAL_58E_1 "кривая #58E 8: GEAR [2/2]" CURVE 0x08063DB8 RL_FNC_UWORD 0 CM_RAW 0 65535
 /begin AXIS_DESCR COM_AXIS AXIN_09E_GEAR CM_RAW 8 0 255 AXIS_PTS_REF AX_09E_GEAR /end AXIS_DESCR
/end CHARACTERISTIC
/begin CHARACTERISTIC CAL_58F "значение #58F" VALUE 0x08063DA4 RL_FNC_UWORD 0 CM_RAW 0 65535 /end CHARACTERISTIC
/begin CHARACTERISTIC LIMITER_ENABLE "ограничитель скорости включён (1)" VALUE 0x08063BFB RL_FNC_SBYTE 0 CM_RAW -128 127 /end CHARACTERISTIC
/begin CHARACTERISTIC CAL_591 "значение #591" VALUE 0x08063CE8 RL_FNC_UWORD 0 CM_RAW 0 65535 /end CHARACTERISTIC
/begin CHARACTERISTIC CRUISE_VSET_MIN "минимальная заданная скорость круиза" VALUE 0x08063CE6 RL_FNC_UWORD 0 CM_KMH64 0 1023.98 /end CHARACTERISTIC
/begin CHARACTERISTIC CAL_593 "массив #593" VAL_BLK 0x08063D18 RL_FNC_UWORD 0 CM_RAW 0 65535 MATRIX_DIM 3 1 1 /end CHARACTERISTIC
/begin CHARACTERISTIC CAL_594 "кривая #594 8: GEAR" CURVE 0x08063BD0 RL_FNC_UWORD 0 CM_RAW 0 65535
 /begin AXIS_DESCR COM_AXIS AXIN_05E_GEAR CM_RAW 8 -128 127 AXIS_PTS_REF AX_05E_GEAR /end AXIS_DESCR
/end CHARACTERISTIC
/begin CHARACTERISTIC CAL_595 "массив #595" VAL_BLK 0x08063BEC RL_FNC_UWORD 0 CM_RAW 0 65535 MATRIX_DIM 2 1 1 /end CHARACTERISTIC
/begin CHARACTERISTIC CAL_596 "значение #596" VALUE 0x08063E04 RL_FNC_UWORD 0 CM_RAW 0 65535 /end CHARACTERISTIC
/begin CHARACTERISTIC CAL_597 "значение #597" VALUE 0x08063BE0 RL_FNC_UWORD 0 CM_RAW 0 65535 /end CHARACTERISTIC
/begin CHARACTERISTIC CAL_598 "значение #598" VALUE 0x08063BE2 RL_FNC_UWORD 0 CM_RAW 0 65535 /end CHARACTERISTIC
/begin CHARACTERISTIC CAL_599 "массив #599" VAL_BLK 0x08063E10 RL_FNC_UWORD 0 CM_RAW 0 65535 MATRIX_DIM 8 1 1 /end CHARACTERISTIC
/begin CHARACTERISTIC CAL_59A "значение #59A" VALUE 0x08063D20 RL_FNC_UWORD 0 CM_RAW 0 65535 /end CHARACTERISTIC
/begin CHARACTERISTIC CAL_59B "кривая #59B 8: GEAR" CURVE 0x08063D24 RL_FNC_UWORD 0 CM_RAW 0 65535
 /begin AXIS_DESCR COM_AXIS AXIN_09E_GEAR CM_RAW 8 0 255 AXIS_PTS_REF AX_09E_GEAR /end AXIS_DESCR
/end CHARACTERISTIC
/begin CHARACTERISTIC CRUISE_BTN_OPEN "кнопки круиза: верхний порог исправной линии, АЦП" VALUE 0x08063E0E RL_FNC_SWORD 0 CM_RAW -32768 32767 /end CHARACTERISTIC
/begin CHARACTERISTIC CAL_59D "значение #59D" VALUE 0x0806538D RL_FNC_SBYTE 0 CM_RAW -128 127 /end CHARACTERISTIC
/begin CHARACTERISTIC CAL_59E "значение #59E" VALUE 0x0806538E RL_FNC_SBYTE 0 CM_RAW -128 127 /end CHARACTERISTIC
/begin CHARACTERISTIC CAL_59F "значение #59F" VALUE 0x0806538F RL_FNC_SBYTE 0 CM_RAW -128 127 /end CHARACTERISTIC
/begin CHARACTERISTIC CAL_5A0 "значение #5A0" VALUE 0x08065390 RL_FNC_SBYTE 0 CM_RAW -128 127 /end CHARACTERISTIC
/begin CHARACTERISTIC CAL_5A1 "значение #5A1" VALUE 0x08065391 RL_FNC_SBYTE 0 CM_RAW -128 127 /end CHARACTERISTIC
/begin CHARACTERISTIC CAL_5A2 "значение #5A2" VALUE 0x08065392 RL_FNC_SBYTE 0 CM_RAW -128 127 /end CHARACTERISTIC
/begin CHARACTERISTIC CAL_5A3 "значение #5A3" VALUE 0x08065397 RL_FNC_SBYTE 0 CM_RAW -128 127 /end CHARACTERISTIC
/begin CHARACTERISTIC CAL_5A4 "значение #5A4" VALUE 0x08065398 RL_FNC_SBYTE 0 CM_RAW -128 127 /end CHARACTERISTIC
/begin CHARACTERISTIC CAL_5A6 "массив #5A6" VAL_BLK 0x080643BC RL_FNC_UWORD 0 CM_RAW 0 65535 MATRIX_DIM 2 1 1 /end CHARACTERISTIC
/begin CHARACTERISTIC CAL_5A7 "значение #5A7" VALUE 0x080643C0 RL_FNC_SBYTE 0 CM_RAW -128 127 /end CHARACTERISTIC
/begin CHARACTERISTIC CAL_5A8 "значение #5A8" VALUE 0x080643F8 RL_FNC_SLONG 0 CM_RAW -2.14748e+09 2.14748e+09 /end CHARACTERISTIC
/begin CHARACTERISTIC CAL_5A9 "значение #5A9" VALUE 0x080643FC RL_FNC_UWORD 0 CM_RAW 0 65535 /end CHARACTERISTIC
/begin CHARACTERISTIC CAL_5AA "карта #5AA 3x9: ? × ?" MAP 0x080643D8 RL_FNC_SBYTE 0 CM_RAW -128 127 /begin AXIS_DESCR COM_AXIS AXIN_070 CM_RAW 9 -128 127 AXIS_PTS_REF AX_070 /end AXIS_DESCR /begin AXIS_DESCR COM_AXIS AXIN_08B CM_RAW 3 -128 127 AXIS_PTS_REF AX_08B /end AXIS_DESCR /end CHARACTERISTIC
/begin CHARACTERISTIC CAL_5AB "карта #5AB 3x6: ? × ?" MAP 0x080643C4 RL_FNC_SBYTE 0 CM_RAW -128 127 /begin AXIS_DESCR COM_AXIS AXIN_071 CM_RAW 6 -128 127 AXIS_PTS_REF AX_071 /end AXIS_DESCR /begin AXIS_DESCR COM_AXIS AXIN_08B CM_RAW 3 -128 127 AXIS_PTS_REF AX_08B /end AXIS_DESCR /end CHARACTERISTIC
/begin CHARACTERISTIC CAL_5AC "значение #5AC" VALUE 0x080643F4 RL_FNC_UWORD 0 CM_RAW 0 65535 /end CHARACTERISTIC
/begin CHARACTERISTIC CAL_5AF "значение #5AF" VALUE 0x08066B6E RL_FNC_UWORD 0 CM_RAW 0 65535 /end CHARACTERISTIC
/begin CHARACTERISTIC CAL_5B0_0 "кривая #5B0 8: ? [1/2]" CURVE 0x08066B70 RL_FNC_SWORD 0 CM_RAW -32768 32767 /begin AXIS_DESCR COM_AXIS AXIN_0A0 CM_RAW 8 -128 127 AXIS_PTS_REF AX_0A0 /end AXIS_DESCR /end CHARACTERISTIC
/begin CHARACTERISTIC CAL_5B0_1 "кривая #5B0 8: ? [2/2]" CURVE 0x08066B80 RL_FNC_SWORD 0 CM_RAW -32768 32767 /begin AXIS_DESCR COM_AXIS AXIN_0A0 CM_RAW 8 -128 127 AXIS_PTS_REF AX_0A0 /end AXIS_DESCR /end CHARACTERISTIC
/begin CHARACTERISTIC CAL_5B1 "значение #5B1" VALUE 0x08066B90 RL_FNC_SBYTE 0 CM_RAW -128 127 /end CHARACTERISTIC
/begin CHARACTERISTIC CAL_5B2 "значение #5B2" VALUE 0x08066B91 RL_FNC_UBYTE 0 CM_RAW 0 255 /end CHARACTERISTIC
/begin CHARACTERISTIC CAL_5B3_0 "кривая #5B3 16: PEDAL [1/8]" CURVE 0x08066B94 RL_FNC_UWORD 0 CM_RAW 0 65535
 /begin AXIS_DESCR COM_AXIS AXIN_01B_PEDAL CM_P128 16 0 511.992 AXIS_PTS_REF AX_01B_PEDAL /end AXIS_DESCR
/end CHARACTERISTIC
/begin CHARACTERISTIC CAL_5B3_1 "кривая #5B3 16: PEDAL [2/8]" CURVE 0x08066BB4 RL_FNC_UWORD 0 CM_RAW 0 65535
 /begin AXIS_DESCR COM_AXIS AXIN_01B_PEDAL CM_P128 16 0 511.992 AXIS_PTS_REF AX_01B_PEDAL /end AXIS_DESCR
/end CHARACTERISTIC
/begin CHARACTERISTIC CAL_5B3_2 "кривая #5B3 16: PEDAL [3/8]" CURVE 0x08066BD4 RL_FNC_UWORD 0 CM_RAW 0 65535
 /begin AXIS_DESCR COM_AXIS AXIN_01B_PEDAL CM_P128 16 0 511.992 AXIS_PTS_REF AX_01B_PEDAL /end AXIS_DESCR
/end CHARACTERISTIC
/begin CHARACTERISTIC CAL_5B3_3 "кривая #5B3 16: PEDAL [4/8]" CURVE 0x08066BF4 RL_FNC_UWORD 0 CM_RAW 0 65535
 /begin AXIS_DESCR COM_AXIS AXIN_01B_PEDAL CM_P128 16 0 511.992 AXIS_PTS_REF AX_01B_PEDAL /end AXIS_DESCR
/end CHARACTERISTIC
/begin CHARACTERISTIC CAL_5B3_4 "кривая #5B3 16: PEDAL [5/8]" CURVE 0x08066C14 RL_FNC_UWORD 0 CM_RAW 0 65535
 /begin AXIS_DESCR COM_AXIS AXIN_01B_PEDAL CM_P128 16 0 511.992 AXIS_PTS_REF AX_01B_PEDAL /end AXIS_DESCR
/end CHARACTERISTIC
/begin CHARACTERISTIC CAL_5B3_5 "кривая #5B3 16: PEDAL [6/8]" CURVE 0x08066C34 RL_FNC_UWORD 0 CM_RAW 0 65535
 /begin AXIS_DESCR COM_AXIS AXIN_01B_PEDAL CM_P128 16 0 511.992 AXIS_PTS_REF AX_01B_PEDAL /end AXIS_DESCR
/end CHARACTERISTIC
/begin CHARACTERISTIC CAL_5B3_6 "кривая #5B3 16: PEDAL [7/8]" CURVE 0x08066C54 RL_FNC_UWORD 0 CM_RAW 0 65535
 /begin AXIS_DESCR COM_AXIS AXIN_01B_PEDAL CM_P128 16 0 511.992 AXIS_PTS_REF AX_01B_PEDAL /end AXIS_DESCR
/end CHARACTERISTIC
/begin CHARACTERISTIC CAL_5B3_7 "кривая #5B3 16: PEDAL [8/8]" CURVE 0x08066C74 RL_FNC_UWORD 0 CM_RAW 0 65535
 /begin AXIS_DESCR COM_AXIS AXIN_01B_PEDAL CM_P128 16 0 511.992 AXIS_PTS_REF AX_01B_PEDAL /end AXIS_DESCR
/end CHARACTERISTIC
/begin CHARACTERISTIC CAL_5B4_0 "кривая #5B4 16: PEDAL [1/8]" CURVE 0x08066C94 RL_FNC_UWORD 0 CM_RAW 0 65535
 /begin AXIS_DESCR COM_AXIS AXIN_01B_PEDAL CM_P128 16 0 511.992 AXIS_PTS_REF AX_01B_PEDAL /end AXIS_DESCR
/end CHARACTERISTIC
/begin CHARACTERISTIC CAL_5B4_1 "кривая #5B4 16: PEDAL [2/8]" CURVE 0x08066CB4 RL_FNC_UWORD 0 CM_RAW 0 65535
 /begin AXIS_DESCR COM_AXIS AXIN_01B_PEDAL CM_P128 16 0 511.992 AXIS_PTS_REF AX_01B_PEDAL /end AXIS_DESCR
/end CHARACTERISTIC
/begin CHARACTERISTIC CAL_5B4_2 "кривая #5B4 16: PEDAL [3/8]" CURVE 0x08066CD4 RL_FNC_UWORD 0 CM_RAW 0 65535
 /begin AXIS_DESCR COM_AXIS AXIN_01B_PEDAL CM_P128 16 0 511.992 AXIS_PTS_REF AX_01B_PEDAL /end AXIS_DESCR
/end CHARACTERISTIC
/begin CHARACTERISTIC CAL_5B4_3 "кривая #5B4 16: PEDAL [4/8]" CURVE 0x08066CF4 RL_FNC_UWORD 0 CM_RAW 0 65535
 /begin AXIS_DESCR COM_AXIS AXIN_01B_PEDAL CM_P128 16 0 511.992 AXIS_PTS_REF AX_01B_PEDAL /end AXIS_DESCR
/end CHARACTERISTIC
/begin CHARACTERISTIC CAL_5B4_4 "кривая #5B4 16: PEDAL [5/8]" CURVE 0x08066D14 RL_FNC_UWORD 0 CM_RAW 0 65535
 /begin AXIS_DESCR COM_AXIS AXIN_01B_PEDAL CM_P128 16 0 511.992 AXIS_PTS_REF AX_01B_PEDAL /end AXIS_DESCR
/end CHARACTERISTIC
/begin CHARACTERISTIC CAL_5B4_5 "кривая #5B4 16: PEDAL [6/8]" CURVE 0x08066D34 RL_FNC_UWORD 0 CM_RAW 0 65535
 /begin AXIS_DESCR COM_AXIS AXIN_01B_PEDAL CM_P128 16 0 511.992 AXIS_PTS_REF AX_01B_PEDAL /end AXIS_DESCR
/end CHARACTERISTIC
/begin CHARACTERISTIC CAL_5B4_6 "кривая #5B4 16: PEDAL [7/8]" CURVE 0x08066D54 RL_FNC_UWORD 0 CM_RAW 0 65535
 /begin AXIS_DESCR COM_AXIS AXIN_01B_PEDAL CM_P128 16 0 511.992 AXIS_PTS_REF AX_01B_PEDAL /end AXIS_DESCR
/end CHARACTERISTIC
/begin CHARACTERISTIC CAL_5B4_7 "кривая #5B4 16: PEDAL [8/8]" CURVE 0x08066D74 RL_FNC_UWORD 0 CM_RAW 0 65535
 /begin AXIS_DESCR COM_AXIS AXIN_01B_PEDAL CM_P128 16 0 511.992 AXIS_PTS_REF AX_01B_PEDAL /end AXIS_DESCR
/end CHARACTERISTIC
/begin CHARACTERISTIC CAL_5B5 "значение #5B5" VALUE 0x08066D94 RL_FNC_SBYTE 0 CM_RAW -128 127 /end CHARACTERISTIC
/begin CHARACTERISTIC CAL_5B6 "значение #5B6" VALUE 0x08066D96 RL_FNC_UWORD 0 CM_RAW 0 65535 /end CHARACTERISTIC
/begin CHARACTERISTIC CAL_5B7 "значение #5B7" VALUE 0x08066D98 RL_FNC_SBYTE 0 CM_RAW -128 127 /end CHARACTERISTIC
/begin CHARACTERISTIC CAL_5B8 "массив #5B8" VAL_BLK 0x0806935C RL_FNC_UWORD 0 CM_RAW 0 65535 MATRIX_DIM 2 1 1 /end CHARACTERISTIC
/begin CHARACTERISTIC CAL_5B9 "массив #5B9" VAL_BLK 0x080624B0 RL_FNC_SBYTE 0 CM_RAW -128 127 MATRIX_DIM 13 1 1 /end CHARACTERISTIC
/begin CHARACTERISTIC CAL_5BA "массив #5BA" VAL_BLK 0x080624C0 RL_FNC_SBYTE 0 CM_RAW -128 127 MATRIX_DIM 19 1 1 /end CHARACTERISTIC
/begin CHARACTERISTIC CAL_5BB "массив #5BB" VAL_BLK 0x080624D4 RL_FNC_SBYTE 0 CM_RAW -128 127 MATRIX_DIM 14 1 1 /end CHARACTERISTIC
/begin CHARACTERISTIC CAL_5BC "массив #5BC" VAL_BLK 0x080624E4 RL_FNC_SBYTE 0 CM_RAW -128 127 MATRIX_DIM 8 1 1 /end CHARACTERISTIC
/begin CHARACTERISTIC CAL_5BD "массив #5BD" VAL_BLK 0x08063EE8 RL_FNC_SBYTE 0 CM_RAW -128 127 MATRIX_DIM 2 1 1 /end CHARACTERISTIC
/begin CHARACTERISTIC CAL_5BE "карта #5BE 2x4: ? × ?" MAP 0x08063EF0 RL_FNC_SBYTE 0 CM_RAW -128 127 /begin AXIS_DESCR COM_AXIS AXIN_0A2 CM_RAW 4 0 255 AXIS_PTS_REF AX_0A2 /end AXIS_DESCR /begin AXIS_DESCR COM_AXIS AXIN_013 CM_RAW 2 0 255 AXIS_PTS_REF AX_013 /end AXIS_DESCR /end CHARACTERISTIC
/begin CHARACTERISTIC CAL_5BF "значение #5BF" VALUE 0x080632E6 RL_FNC_SBYTE 0 CM_RAW -128 127 /end CHARACTERISTIC
/begin CHARACTERISTIC CAL_5C0 "значение #5C0" VALUE 0x080632EA RL_FNC_SBYTE 0 CM_RAW -128 127 /end CHARACTERISTIC
/begin CHARACTERISTIC CAL_5C1 "значение #5C1" VALUE 0x080632E4 RL_FNC_SBYTE 0 CM_RAW -128 127 /end CHARACTERISTIC
/begin CHARACTERISTIC CAL_5C2 "значение #5C2" VALUE 0x0806331E RL_FNC_SWORD 0 CM_RAW -32768 32767 /end CHARACTERISTIC
/begin CHARACTERISTIC CAL_5C3 "значение #5C3" VALUE 0x08063332 RL_FNC_SWORD 0 CM_RAW -32768 32767 /end CHARACTERISTIC
/begin CHARACTERISTIC CAL_5C4 "значение #5C4" VALUE 0x080632E9 RL_FNC_SBYTE 0 CM_RAW -128 127 /end CHARACTERISTIC
/begin CHARACTERISTIC CAL_5C5 "значение #5C5" VALUE 0x080632E5 RL_FNC_SBYTE 0 CM_RAW -128 127 /end CHARACTERISTIC
/begin CHARACTERISTIC CAL_5C6 "значение #5C6" VALUE 0x080632E8 RL_FNC_SBYTE 0 CM_RAW -128 127 /end CHARACTERISTIC
/begin CHARACTERISTIC CAL_5C7 "значение #5C7" VALUE 0x08063320 RL_FNC_SBYTE 0 CM_RAW -128 127 /end CHARACTERISTIC
/begin CHARACTERISTIC CAL_5C8 "значение #5C8" VALUE 0x0806332D RL_FNC_SBYTE 0 CM_RAW -128 127 /end CHARACTERISTIC
/begin CHARACTERISTIC CAL_5C9 "значение #5C9" VALUE 0x08063352 RL_FNC_SBYTE 0 CM_RAW -128 127 /end CHARACTERISTIC
/begin CHARACTERISTIC CAL_5CA "значение #5CA" VALUE 0x0806332E RL_FNC_SWORD 0 CM_RAW -32768 32767 /end CHARACTERISTIC
/begin CHARACTERISTIC CAL_5CB "значение #5CB" VALUE 0x08063344 RL_FNC_SWORD 0 CM_RAW -32768 32767 /end CHARACTERISTIC
/begin CHARACTERISTIC CAL_5CC "значение #5CC" VALUE 0x0806336B RL_FNC_SBYTE 0 CM_RAW -128 127 /end CHARACTERISTIC
/begin CHARACTERISTIC CAL_5CD "значение #5CD" VALUE 0x0806336C RL_FNC_SBYTE 0 CM_RAW -128 127 /end CHARACTERISTIC
/begin CHARACTERISTIC CAL_5CE "значение #5CE" VALUE 0x0806336D RL_FNC_SBYTE 0 CM_RAW -128 127 /end CHARACTERISTIC
/begin CHARACTERISTIC CAL_5CF "значение #5CF" VALUE 0x08063323 RL_FNC_SBYTE 0 CM_RAW -128 127 /end CHARACTERISTIC
/begin CHARACTERISTIC CAL_5D0 "значение #5D0" VALUE 0x0806331A RL_FNC_SBYTE 0 CM_RAW -128 127 /end CHARACTERISTIC
/begin CHARACTERISTIC CAL_5D1 "значение #5D1" VALUE 0x0806331B RL_FNC_SBYTE 0 CM_RAW -128 127 /end CHARACTERISTIC
/begin CHARACTERISTIC CAL_5D2 "значение #5D2" VALUE 0x08063330 RL_FNC_SBYTE 0 CM_RAW -128 127 /end CHARACTERISTIC
/begin CHARACTERISTIC CAL_5D3 "значение #5D3" VALUE 0x08063365 RL_FNC_SBYTE 0 CM_RAW -128 127 /end CHARACTERISTIC
/begin CHARACTERISTIC CAL_5D4 "значение #5D4" VALUE 0x080632FE RL_FNC_SBYTE 0 CM_RAW -128 127 /end CHARACTERISTIC
/begin CHARACTERISTIC CAL_5D5 "значение #5D5" VALUE 0x08063301 RL_FNC_SBYTE 0 CM_RAW -128 127 /end CHARACTERISTIC
/begin CHARACTERISTIC CAL_5D6 "значение #5D6" VALUE 0x08063302 RL_FNC_SBYTE 0 CM_RAW -128 127 /end CHARACTERISTIC
/begin CHARACTERISTIC CAL_5D7 "значение #5D7" VALUE 0x08063310 RL_FNC_SBYTE 0 CM_RAW -128 127 /end CHARACTERISTIC
/begin CHARACTERISTIC CAL_5D8 "значение #5D8" VALUE 0x080632EC RL_FNC_SLONG 0 CM_RAW -2.14748e+09 2.14748e+09 /end CHARACTERISTIC
/begin CHARACTERISTIC CAL_5D9 "значение #5D9" VALUE 0x08063316 RL_FNC_SBYTE 0 CM_RAW -128 127 /end CHARACTERISTIC
/begin CHARACTERISTIC CAL_5DA "значение #5DA" VALUE 0x080632DE RL_FNC_SBYTE 0 CM_RAW -128 127 /end CHARACTERISTIC
/begin CHARACTERISTIC CAL_5DB "значение #5DB" VALUE 0x080632DC RL_FNC_SBYTE 0 CM_RAW -128 127 /end CHARACTERISTIC
/begin CHARACTERISTIC CAL_5DC "значение #5DC" VALUE 0x08063309 RL_FNC_SBYTE 0 CM_RAW -128 127 /end CHARACTERISTIC
/begin CHARACTERISTIC CAL_5DD "значение #5DD" VALUE 0x08063321 RL_FNC_SBYTE 0 CM_RAW -128 127 /end CHARACTERISTIC
/begin CHARACTERISTIC CAL_5DE "значение #5DE" VALUE 0x08063326 RL_FNC_SBYTE 0 CM_RAW -128 127 /end CHARACTERISTIC
/begin CHARACTERISTIC CAL_5DF "значение #5DF" VALUE 0x080632FA RL_FNC_SWORD 0 CM_RAW -32768 32767 /end CHARACTERISTIC
/begin CHARACTERISTIC CAL_5E0 "значение #5E0" VALUE 0x08063341 RL_FNC_SBYTE 0 CM_RAW -128 127 /end CHARACTERISTIC
/begin CHARACTERISTIC CAL_5E1 "значение #5E1" VALUE 0x08063349 RL_FNC_SBYTE 0 CM_RAW -128 127 /end CHARACTERISTIC
/begin CHARACTERISTIC CAL_5E2 "значение #5E2" VALUE 0x080632FD RL_FNC_SBYTE 0 CM_RAW -128 127 /end CHARACTERISTIC
/begin CHARACTERISTIC CAL_5E3 "значение #5E3" VALUE 0x0806331C RL_FNC_SBYTE 0 CM_RAW -128 127 /end CHARACTERISTIC
/begin CHARACTERISTIC CAL_5E4 "значение #5E4" VALUE 0x0806332B RL_FNC_SBYTE 0 CM_RAW -128 127 /end CHARACTERISTIC
/begin CHARACTERISTIC CAL_5E5 "значение #5E5" VALUE 0x0806334F RL_FNC_SBYTE 0 CM_RAW -128 127 /end CHARACTERISTIC
/begin CHARACTERISTIC CAL_5E6 "значение #5E6" VALUE 0x0806335F RL_FNC_SBYTE 0 CM_RAW -128 127 /end CHARACTERISTIC
/begin CHARACTERISTIC CAL_5E7 "значение #5E7" VALUE 0x080632FF RL_FNC_SBYTE 0 CM_RAW -128 127 /end CHARACTERISTIC
/begin CHARACTERISTIC CAL_5E8 "значение #5E8" VALUE 0x08063315 RL_FNC_SBYTE 0 CM_RAW -128 127 /end CHARACTERISTIC
/begin CHARACTERISTIC CAL_5E9 "значение #5E9" VALUE 0x0806330C RL_FNC_SLONG 0 CM_RAW -2.14748e+09 2.14748e+09 /end CHARACTERISTIC
/begin CHARACTERISTIC CAL_5EA "значение #5EA" VALUE 0x08063370 RL_FNC_SWORD 0 CM_RAW -32768 32767 /end CHARACTERISTIC
/begin CHARACTERISTIC CAL_5EB "значение #5EB" VALUE 0x0807496E RL_FNC_SBYTE 0 CM_RAW -128 127 /end CHARACTERISTIC
/begin CHARACTERISTIC CAL_5F1 "массив #5F1" VAL_BLK 0x08068FB8 RL_FNC_SWORD 0 CM_RAW -32768 32767 MATRIX_DIM 23 1 1 /end CHARACTERISTIC
/begin CHARACTERISTIC CAL_5F2 "массив #5F2" VAL_BLK 0x0806BB40 RL_FNC_UWORD 0 CM_RAW 0 65535 MATRIX_DIM 2 1 1 /end CHARACTERISTIC
/begin CHARACTERISTIC CAL_5F3 "массив #5F3" VAL_BLK 0x0806BBC8 RL_FNC_UWORD 0 CM_RAW 0 65535 MATRIX_DIM 2 1 1 /end CHARACTERISTIC
/begin CHARACTERISTIC CAL_5F4_0 "кривая #5F4 14: ? [1/2]" CURVE 0x0806BB90 RL_FNC_UWORD 0 CM_RAW 0 65535 /begin AXIS_DESCR COM_AXIS AXIN_0A3 CM_RAW 14 0 65535 AXIS_PTS_REF AX_0A3 /end AXIS_DESCR /end CHARACTERISTIC
/begin CHARACTERISTIC CAL_5F4_1 "кривая #5F4 14: ? [2/2]" CURVE 0x0806BBAC RL_FNC_UWORD 0 CM_RAW 0 65535 /begin AXIS_DESCR COM_AXIS AXIN_0A3 CM_RAW 14 0 65535 AXIS_PTS_REF AX_0A3 /end AXIS_DESCR /end CHARACTERISTIC
/begin CHARACTERISTIC CAL_5F5 "массив #5F5" VAL_BLK 0x0806BC04 RL_FNC_UWORD 0 CM_RAW 0 65535 MATRIX_DIM 2 1 1 /end CHARACTERISTIC
/begin CHARACTERISTIC CAL_5F6_0 "кривая #5F6 14: ? [1/2]" CURVE 0x0806BBCC RL_FNC_UWORD 0 CM_RAW 0 65535 /begin AXIS_DESCR COM_AXIS AXIN_0A3 CM_RAW 14 0 65535 AXIS_PTS_REF AX_0A3 /end AXIS_DESCR /end CHARACTERISTIC
/begin CHARACTERISTIC CAL_5F6_1 "кривая #5F6 14: ? [2/2]" CURVE 0x0806BBE8 RL_FNC_UWORD 0 CM_RAW 0 65535 /begin AXIS_DESCR COM_AXIS AXIN_0A3 CM_RAW 14 0 65535 AXIS_PTS_REF AX_0A3 /end AXIS_DESCR /end CHARACTERISTIC
/begin CHARACTERISTIC CAL_5F7 "карта #5F7 2x3: ? × ?" MAP 0x0806BC08 RL_FNC_UWORD 0 CM_RAW 0 65535 /begin AXIS_DESCR COM_AXIS AXIN_0A4 CM_RAW 3 -128 127 AXIS_PTS_REF AX_0A4 /end AXIS_DESCR /begin AXIS_DESCR COM_AXIS AXIN_0A6 CM_RAW 2 -128 127 AXIS_PTS_REF AX_0A6 /end AXIS_DESCR /end CHARACTERISTIC
/begin CHARACTERISTIC CAL_5F8 "массив #5F8" VAL_BLK 0x0806BC14 RL_FNC_UWORD 0 CM_RAW 0 65535 MATRIX_DIM 2 1 1 /end CHARACTERISTIC
/begin CHARACTERISTIC CAL_5F9 "массив #5F9" VAL_BLK 0x0806BC1C RL_FNC_UWORD 0 CM_RAW 0 65535 MATRIX_DIM 2 1 1 /end CHARACTERISTIC
/begin CHARACTERISTIC CAL_5FA_0 "кривая #5FA 10: ? [1/2]" CURVE 0x0806BC20 RL_FNC_UWORD 0 CM_RAW 0 65535 /begin AXIS_DESCR COM_AXIS AXIN_0DE CM_RAW 10 0 65535 AXIS_PTS_REF AX_0DE /end AXIS_DESCR /end CHARACTERISTIC
/begin CHARACTERISTIC CAL_5FA_1 "кривая #5FA 10: ? [2/2]" CURVE 0x0806BC34 RL_FNC_UWORD 0 CM_RAW 0 65535 /begin AXIS_DESCR COM_AXIS AXIN_0DE CM_RAW 10 0 65535 AXIS_PTS_REF AX_0DE /end AXIS_DESCR /end CHARACTERISTIC
/begin CHARACTERISTIC CAL_5FB "массив #5FB" VAL_BLK 0x0806BC48 RL_FNC_UWORD 0 CM_RAW 0 65535 MATRIX_DIM 2 1 1 /end CHARACTERISTIC
/begin CHARACTERISTIC CAL_5FC "массив #5FC" VAL_BLK 0x0806BC4C RL_FNC_UWORD 0 CM_RAW 0 65535 MATRIX_DIM 2 1 1 /end CHARACTERISTIC
/begin CHARACTERISTIC CAL_5FD "карта #5FD 2x2: ? × ?" MAP 0x0806BC60 RL_FNC_UWORD 0 CM_RAW 0 65535 /begin AXIS_DESCR COM_AXIS AXIN_0A5 CM_RAW 2 -128 127 AXIS_PTS_REF AX_0A5 /end AXIS_DESCR /begin AXIS_DESCR COM_AXIS AXIN_0A6 CM_RAW 2 -128 127 AXIS_PTS_REF AX_0A6 /end AXIS_DESCR /end CHARACTERISTIC
/begin CHARACTERISTIC CAL_5FE "карта #5FE 2x2: ? × ?" MAP 0x0806BC68 RL_FNC_UWORD 0 CM_RAW 0 65535 /begin AXIS_DESCR COM_AXIS AXIN_0A5 CM_RAW 2 -128 127 AXIS_PTS_REF AX_0A5 /end AXIS_DESCR /begin AXIS_DESCR COM_AXIS AXIN_0A6 CM_RAW 2 -128 127 AXIS_PTS_REF AX_0A6 /end AXIS_DESCR /end CHARACTERISTIC
/begin CHARACTERISTIC CAL_5FF "карта #5FF 2x2: ? × ?" MAP 0x0806BC70 RL_FNC_UWORD 0 CM_RAW 0 65535 /begin AXIS_DESCR COM_AXIS AXIN_0A5 CM_RAW 2 -128 127 AXIS_PTS_REF AX_0A5 /end AXIS_DESCR /begin AXIS_DESCR COM_AXIS AXIN_0A6 CM_RAW 2 -128 127 AXIS_PTS_REF AX_0A6 /end AXIS_DESCR /end CHARACTERISTIC
/begin CHARACTERISTIC CAL_600 "массив #600" VAL_BLK 0x0806BC78 RL_FNC_UWORD 0 CM_RAW 0 65535 MATRIX_DIM 2 1 1 /end CHARACTERISTIC
/begin CHARACTERISTIC CAL_602_0 "карта #602 10x8: N × ? [1/2]" MAP 0x0806B8BC RL_FNC_UWORD 0 CM_RAW 0 65535
 /begin AXIS_DESCR COM_AXIS AXIN_04B_N CM_RPM2 8 0 32767.5 AXIS_PTS_REF AX_04B_N /end AXIS_DESCR
 /begin AXIS_DESCR COM_AXIS AXIN_04D CM_RAW 10 0 65535 AXIS_PTS_REF AX_04D /end AXIS_DESCR
/end CHARACTERISTIC
/begin CHARACTERISTIC CAL_602_1 "карта #602 10x8: N × ? [2/2]" MAP 0x0806B95C RL_FNC_UWORD 0 CM_RAW 0 65535
 /begin AXIS_DESCR COM_AXIS AXIN_04B_N CM_RPM2 8 0 32767.5 AXIS_PTS_REF AX_04B_N /end AXIS_DESCR
 /begin AXIS_DESCR COM_AXIS AXIN_04D CM_RAW 10 0 65535 AXIS_PTS_REF AX_04D /end AXIS_DESCR
/end CHARACTERISTIC
/begin CHARACTERISTIC CAL_603_0 "карта #603 10x8: N × ? [1/2]" MAP 0x0806B9FC RL_FNC_UWORD 0 CM_RAW 0 65535
 /begin AXIS_DESCR COM_AXIS AXIN_04B_N CM_RPM2 8 0 32767.5 AXIS_PTS_REF AX_04B_N /end AXIS_DESCR
 /begin AXIS_DESCR COM_AXIS AXIN_04D CM_RAW 10 0 65535 AXIS_PTS_REF AX_04D /end AXIS_DESCR
/end CHARACTERISTIC
/begin CHARACTERISTIC CAL_603_1 "карта #603 10x8: N × ? [2/2]" MAP 0x0806BA9C RL_FNC_UWORD 0 CM_RAW 0 65535
 /begin AXIS_DESCR COM_AXIS AXIN_04B_N CM_RPM2 8 0 32767.5 AXIS_PTS_REF AX_04B_N /end AXIS_DESCR
 /begin AXIS_DESCR COM_AXIS AXIN_04D CM_RAW 10 0 65535 AXIS_PTS_REF AX_04D /end AXIS_DESCR
/end CHARACTERISTIC
/begin CHARACTERISTIC CAL_604 "массив #604" VAL_BLK 0x0806BB44 RL_FNC_SBYTE 0 CM_RAW -128 127 MATRIX_DIM 2 1 1 /end CHARACTERISTIC
/begin CHARACTERISTIC CAL_605 "массив #605" VAL_BLK 0x0806BB48 RL_FNC_SBYTE 0 CM_RAW -128 127 MATRIX_DIM 2 1 1 /end CHARACTERISTIC
/begin CHARACTERISTIC CAL_606 "массив #606" VAL_BLK 0x0806BC80 RL_FNC_UWORD 0 CM_RAW 0 65535 MATRIX_DIM 2 1 1 /end CHARACTERISTIC
/begin CHARACTERISTIC CAL_607 "массив #607" VAL_BLK 0x0806BC88 RL_FNC_UWORD 0 CM_RAW 0 65535 MATRIX_DIM 2 1 1 /end CHARACTERISTIC
/begin CHARACTERISTIC CAL_609 "значение #609" VALUE 0x0806BB3C RL_FNC_UWORD 0 CM_RAW 0 65535 /end CHARACTERISTIC
/begin CHARACTERISTIC CAL_60A "значение #60A" VALUE 0x0806BC18 RL_FNC_UWORD 0 CM_RAW 0 65535 /end CHARACTERISTIC
/begin CHARACTERISTIC CAL_60B "значение #60B" VALUE 0x0806BC1A RL_FNC_UWORD 0 CM_RAW 0 65535 /end CHARACTERISTIC
/begin CHARACTERISTIC CAL_60D "карта #60D 10x10: N × LOAD" MAP 0x0806BCBC RL_FNC_UWORD 0 CM_RAW 0 65535
 /begin AXIS_DESCR COM_AXIS AXIN_00C_N CM_RPM2 10 0 32767.5 AXIS_PTS_REF AX_00C_N /end AXIS_DESCR
 /begin AXIS_DESCR COM_AXIS AXIN_01E_LOAD CM_RAW 10 0 65535 AXIS_PTS_REF AX_01E_LOAD /end AXIS_DESCR
/end CHARACTERISTIC
/begin CHARACTERISTIC CAL_60E "значение #60E" VALUE 0x0806BD84 RL_FNC_SBYTE 0 CM_RAW -128 127 /end CHARACTERISTIC
/begin CHARACTERISTIC CAL_60F "массив #60F" VAL_BLK 0x0806BDA8 RL_FNC_UWORD 0 CM_RAW 0 65535 MATRIX_DIM 2 1 1 /end CHARACTERISTIC
/begin CHARACTERISTIC CAL_610 "значение #610" VALUE 0x0806BDAC RL_FNC_UWORD 0 CM_RAW 0 65535 /end CHARACTERISTIC
/begin CHARACTERISTIC CAL_611 "карта #611 2x9: ? × ?" MAP 0x0806BD94 RL_FNC_SBYTE 0 CM_RAW -128 127 /begin AXIS_DESCR COM_AXIS AXIN_070 CM_RAW 9 -128 127 AXIS_PTS_REF AX_070 /end AXIS_DESCR /begin AXIS_DESCR COM_AXIS AXIN_0A8 CM_RAW 2 -128 127 AXIS_PTS_REF AX_0A8 /end AXIS_DESCR /end CHARACTERISTIC
/begin CHARACTERISTIC CAL_612 "карта #612 2x6: ? × ?" MAP 0x0806BD88 RL_FNC_SBYTE 0 CM_RAW -128 127 /begin AXIS_DESCR COM_AXIS AXIN_071 CM_RAW 6 -128 127 AXIS_PTS_REF AX_071 /end AXIS_DESCR /begin AXIS_DESCR COM_AXIS AXIN_0A8 CM_RAW 2 -128 127 AXIS_PTS_REF AX_0A8 /end AXIS_DESCR /end CHARACTERISTIC
/begin CHARACTERISTIC CAL_613 "значение #613" VALUE 0x0806BD86 RL_FNC_UWORD 0 CM_RAW 0 65535 /end CHARACTERISTIC
/begin CHARACTERISTIC CAL_614 "значение #614" VALUE 0x0806BDA6 RL_FNC_UWORD 0 CM_RAW 0 65535 /end CHARACTERISTIC
/begin CHARACTERISTIC CAL_616 "массив #616 [знак по значениям]" VAL_BLK 0x08062E68 RL_FNC_SWORD 0 CM_RAW -32768 32767 MATRIX_DIM 2 1 1 /end CHARACTERISTIC
/begin CHARACTERISTIC CAL_617 "значение #617" VALUE 0x08062E6E RL_FNC_SBYTE 0 CM_RAW -128 127 /end CHARACTERISTIC
/begin CHARACTERISTIC CAL_618 "карта #618 5x9: ? × ?" MAP 0x08062E90 RL_FNC_SBYTE 0 CM_RAW -128 127 /begin AXIS_DESCR COM_AXIS AXIN_070 CM_RAW 9 -128 127 AXIS_PTS_REF AX_070 /end AXIS_DESCR /begin AXIS_DESCR COM_AXIS AXIN_0A9 CM_RAW 5 -128 127 AXIS_PTS_REF AX_0A9 /end AXIS_DESCR /end CHARACTERISTIC
/begin CHARACTERISTIC CAL_619 "карта #619 5x6: ? × ?" MAP 0x08062E70 RL_FNC_SBYTE 0 CM_RAW -128 127 /begin AXIS_DESCR COM_AXIS AXIN_071 CM_RAW 6 -128 127 AXIS_PTS_REF AX_071 /end AXIS_DESCR /begin AXIS_DESCR COM_AXIS AXIN_0A9 CM_RAW 5 -128 127 AXIS_PTS_REF AX_0A9 /end AXIS_DESCR /end CHARACTERISTIC
/begin CHARACTERISTIC CAL_61A "массив #61A [знак по значениям]" VAL_BLK 0x08062EC0 RL_FNC_SWORD 0 CM_RAW -32768 32767 MATRIX_DIM 2 1 1 /end CHARACTERISTIC
/begin CHARACTERISTIC CAL_61B "массив #61B" VAL_BLK 0x08062EC4 RL_FNC_UWORD 0 CM_RAW 0 65535 MATRIX_DIM 3 1 1 /end CHARACTERISTIC
/begin CHARACTERISTIC CAL_61C "значение #61C" VALUE 0x08062ECA RL_FNC_UWORD 0 CM_RAW 0 65535 /end CHARACTERISTIC
/begin CHARACTERISTIC CAL_61F "массив #61F" VAL_BLK 0x08068FE8 RL_FNC_SWORD 0 CM_RAW -32768 32767 MATRIX_DIM 17 1 1 /end CHARACTERISTIC
/begin CHARACTERISTIC CAL_620 "значение #620" VALUE 0x0807499D RL_FNC_SBYTE 0 CM_RAW -128 127 /end CHARACTERISTIC
/begin CHARACTERISTIC CAL_621 "значение #621" VALUE 0x0807499E RL_FNC_SBYTE 0 CM_RAW -128 127 /end CHARACTERISTIC
/begin CHARACTERISTIC CAL_625 "значение #625" VALUE 0x0806E8EE RL_FNC_UWORD 0 CM_RAW 0 65535 /end CHARACTERISTIC
/begin CHARACTERISTIC CAL_626 "массив #626" VAL_BLK 0x0806E8F0 RL_FNC_UWORD 0 CM_RAW 0 65535 MATRIX_DIM 2 1 1 /end CHARACTERISTIC
/begin CHARACTERISTIC CAL_627 "значение #627" VALUE 0x0806E91E RL_FNC_UWORD 0 CM_RAW 0 65535 /end CHARACTERISTIC
/begin CHARACTERISTIC CAL_628 "кривая #628 14: ?" CURVE 0x0806E920 RL_FNC_UWORD 0 CM_RAW 0 65535 /begin AXIS_DESCR COM_AXIS AXIN_0AA CM_RAW 14 0 65535 AXIS_PTS_REF AX_0AA /end AXIS_DESCR /end CHARACTERISTIC
/begin CHARACTERISTIC CAL_629 "кривая #629 21: ?" CURVE 0x0806E8F4 RL_FNC_UWORD 0 CM_RAW 0 65535 /begin AXIS_DESCR COM_AXIS AXIN_00E CM_RAW 21 0 65535 AXIS_PTS_REF AX_00E /end AXIS_DESCR /end CHARACTERISTIC
/begin CHARACTERISTIC CAL_62A "значение #62A" VALUE 0x0806E93E RL_FNC_UWORD 0 CM_RAW 0 65535 /end CHARACTERISTIC
/begin CHARACTERISTIC CAL_62B "карта #62B 10x10: N × LOAD" MAP 0x0806E940 RL_FNC_UWORD 0 CM_RAW 0 65535
 /begin AXIS_DESCR COM_AXIS AXIN_00C_N CM_RPM2 10 0 32767.5 AXIS_PTS_REF AX_00C_N /end AXIS_DESCR
 /begin AXIS_DESCR COM_AXIS AXIN_01E_LOAD CM_RAW 10 0 65535 AXIS_PTS_REF AX_01E_LOAD /end AXIS_DESCR
/end CHARACTERISTIC
/begin CHARACTERISTIC CAL_62C "значение #62C" VALUE 0x0806E93C RL_FNC_UWORD 0 CM_RAW 0 65535 /end CHARACTERISTIC
/begin CHARACTERISTIC CAL_62D "массив #62D" VAL_BLK 0x0806EA08 RL_FNC_UWORD 0 CM_RAW 0 65535 MATRIX_DIM 2 1 1 /end CHARACTERISTIC
/begin CHARACTERISTIC CAL_62E "кривая #62E 6: ?" CURVE 0x0806EA0C RL_FNC_UWORD 0 CM_RAW 0 65535 /begin AXIS_DESCR COM_AXIS AXIN_0AB CM_RAW 6 0 65535 AXIS_PTS_REF AX_0AB /end AXIS_DESCR /end CHARACTERISTIC
/begin CHARACTERISTIC CAL_62F "кривая #62F 6: ?" CURVE 0x0806EA18 RL_FNC_UWORD 0 CM_RAW 0 65535 /begin AXIS_DESCR COM_AXIS AXIN_0AB CM_RAW 6 0 65535 AXIS_PTS_REF AX_0AB /end AXIS_DESCR /end CHARACTERISTIC
/begin CHARACTERISTIC CAL_630 "значение #630" VALUE 0x0806EA24 RL_FNC_UWORD 0 CM_RAW 0 65535 /end CHARACTERISTIC
/begin CHARACTERISTIC CAL_631 "массив #631" VAL_BLK 0x0806EA28 RL_FNC_UWORD 0 CM_RAW 0 65535 MATRIX_DIM 2 1 1 /end CHARACTERISTIC
/begin CHARACTERISTIC CAL_632 "значение #632" VALUE 0x0806EA2C RL_FNC_UWORD 0 CM_RAW 0 65535 /end CHARACTERISTIC
/begin CHARACTERISTIC CAL_633 "кривая #633 8: TAIR" CURVE 0x0806EA30 RL_FNC_UWORD 0 CM_RAW 0 65535
 /begin AXIS_DESCR COM_AXIS AXIN_049_TAIR CM_C128 8 -256 255.992 AXIS_PTS_REF AX_049_TAIR /end AXIS_DESCR
/end CHARACTERISTIC
/begin CHARACTERISTIC CAL_634 "значение #634" VALUE 0x0806EA40 RL_FNC_UWORD 0 CM_RAW 0 65535 /end CHARACTERISTIC
/begin CHARACTERISTIC CAL_635 "массив #635" VAL_BLK 0x0806EA44 RL_FNC_UWORD 0 CM_RAW 0 65535 MATRIX_DIM 2 1 1 /end CHARACTERISTIC
/begin CHARACTERISTIC CAL_636 "значение #636" VALUE 0x0806EA48 RL_FNC_SBYTE 0 CM_RAW -128 127 /end CHARACTERISTIC
/begin CHARACTERISTIC CAL_637 "значение #637" VALUE 0x0806EA4C RL_FNC_UWORD 0 CM_RAW 0 65535 /end CHARACTERISTIC
/begin CHARACTERISTIC CAL_638 "значение #638" VALUE 0x0806EA4A RL_FNC_UWORD 0 CM_RAW 0 65535 /end CHARACTERISTIC
/begin CHARACTERISTIC CAL_639 "значение #639" VALUE 0x0806EA50 RL_FNC_UWORD 0 CM_RAW 0 65535 /end CHARACTERISTIC
/begin CHARACTERISTIC CAL_63A "значение #63A" VALUE 0x0806EA4E RL_FNC_UWORD 0 CM_RAW 0 65535 /end CHARACTERISTIC
/begin CHARACTERISTIC CAL_63B "значение #63B" VALUE 0x0806EA52 RL_FNC_UWORD 0 CM_RAW 0 65535 /end CHARACTERISTIC
/begin CHARACTERISTIC CAL_63C "значение #63C" VALUE 0x0806EA54 RL_FNC_UWORD 0 CM_RAW 0 65535 /end CHARACTERISTIC
/begin CHARACTERISTIC CAL_63D "значение #63D" VALUE 0x0806EA56 RL_FNC_UWORD 0 CM_RAW 0 65535 /end CHARACTERISTIC
/begin CHARACTERISTIC CAL_63E "значение #63E" VALUE 0x0806EA5A RL_FNC_UWORD 0 CM_RAW 0 65535 /end CHARACTERISTIC
/begin CHARACTERISTIC CAL_63F "значение #63F" VALUE 0x0806EA58 RL_FNC_UWORD 0 CM_RAW 0 65535 /end CHARACTERISTIC
/begin CHARACTERISTIC CAL_640 "массив #640" VAL_BLK 0x0806EA5C RL_FNC_UWORD 0 CM_RAW 0 65535 MATRIX_DIM 3 1 1 /end CHARACTERISTIC
/begin CHARACTERISTIC CAL_641 "значение #641" VALUE 0x0806EA62 RL_FNC_UWORD 0 CM_RAW 0 65535 /end CHARACTERISTIC
/begin CHARACTERISTIC CAL_642 "массив #642" VAL_BLK 0x0806EA64 RL_FNC_UWORD 0 CM_RAW 0 65535 MATRIX_DIM 2 1 1 /end CHARACTERISTIC
/begin CHARACTERISTIC CAL_643_0 "кривая #643 8: TAIR [1/2]" CURVE 0x0806EA6C RL_FNC_UWORD 0 CM_RAW 0 65535
 /begin AXIS_DESCR COM_AXIS AXIN_049_TAIR CM_C128 8 -256 255.992 AXIS_PTS_REF AX_049_TAIR /end AXIS_DESCR
/end CHARACTERISTIC
/begin CHARACTERISTIC CAL_643_1 "кривая #643 8: TAIR [2/2]" CURVE 0x0806EA7C RL_FNC_UWORD 0 CM_RAW 0 65535
 /begin AXIS_DESCR COM_AXIS AXIN_049_TAIR CM_C128 8 -256 255.992 AXIS_PTS_REF AX_049_TAIR /end AXIS_DESCR
/end CHARACTERISTIC
/begin CHARACTERISTIC CAL_644 "значение #644" VALUE 0x0806EA68 RL_FNC_UWORD 0 CM_RAW 0 65535 /end CHARACTERISTIC
/begin CHARACTERISTIC CAL_645 "значение #645" VALUE 0x0806EA8C RL_FNC_UWORD 0 CM_RAW 0 65535 /end CHARACTERISTIC
/begin CHARACTERISTIC CAL_646 "массив #646" VAL_BLK 0x0806EA90 RL_FNC_UWORD 0 CM_RAW 0 65535 MATRIX_DIM 2 1 1 /end CHARACTERISTIC
/begin CHARACTERISTIC CAL_647 "значение #647" VALUE 0x0806EA94 RL_FNC_UWORD 0 CM_RAW 0 65535 /end CHARACTERISTIC
/begin CHARACTERISTIC CAL_648 "массив #648" VAL_BLK 0x0806EA98 RL_FNC_UWORD 0 CM_RAW 0 65535 MATRIX_DIM 2 1 1 /end CHARACTERISTIC
/begin CHARACTERISTIC CAL_649 "массив #649" VAL_BLK 0x0806EA9C RL_FNC_UWORD 0 CM_RAW 0 65535 MATRIX_DIM 2 1 1 /end CHARACTERISTIC
/begin CHARACTERISTIC CAL_64A_0 "кривая #64A 8: TAIR [1/2]" CURVE 0x0806EAA0 RL_FNC_UWORD 0 CM_RAW 0 65535
 /begin AXIS_DESCR COM_AXIS AXIN_049_TAIR CM_C128 8 -256 255.992 AXIS_PTS_REF AX_049_TAIR /end AXIS_DESCR
/end CHARACTERISTIC
/begin CHARACTERISTIC CAL_64A_1 "кривая #64A 8: TAIR [2/2]" CURVE 0x0806EAB0 RL_FNC_UWORD 0 CM_RAW 0 65535
 /begin AXIS_DESCR COM_AXIS AXIN_049_TAIR CM_C128 8 -256 255.992 AXIS_PTS_REF AX_049_TAIR /end AXIS_DESCR
/end CHARACTERISTIC
/begin CHARACTERISTIC CAL_64B "значение #64B" VALUE 0x0806E8C6 RL_FNC_UWORD 0 CM_RAW 0 65535 /end CHARACTERISTIC
/begin CHARACTERISTIC CAL_64C "массив #64C" VAL_BLK 0x0806E8C8 RL_FNC_UWORD 0 CM_RAW 0 65535 MATRIX_DIM 2 1 1 /end CHARACTERISTIC
/begin CHARACTERISTIC CAL_64D "значение #64D" VALUE 0x0806E8CC RL_FNC_UWORD 0 CM_RAW 0 65535 /end CHARACTERISTIC
/begin CHARACTERISTIC CAL_64E "массив #64E" VAL_BLK 0x0806E8E8 RL_FNC_UWORD 0 CM_RAW 0 65535 MATRIX_DIM 2 1 1 /end CHARACTERISTIC
/begin CHARACTERISTIC CAL_64F "значение #64F" VALUE 0x0806E8E6 RL_FNC_UWORD 0 CM_RAW 0 65535 /end CHARACTERISTIC
/begin CHARACTERISTIC CAL_650 "значение #650" VALUE 0x0806E8EC RL_FNC_UWORD 0 CM_RAW 0 65535 /end CHARACTERISTIC
/begin CHARACTERISTIC CAL_654 "массив #654" VAL_BLK 0x0806E890 RL_FNC_SBYTE 0 CM_RAW -128 127 MATRIX_DIM 2 1 1 /end CHARACTERISTIC
/begin CHARACTERISTIC CAL_655 "массив #655" VAL_BLK 0x0806E894 RL_FNC_UWORD 0 CM_RAW 0 65535 MATRIX_DIM 2 1 1 /end CHARACTERISTIC
/begin CHARACTERISTIC CAL_656 "массив #656" VAL_BLK 0x0806E8C0 RL_FNC_UWORD 0 CM_RAW 0 65535 MATRIX_DIM 2 1 1 /end CHARACTERISTIC
/begin CHARACTERISTIC CAL_657 "значение #657" VALUE 0x0806E8C4 RL_FNC_SBYTE 0 CM_RAW -128 127 /end CHARACTERISTIC
/begin CHARACTERISTIC CAL_658 "массив #658" VAL_BLK 0x0806E8BC RL_FNC_SBYTE 0 CM_RAW -128 127 MATRIX_DIM 2 1 1 /end CHARACTERISTIC
/begin CHARACTERISTIC CAL_659_0 "карта #659 10x10: N × LOAD [1/2]" MAP 0x0806FD70 RL_FNC_UWORD 0 CM_RAW 0 65535
 /begin AXIS_DESCR COM_AXIS AXIN_00C_N CM_RPM2 10 0 32767.5 AXIS_PTS_REF AX_00C_N /end AXIS_DESCR
 /begin AXIS_DESCR COM_AXIS AXIN_01E_LOAD CM_RAW 10 0 65535 AXIS_PTS_REF AX_01E_LOAD /end AXIS_DESCR
/end CHARACTERISTIC
/begin CHARACTERISTIC CAL_659_1 "карта #659 10x10: N × LOAD [2/2]" MAP 0x0806FE38 RL_FNC_UWORD 0 CM_RAW 0 65535
 /begin AXIS_DESCR COM_AXIS AXIN_00C_N CM_RPM2 10 0 32767.5 AXIS_PTS_REF AX_00C_N /end AXIS_DESCR
 /begin AXIS_DESCR COM_AXIS AXIN_01E_LOAD CM_RAW 10 0 65535 AXIS_PTS_REF AX_01E_LOAD /end AXIS_DESCR
/end CHARACTERISTIC
/begin CHARACTERISTIC CAL_65A_0 "карта #65A 10x10: N × LOAD [1/2]" MAP 0x0806FF00 RL_FNC_UWORD 0 CM_RAW 0 65535
 /begin AXIS_DESCR COM_AXIS AXIN_00C_N CM_RPM2 10 0 32767.5 AXIS_PTS_REF AX_00C_N /end AXIS_DESCR
 /begin AXIS_DESCR COM_AXIS AXIN_01E_LOAD CM_RAW 10 0 65535 AXIS_PTS_REF AX_01E_LOAD /end AXIS_DESCR
/end CHARACTERISTIC
/begin CHARACTERISTIC CAL_65A_1 "карта #65A 10x10: N × LOAD [2/2]" MAP 0x0806FFC8 RL_FNC_UWORD 0 CM_RAW 0 65535
 /begin AXIS_DESCR COM_AXIS AXIN_00C_N CM_RPM2 10 0 32767.5 AXIS_PTS_REF AX_00C_N /end AXIS_DESCR
 /begin AXIS_DESCR COM_AXIS AXIN_01E_LOAD CM_RAW 10 0 65535 AXIS_PTS_REF AX_01E_LOAD /end AXIS_DESCR
/end CHARACTERISTIC
/begin CHARACTERISTIC CAL_65B_0 "карта #65B 10x10: N × LOAD [1/2]" MAP 0x08070090 RL_FNC_UWORD 0 CM_RAW 0 65535
 /begin AXIS_DESCR COM_AXIS AXIN_00C_N CM_RPM2 10 0 32767.5 AXIS_PTS_REF AX_00C_N /end AXIS_DESCR
 /begin AXIS_DESCR COM_AXIS AXIN_01E_LOAD CM_RAW 10 0 65535 AXIS_PTS_REF AX_01E_LOAD /end AXIS_DESCR
/end CHARACTERISTIC
/begin CHARACTERISTIC CAL_65B_1 "карта #65B 10x10: N × LOAD [2/2]" MAP 0x08070158 RL_FNC_UWORD 0 CM_RAW 0 65535
 /begin AXIS_DESCR COM_AXIS AXIN_00C_N CM_RPM2 10 0 32767.5 AXIS_PTS_REF AX_00C_N /end AXIS_DESCR
 /begin AXIS_DESCR COM_AXIS AXIN_01E_LOAD CM_RAW 10 0 65535 AXIS_PTS_REF AX_01E_LOAD /end AXIS_DESCR
/end CHARACTERISTIC
/begin CHARACTERISTIC CAL_65C_0 "кривая #65C 16: TCOOL [1/2]" CURVE 0x0806FBF0 RL_FNC_UWORD 0 CM_RAW 0 65535
 /begin AXIS_DESCR COM_AXIS AXIN_004_TCOOL CM_C128 16 -256 255.992 AXIS_PTS_REF AX_004_TCOOL /end AXIS_DESCR
/end CHARACTERISTIC
/begin CHARACTERISTIC CAL_65C_1 "кривая #65C 16: TCOOL [2/2]" CURVE 0x0806FC10 RL_FNC_UWORD 0 CM_RAW 0 65535
 /begin AXIS_DESCR COM_AXIS AXIN_004_TCOOL CM_C128 16 -256 255.992 AXIS_PTS_REF AX_004_TCOOL /end AXIS_DESCR
/end CHARACTERISTIC
/begin CHARACTERISTIC CAL_65D_0 "кривая #65D 16: TAIR [1/2]" CURVE 0x0806FC30 RL_FNC_UWORD 0 CM_RAW 0 65535
 /begin AXIS_DESCR COM_AXIS AXIN_002_TAIR CM_C128 16 -256 255.992 AXIS_PTS_REF AX_002_TAIR /end AXIS_DESCR
/end CHARACTERISTIC
/begin CHARACTERISTIC CAL_65D_1 "кривая #65D 16: TAIR [2/2]" CURVE 0x0806FC50 RL_FNC_UWORD 0 CM_RAW 0 65535
 /begin AXIS_DESCR COM_AXIS AXIN_002_TAIR CM_C128 16 -256 255.992 AXIS_PTS_REF AX_002_TAIR /end AXIS_DESCR
/end CHARACTERISTIC
/begin CHARACTERISTIC CAL_65E_0 "кривая #65E 16: TCOOL [1/2]" CURVE 0x0806FC70 RL_FNC_UWORD 0 CM_RAW 0 65535
 /begin AXIS_DESCR COM_AXIS AXIN_004_TCOOL CM_C128 16 -256 255.992 AXIS_PTS_REF AX_004_TCOOL /end AXIS_DESCR
/end CHARACTERISTIC
/begin CHARACTERISTIC CAL_65E_1 "кривая #65E 16: TCOOL [2/2]" CURVE 0x0806FC90 RL_FNC_UWORD 0 CM_RAW 0 65535
 /begin AXIS_DESCR COM_AXIS AXIN_004_TCOOL CM_C128 16 -256 255.992 AXIS_PTS_REF AX_004_TCOOL /end AXIS_DESCR
/end CHARACTERISTIC
/begin CHARACTERISTIC CAL_65F_0 "кривая #65F 16: TAIR [1/2]" CURVE 0x0806FCB0 RL_FNC_UWORD 0 CM_RAW 0 65535
 /begin AXIS_DESCR COM_AXIS AXIN_002_TAIR CM_C128 16 -256 255.992 AXIS_PTS_REF AX_002_TAIR /end AXIS_DESCR
/end CHARACTERISTIC
/begin CHARACTERISTIC CAL_65F_1 "кривая #65F 16: TAIR [2/2]" CURVE 0x0806FCD0 RL_FNC_UWORD 0 CM_RAW 0 65535
 /begin AXIS_DESCR COM_AXIS AXIN_002_TAIR CM_C128 16 -256 255.992 AXIS_PTS_REF AX_002_TAIR /end AXIS_DESCR
/end CHARACTERISTIC
/begin CHARACTERISTIC CAL_660_0 "кривая #660 16: TCOOL [1/2]" CURVE 0x0806FCF0 RL_FNC_UWORD 0 CM_RAW 0 65535
 /begin AXIS_DESCR COM_AXIS AXIN_004_TCOOL CM_C128 16 -256 255.992 AXIS_PTS_REF AX_004_TCOOL /end AXIS_DESCR
/end CHARACTERISTIC
/begin CHARACTERISTIC CAL_660_1 "кривая #660 16: TCOOL [2/2]" CURVE 0x0806FD10 RL_FNC_UWORD 0 CM_RAW 0 65535
 /begin AXIS_DESCR COM_AXIS AXIN_004_TCOOL CM_C128 16 -256 255.992 AXIS_PTS_REF AX_004_TCOOL /end AXIS_DESCR
/end CHARACTERISTIC
/begin CHARACTERISTIC CAL_661_0 "кривая #661 16: TAIR [1/2]" CURVE 0x0806FD30 RL_FNC_UWORD 0 CM_RAW 0 65535
 /begin AXIS_DESCR COM_AXIS AXIN_002_TAIR CM_C128 16 -256 255.992 AXIS_PTS_REF AX_002_TAIR /end AXIS_DESCR
/end CHARACTERISTIC
/begin CHARACTERISTIC CAL_661_1 "кривая #661 16: TAIR [2/2]" CURVE 0x0806FD50 RL_FNC_UWORD 0 CM_RAW 0 65535
 /begin AXIS_DESCR COM_AXIS AXIN_002_TAIR CM_C128 16 -256 255.992 AXIS_PTS_REF AX_002_TAIR /end AXIS_DESCR
/end CHARACTERISTIC
/begin CHARACTERISTIC CAL_662_0 "карта #662 9x18: ? × TCOOL [1/2]" MAP 0x0806F968 RL_FNC_UWORD 0 CM_RAW 0 65535 /begin AXIS_DESCR COM_AXIS AXIN_076 CM_RAW 18 0 65535 AXIS_PTS_REF AX_076 /end AXIS_DESCR
 /begin AXIS_DESCR COM_AXIS AXIN_045_TCOOL CM_C128 9 -256 255.992 AXIS_PTS_REF AX_045_TCOOL /end AXIS_DESCR
/end CHARACTERISTIC
/begin CHARACTERISTIC CAL_662_1 "карта #662 9x18: ? × TCOOL [2/2]" MAP 0x0806FAAC RL_FNC_UWORD 0 CM_RAW 0 65535 /begin AXIS_DESCR COM_AXIS AXIN_076 CM_RAW 18 0 65535 AXIS_PTS_REF AX_076 /end AXIS_DESCR
 /begin AXIS_DESCR COM_AXIS AXIN_045_TCOOL CM_C128 9 -256 255.992 AXIS_PTS_REF AX_045_TCOOL /end AXIS_DESCR
/end CHARACTERISTIC
/begin CHARACTERISTIC CAL_663_0 "кривая #663 17: N [1/2]" CURVE 0x08070220 RL_FNC_SBYTE 0 CM_RAW -128 127
 /begin AXIS_DESCR COM_AXIS AXIN_001_N CM_RPM2 17 0 32767.5 AXIS_PTS_REF AX_001_N /end AXIS_DESCR
/end CHARACTERISTIC
/begin CHARACTERISTIC CAL_663_1 "кривая #663 17: N [2/2]" CURVE 0x08070231 RL_FNC_SBYTE 0 CM_RAW -128 127
 /begin AXIS_DESCR COM_AXIS AXIN_001_N CM_RPM2 17 0 32767.5 AXIS_PTS_REF AX_001_N /end AXIS_DESCR
/end CHARACTERISTIC
/begin CHARACTERISTIC CAL_664 "значение #664" VALUE 0x08070242 RL_FNC_UWORD 0 CM_RAW 0 65535 /end CHARACTERISTIC
/begin CHARACTERISTIC CAL_665 "массив #665" VAL_BLK 0x08070244 RL_FNC_UWORD 0 CM_RAW 0 65535 MATRIX_DIM 2 1 1 /end CHARACTERISTIC
/begin CHARACTERISTIC CAL_666 "массив #666" VAL_BLK 0x08070248 RL_FNC_UWORD 0 CM_RAW 0 65535 MATRIX_DIM 2 1 1 /end CHARACTERISTIC
/begin CHARACTERISTIC CAL_667 "массив #667" VAL_BLK 0x0807024C RL_FNC_UWORD 0 CM_RAW 0 65535 MATRIX_DIM 2 1 1 /end CHARACTERISTIC
/begin CHARACTERISTIC CAL_668 "значение #668" VALUE 0x08070250 RL_FNC_SWORD 0 CM_RAW -32768 32767 /end CHARACTERISTIC
/begin CHARACTERISTIC CAL_66B "значение #66B" VALUE 0x08070252 RL_FNC_SBYTE 0 CM_RAW -128 127 /end CHARACTERISTIC
/begin CHARACTERISTIC CAL_66E "значение #66E" VALUE 0x08070253 RL_FNC_SBYTE 0 CM_RAW -128 127 /end CHARACTERISTIC
/begin CHARACTERISTIC CAL_670 "значение #670" VALUE 0x08070255 RL_FNC_SBYTE 0 CM_RAW -128 127 /end CHARACTERISTIC
/begin CHARACTERISTIC CAL_671 "значение #671" VALUE 0x08070256 RL_FNC_SBYTE 0 CM_RAW -128 127 /end CHARACTERISTIC
/begin CHARACTERISTIC CAL_672 "значение #672" VALUE 0x080702D0 RL_FNC_UWORD 0 CM_RAW 0 65535 /end CHARACTERISTIC
/begin CHARACTERISTIC CAL_673 "значение #673" VALUE 0x08070318 RL_FNC_SBYTE 0 CM_RAW -128 127 /end CHARACTERISTIC
/begin CHARACTERISTIC CAL_674_0 "кривая #674 10: N [1/2]" CURVE 0x080702A0 RL_FNC_UWORD 0 CM_RAW 0 65535
 /begin AXIS_DESCR COM_AXIS AXIN_00C_N CM_RPM2 10 0 32767.5 AXIS_PTS_REF AX_00C_N /end AXIS_DESCR
/end CHARACTERISTIC
/begin CHARACTERISTIC CAL_674_1 "кривая #674 10: N [2/2]" CURVE 0x080702B4 RL_FNC_UWORD 0 CM_RAW 0 65535
 /begin AXIS_DESCR COM_AXIS AXIN_00C_N CM_RPM2 10 0 32767.5 AXIS_PTS_REF AX_00C_N /end AXIS_DESCR
/end CHARACTERISTIC
/begin CHARACTERISTIC CAL_676 "массив #676" VAL_BLK 0x080702C8 RL_FNC_SBYTE 0 CM_RAW -128 127 MATRIX_DIM 7 1 1 /end CHARACTERISTIC
/end MODULE
/end PROJECT
