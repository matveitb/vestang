ASAP2_VERSION 1 60
/begin PROJECT M74_9 "ИТЭЛМА M74.9, сгенерировано tools/mka2l.py"
/begin HEADER "из таблицы дескрипторов @0x41564, 2545 записей" VERSION "I865BB02_w2345b3" /end HEADER
/begin MODULE I865BB02_w2345b3 "I865BB02_w2345b3"
/begin MOD_COMMON "" BYTE_ORDER MSB_LAST ALIGNMENT_BYTE 1 ALIGNMENT_WORD 1 ALIGNMENT_LONG 1 /end MOD_COMMON
/begin COMPU_METHOD CM_RAW "сырое значение" RAT_FUNC "%.3" "" COEFFS 0 1 0 0 0 1 /end COMPU_METHOD
/begin COMPU_METHOD CM_C128 "температура, °C (сырое / 128)" RAT_FUNC "%.3" "degC" COEFFS 0 1 0 0 0 128 /end COMPU_METHOD
/begin COMPU_METHOD CM_P128 "педаль / запрос, % (сырое / 128)" RAT_FUNC "%.3" "%" COEFFS 0 1 0 0 0 128 /end COMPU_METHOD
/begin COMPU_METHOD CM_RPM2 "обороты, об/мин (сырое / 2)" RAT_FUNC "%.3" "rpm" COEFFS 0 1 0 0 0 2 /end COMPU_METHOD
/begin RECORD_LAYOUT RL_AX_UWORD_17 AXIS_PTS_X 1 UWORD INDEX_INCR DIRECT FIX_NO_AXIS_PTS_X 17 /end RECORD_LAYOUT
/begin RECORD_LAYOUT RL_AX_SWORD_16 AXIS_PTS_X 1 SWORD INDEX_INCR DIRECT FIX_NO_AXIS_PTS_X 16 /end RECORD_LAYOUT
/begin RECORD_LAYOUT RL_AX_UWORD_14 AXIS_PTS_X 1 UWORD INDEX_INCR DIRECT FIX_NO_AXIS_PTS_X 14 /end RECORD_LAYOUT
/begin RECORD_LAYOUT RL_AX_UWORD_24 AXIS_PTS_X 1 UWORD INDEX_INCR DIRECT FIX_NO_AXIS_PTS_X 24 /end RECORD_LAYOUT
/begin RECORD_LAYOUT RL_AX_UWORD_15 AXIS_PTS_X 1 UWORD INDEX_INCR DIRECT FIX_NO_AXIS_PTS_X 15 /end RECORD_LAYOUT
/begin RECORD_LAYOUT RL_AX_SBYTE_4 AXIS_PTS_X 1 SBYTE INDEX_INCR DIRECT FIX_NO_AXIS_PTS_X 4 /end RECORD_LAYOUT
/begin RECORD_LAYOUT RL_AX_SBYTE_3 AXIS_PTS_X 1 SBYTE INDEX_INCR DIRECT FIX_NO_AXIS_PTS_X 3 /end RECORD_LAYOUT
/begin RECORD_LAYOUT RL_AX_UWORD_3 AXIS_PTS_X 1 UWORD INDEX_INCR DIRECT FIX_NO_AXIS_PTS_X 3 /end RECORD_LAYOUT
/begin RECORD_LAYOUT RL_AX_SWORD_9 AXIS_PTS_X 1 SWORD INDEX_INCR DIRECT FIX_NO_AXIS_PTS_X 9 /end RECORD_LAYOUT
/begin RECORD_LAYOUT RL_AX_UWORD_9 AXIS_PTS_X 1 UWORD INDEX_INCR DIRECT FIX_NO_AXIS_PTS_X 9 /end RECORD_LAYOUT
/begin RECORD_LAYOUT RL_AX_UWORD_10 AXIS_PTS_X 1 UWORD INDEX_INCR DIRECT FIX_NO_AXIS_PTS_X 10 /end RECORD_LAYOUT
/begin RECORD_LAYOUT RL_AX_UWORD_16 AXIS_PTS_X 1 UWORD INDEX_INCR DIRECT FIX_NO_AXIS_PTS_X 16 /end RECORD_LAYOUT
/begin RECORD_LAYOUT RL_AX_UWORD_18 AXIS_PTS_X 1 UWORD INDEX_INCR DIRECT FIX_NO_AXIS_PTS_X 18 /end RECORD_LAYOUT
/begin RECORD_LAYOUT RL_AX_UWORD_6 AXIS_PTS_X 1 UWORD INDEX_INCR DIRECT FIX_NO_AXIS_PTS_X 6 /end RECORD_LAYOUT
/begin RECORD_LAYOUT RL_AX_UBYTE_2 AXIS_PTS_X 1 UBYTE INDEX_INCR DIRECT FIX_NO_AXIS_PTS_X 2 /end RECORD_LAYOUT
/begin RECORD_LAYOUT RL_AX_UWORD_12 AXIS_PTS_X 1 UWORD INDEX_INCR DIRECT FIX_NO_AXIS_PTS_X 12 /end RECORD_LAYOUT
/begin RECORD_LAYOUT RL_AX_UWORD_4 AXIS_PTS_X 1 UWORD INDEX_INCR DIRECT FIX_NO_AXIS_PTS_X 4 /end RECORD_LAYOUT
/begin RECORD_LAYOUT RL_AX_UWORD_5 AXIS_PTS_X 1 UWORD INDEX_INCR DIRECT FIX_NO_AXIS_PTS_X 5 /end RECORD_LAYOUT
/begin RECORD_LAYOUT RL_AX_UWORD_7 AXIS_PTS_X 1 UWORD INDEX_INCR DIRECT FIX_NO_AXIS_PTS_X 7 /end RECORD_LAYOUT
/begin RECORD_LAYOUT RL_AX_UWORD_8 AXIS_PTS_X 1 UWORD INDEX_INCR DIRECT FIX_NO_AXIS_PTS_X 8 /end RECORD_LAYOUT
/begin RECORD_LAYOUT RL_AX_SBYTE_2 AXIS_PTS_X 1 SBYTE INDEX_INCR DIRECT FIX_NO_AXIS_PTS_X 2 /end RECORD_LAYOUT
/begin RECORD_LAYOUT RL_AX_SWORD_8 AXIS_PTS_X 1 SWORD INDEX_INCR DIRECT FIX_NO_AXIS_PTS_X 8 /end RECORD_LAYOUT
/begin RECORD_LAYOUT RL_AX_UWORD_1 AXIS_PTS_X 1 UWORD INDEX_INCR DIRECT FIX_NO_AXIS_PTS_X 1 /end RECORD_LAYOUT
/begin RECORD_LAYOUT RL_AX_UWORD_11 AXIS_PTS_X 1 UWORD INDEX_INCR DIRECT FIX_NO_AXIS_PTS_X 11 /end RECORD_LAYOUT
/begin RECORD_LAYOUT RL_AX_SBYTE_8 AXIS_PTS_X 1 SBYTE INDEX_INCR DIRECT FIX_NO_AXIS_PTS_X 8 /end RECORD_LAYOUT
/begin RECORD_LAYOUT RL_AX_SBYTE_6 AXIS_PTS_X 1 SBYTE INDEX_INCR DIRECT FIX_NO_AXIS_PTS_X 6 /end RECORD_LAYOUT
/begin RECORD_LAYOUT RL_AX_SBYTE_9 AXIS_PTS_X 1 SBYTE INDEX_INCR DIRECT FIX_NO_AXIS_PTS_X 9 /end RECORD_LAYOUT
/begin RECORD_LAYOUT RL_AX_UBYTE_3 AXIS_PTS_X 1 UBYTE INDEX_INCR DIRECT FIX_NO_AXIS_PTS_X 3 /end RECORD_LAYOUT
/begin RECORD_LAYOUT RL_AX_UBYTE_10 AXIS_PTS_X 1 UBYTE INDEX_INCR DIRECT FIX_NO_AXIS_PTS_X 10 /end RECORD_LAYOUT
/begin RECORD_LAYOUT RL_AX_SWORD_11 AXIS_PTS_X 1 SWORD INDEX_INCR DIRECT FIX_NO_AXIS_PTS_X 11 /end RECORD_LAYOUT
/begin RECORD_LAYOUT RL_AX_SBYTE_1 AXIS_PTS_X 1 SBYTE INDEX_INCR DIRECT FIX_NO_AXIS_PTS_X 1 /end RECORD_LAYOUT
/begin RECORD_LAYOUT RL_AX_SBYTE_5 AXIS_PTS_X 1 SBYTE INDEX_INCR DIRECT FIX_NO_AXIS_PTS_X 5 /end RECORD_LAYOUT
/begin RECORD_LAYOUT RL_AX_UWORD_28 AXIS_PTS_X 1 UWORD INDEX_INCR DIRECT FIX_NO_AXIS_PTS_X 28 /end RECORD_LAYOUT
/begin RECORD_LAYOUT RL_AX_UWORD_195 AXIS_PTS_X 1 UWORD INDEX_INCR DIRECT FIX_NO_AXIS_PTS_X 195 /end RECORD_LAYOUT
/begin RECORD_LAYOUT RL_AX_SBYTE_13 AXIS_PTS_X 1 SBYTE INDEX_INCR DIRECT FIX_NO_AXIS_PTS_X 13 /end RECORD_LAYOUT
/begin RECORD_LAYOUT RL_AX_SBYTE_10 AXIS_PTS_X 1 SBYTE INDEX_INCR DIRECT FIX_NO_AXIS_PTS_X 10 /end RECORD_LAYOUT
/begin RECORD_LAYOUT RL_AX_UWORD_25 AXIS_PTS_X 1 UWORD INDEX_INCR DIRECT FIX_NO_AXIS_PTS_X 25 /end RECORD_LAYOUT
/begin RECORD_LAYOUT RL_AX_SWORD_10 AXIS_PTS_X 1 SWORD INDEX_INCR DIRECT FIX_NO_AXIS_PTS_X 10 /end RECORD_LAYOUT
/begin RECORD_LAYOUT RL_AX_UWORD_19 AXIS_PTS_X 1 UWORD INDEX_INCR DIRECT FIX_NO_AXIS_PTS_X 19 /end RECORD_LAYOUT
/begin RECORD_LAYOUT RL_AX_UWORD_42 AXIS_PTS_X 1 UWORD INDEX_INCR DIRECT FIX_NO_AXIS_PTS_X 42 /end RECORD_LAYOUT
/begin RECORD_LAYOUT RL_AX_UWORD_20 AXIS_PTS_X 1 UWORD INDEX_INCR DIRECT FIX_NO_AXIS_PTS_X 20 /end RECORD_LAYOUT
/begin RECORD_LAYOUT RL_AX_SWORD_15 AXIS_PTS_X 1 SWORD INDEX_INCR DIRECT FIX_NO_AXIS_PTS_X 15 /end RECORD_LAYOUT
/begin RECORD_LAYOUT RL_FNC_SWORD FNC_VALUES 1 SWORD ROW_DIR DIRECT /end RECORD_LAYOUT
/begin RECORD_LAYOUT RL_FNC_UWORD FNC_VALUES 1 UWORD ROW_DIR DIRECT /end RECORD_LAYOUT
/begin RECORD_LAYOUT RL_FNC_UBYTE FNC_VALUES 1 UBYTE ROW_DIR DIRECT /end RECORD_LAYOUT
/begin RECORD_LAYOUT RL_FNC_SBYTE FNC_VALUES 1 SBYTE ROW_DIR DIRECT /end RECORD_LAYOUT
/begin RECORD_LAYOUT RL_FNC_ULONG FNC_VALUES 1 ULONG ROW_DIR DIRECT /end RECORD_LAYOUT
/begin RECORD_LAYOUT RL_FNC_SLONG FNC_VALUES 1 SLONG ROW_DIR DIRECT /end RECORD_LAYOUT
/begin AXIS_PTS AX_001_N "ось #001, обороты двигателя [да (60e6/период в 0x1FD40; единица 0,5 об/мин — вероятно)]" 0x080614B4 AXIN_001_N RL_AX_UWORD_17 0 CM_RPM2 17 0 32767.5 /end AXIS_PTS
/begin AXIS_PTS AX_002_TAIR "ось #002, температура воздуха на впуске, АЦП канал 8 [вероятно]" 0x08061580 AXIN_002_TAIR RL_AX_SWORD_16 0 CM_C128 16 -256 255.992 /end AXIS_PTS
/begin AXIS_PTS AX_003_UBAT "ось #003, напряжение бортсети? (масштаб не установлен) [вероятно]" 0x08061108 AXIN_003_UBAT RL_AX_UWORD_14 0 CM_RAW 14 0 65535 /end AXIS_PTS
/begin AXIS_PTS AX_009 "ось #009" 0x08061100 AXIN_009 RL_AX_UWORD_3 0 CM_RAW 3 0 65535 /end AXIS_PTS
/begin AXIS_PTS AX_00A_TCOOL "ось #00A, температура двигателя (ОЖ), АЦП канал 9 [вероятно]" 0x0806120C AXIN_00A_TCOOL RL_AX_SWORD_9 0 CM_C128 9 -256 255.992 /end AXIS_PTS
/begin AXIS_PTS AX_00C_N "ось #00C, обороты двигателя [да (60e6/период в 0x1FD40; единица 0,5 об/мин — вероятно)]" 0x08061454 AXIN_00C_N RL_AX_UWORD_10 0 CM_RPM2 10 0 32767.5 /end AXIS_PTS
/begin AXIS_PTS AX_010 "ось #010" 0x08060290 AXIN_010 RL_AX_UWORD_18 0 CM_RAW 18 0 65535 /end AXIS_PTS
/begin AXIS_PTS AX_01B_PEDAL "ось #01B, положение педали газа [да]" 0x080610D4 AXIN_01B_PEDAL RL_AX_UWORD_16 0 CM_P128 16 0 511.992 /end AXIS_PTS
/begin AXIS_PTS AX_01E_LOAD "ось #01E, нагрузка / наполнение (0x3C28 / 0x3C30 / 0x3C34), масштаб не установлен [вероятно]" 0x08061264 AXIN_01E_LOAD RL_AX_UWORD_10 0 CM_RAW 10 0 65535 /end AXIS_PTS
/begin AXIS_PTS AX_024_LOAD "ось #024, нагрузка / наполнение (0x3C28 / 0x3C30 / 0x3C34), масштаб не установлен [вероятно]" 0x08060AAC AXIN_024_LOAD RL_AX_UWORD_16 0 CM_RAW 16 0 65535 /end AXIS_PTS
/begin AXIS_PTS AX_026_N "ось #026, обороты двигателя [да (60e6/период в 0x1FD40; единица 0,5 об/мин — вероятно)]" 0x08060B20 AXIN_026_N RL_AX_UWORD_16 0 CM_RPM2 16 0 32767.5 /end AXIS_PTS
/begin AXIS_PTS AX_027_N "ось #027, обороты двигателя [да (60e6/период в 0x1FD40; единица 0,5 об/мин — вероятно)]" 0x080606EC AXIN_027_N RL_AX_UWORD_14 0 CM_RPM2 14 0 32767.5 /end AXIS_PTS
/begin AXIS_PTS AX_028_LOAD "ось #028, нагрузка / наполнение (0x3C28 / 0x3C30 / 0x3C34), масштаб не установлен [вероятно]" 0x080606E0 AXIN_028_LOAD RL_AX_UWORD_5 0 CM_RAW 5 0 65535 /end AXIS_PTS
/begin AXIS_PTS AX_033 "ось #033" 0x08060570 AXIN_033 RL_AX_UWORD_16 0 CM_RAW 16 0 65535 /end AXIS_PTS
/begin AXIS_PTS AX_039_LOAD "ось #039, нагрузка / наполнение (0x3C28 / 0x3C30 / 0x3C34), масштаб не установлен [вероятно]" 0x08060714 AXIN_039_LOAD RL_AX_UWORD_9 0 CM_RAW 9 0 65535 /end AXIS_PTS
/begin AXIS_PTS AX_044 "ось #044" 0x080614D8 AXIN_044 RL_AX_UWORD_8 0 CM_RAW 8 0 65535 /end AXIS_PTS
/begin AXIS_PTS AX_046 "ось #046" 0x080615B4 AXIN_046 RL_AX_SBYTE_2 0 CM_RAW 2 -128 127 /end AXIS_PTS
/begin AXIS_PTS AX_047 "ось #047" 0x0806085C AXIN_047 RL_AX_SBYTE_3 0 CM_RAW 3 -128 127 /end AXIS_PTS
/begin AXIS_PTS AX_049_TAIR "ось #049, температура воздуха на впуске, АЦП канал 8 [вероятно]" 0x08061570 AXIN_049_TAIR RL_AX_SWORD_8 0 CM_C128 8 -256 255.992 /end AXIS_PTS
/begin AXIS_PTS AX_050_N "ось #050, обороты двигателя [да (60e6/период в 0x1FD40; единица 0,5 об/мин — вероятно)]" 0x0806141C AXIN_050_N RL_AX_UWORD_8 0 CM_RPM2 8 0 32767.5 /end AXIS_PTS
/begin AXIS_PTS AX_051 "ось #051" 0x080614F4 AXIN_051 RL_AX_UWORD_7 0 CM_RAW 7 0 65535 /end AXIS_PTS
/begin AXIS_PTS AX_052_N "ось #052, обороты двигателя [да (60e6/период в 0x1FD40; единица 0,5 об/мин — вероятно)]" 0x08061490 AXIN_052_N RL_AX_UWORD_17 0 CM_RPM2 17 0 32767.5 /end AXIS_PTS
/begin AXIS_PTS AX_053 "ось #053" 0x08061278 AXIN_053 RL_AX_UWORD_16 0 CM_RAW 16 0 65535 /end AXIS_PTS
/begin AXIS_PTS AX_055 "ось #055" 0x08061124 AXIN_055 RL_AX_UWORD_1 0 CM_RAW 1 0 65535 /end AXIS_PTS
/begin AXIS_PTS AX_05C "ось #05C" 0x08060008 AXIN_05C RL_AX_UWORD_8 0 CM_RAW 8 0 65535 /end AXIS_PTS
/begin AXIS_PTS AX_05D "ось #05D, индекс 0…7 (похоже, передача)" 0x08061540 AXIN_05D RL_AX_SBYTE_8 0 CM_RAW 8 -128 127 /end AXIS_PTS
/begin AXIS_PTS AX_05E_GEAR "ось #05E, номер передачи 0…7 [вероятно]" 0x08061548 AXIN_05E_GEAR RL_AX_SBYTE_8 0 CM_RAW 8 -128 127 /end AXIS_PTS
/begin AXIS_PTS AX_05F_N "ось #05F, обороты двигателя [да (60e6/период в 0x1FD40; единица 0,5 об/мин — вероятно)]" 0x08061374 AXIN_05F_N RL_AX_UWORD_17 0 CM_RPM2 17 0 32767.5 /end AXIS_PTS
/begin AXIS_PTS AX_06E "ось #06E" 0x080615C4 AXIN_06E RL_AX_UWORD_5 0 CM_RAW 5 0 65535 /end AXIS_PTS
/begin AXIS_PTS AX_070 "ось #070" 0x0806129C AXIN_070 RL_AX_SBYTE_9 0 CM_RAW 9 -128 127 /end AXIS_PTS
/begin AXIS_PTS AX_071 "ось #071" 0x080612A8 AXIN_071 RL_AX_SBYTE_6 0 CM_RAW 6 -128 127 /end AXIS_PTS
/begin AXIS_PTS AX_081 "ось #081" 0x08061338 AXIN_081 RL_AX_UWORD_14 0 CM_RAW 14 0 65535 /end AXIS_PTS
/begin AXIS_PTS AX_083 "ось #083" 0x0806018C AXIN_083 RL_AX_UBYTE_3 0 CM_RAW 3 0 255 /end AXIS_PTS
/begin AXIS_PTS AX_085 "ось #085" 0x08060180 AXIN_085 RL_AX_UBYTE_10 0 CM_RAW 10 0 255 /end AXIS_PTS
/begin AXIS_PTS AX_08B "ось #08B" 0x08060230 AXIN_08B RL_AX_SBYTE_3 0 CM_RAW 3 -128 127 /end AXIS_PTS
/begin AXIS_PTS AX_08D "ось #08D" 0x08061298 AXIN_08D RL_AX_SBYTE_1 0 CM_RAW 1 -128 127 /end AXIS_PTS
/begin AXIS_PTS AX_08E "ось #08E" 0x080612DC AXIN_08E RL_AX_UWORD_11 0 CM_RAW 11 0 65535 /end AXIS_PTS
/begin AXIS_PTS AX_091 "ось #091" 0x0806152C AXIN_091 RL_AX_UWORD_10 0 CM_RAW 10 0 65535 /end AXIS_PTS
/begin AXIS_PTS AX_092 "ось #092" 0x08061518 AXIN_092 RL_AX_UWORD_10 0 CM_RAW 10 0 65535 /end AXIS_PTS
/begin AXIS_PTS AX_093 "ось #093" 0x08060EC0 AXIN_093 RL_AX_UWORD_17 0 CM_RAW 17 0 65535 /end AXIS_PTS
/begin AXIS_PTS AX_09A "ось #09A" 0x080600A8 AXIN_09A RL_AX_UWORD_15 0 CM_RAW 15 0 65535 /end AXIS_PTS
/begin AXIS_PTS AX_0A1_N "ось #0A1, обороты двигателя [да (60e6/период в 0x1FD40; единица 0,5 об/мин — вероятно)]" 0x080604E8 AXIN_0A1_N RL_AX_UWORD_16 0 CM_RPM2 16 0 32767.5 /end AXIS_PTS
/begin AXIS_PTS AX_0A7 "ось #0A7" 0x08060860 AXIN_0A7 RL_AX_SBYTE_5 0 CM_RAW 5 -128 127 /end AXIS_PTS
/begin AXIS_PTS AX_0AC_N "ось #0AC, обороты двигателя [да (60e6/период в 0x1FD40; единица 0,5 об/мин — вероятно)]" 0x08060E50 AXIN_0AC_N RL_AX_UWORD_8 0 CM_RPM2 8 0 32767.5 /end AXIS_PTS
/begin AXIS_PTS AX_0AD_N "ось #0AD, обороты двигателя [да (60e6/период в 0x1FD40; единица 0,5 об/мин — вероятно)]" 0x08060E74 AXIN_0AD_N RL_AX_UWORD_9 0 CM_RPM2 9 0 32767.5 /end AXIS_PTS
/begin AXIS_PTS AX_0AE "ось #0AE" 0x08060E60 AXIN_0AE RL_AX_UWORD_9 0 CM_RAW 9 0 65535 /end AXIS_PTS
/begin AXIS_PTS AX_0AF "ось #0AF" 0x08060F60 AXIN_0AF RL_AX_UWORD_8 0 CM_RAW 8 0 65535 /end AXIS_PTS
/begin AXIS_PTS AX_0B0 "ось #0B0" 0x08060F50 AXIN_0B0 RL_AX_UWORD_8 0 CM_RAW 8 0 65535 /end AXIS_PTS
/begin AXIS_PTS AX_0B1_N "ось #0B1, обороты двигателя [да (60e6/период в 0x1FD40; единица 0,5 об/мин — вероятно)]" 0x08060E38 AXIN_0B1_N RL_AX_UWORD_11 0 CM_RPM2 11 0 32767.5 /end AXIS_PTS
/begin AXIS_PTS AX_0B2 "ось #0B2" 0x08060F20 AXIN_0B2 RL_AX_UWORD_12 0 CM_RAW 12 0 65535 /end AXIS_PTS
/begin AXIS_PTS AX_0B3 "ось #0B3, педаль 0…100 %" 0x08060F38 AXIN_0B3 RL_AX_UWORD_11 0 CM_P128 11 0 511.992 /end AXIS_PTS
/begin AXIS_PTS AX_0B4 "ось #0B4" 0x08060F08 AXIN_0B4 RL_AX_SWORD_11 0 CM_RAW 11 -32768 32767 /end AXIS_PTS
/begin AXIS_PTS AX_0B5 "ось #0B5" 0x08060EE4 AXIN_0B5 RL_AX_UWORD_17 0 CM_RAW 17 0 65535 /end AXIS_PTS
/begin AXIS_PTS AX_0B6 "ось #0B6" 0x08060E88 AXIN_0B6 RL_AX_UWORD_9 0 CM_RAW 9 0 65535 /end AXIS_PTS
/begin AXIS_PTS AX_0B7_LOAD "ось #0B7, нагрузка / наполнение (0x3C28 / 0x3C30 / 0x3C34), масштаб не установлен [вероятно]" 0x08060C54 AXIN_0B7_LOAD RL_AX_UWORD_17 0 CM_RAW 17 0 65535 /end AXIS_PTS
/begin AXIS_PTS AX_0B8 "ось #0B8" 0x08060C78 AXIN_0B8 RL_AX_UWORD_28 0 CM_RAW 28 0 65535 /end AXIS_PTS
/begin AXIS_PTS AX_0B9 "ось #0B9" 0x08060CB0 AXIN_0B9 RL_AX_UWORD_195 0 CM_RAW 195 0 65535 /end AXIS_PTS
/begin AXIS_PTS AX_0BA "ось #0BA" 0x08060F70 AXIN_0BA RL_AX_SBYTE_13 0 CM_RAW 13 -128 127 /end AXIS_PTS
/begin AXIS_PTS AX_0BB "ось #0BB" 0x08060F84 AXIN_0BB RL_AX_UWORD_8 0 CM_RAW 8 0 65535 /end AXIS_PTS
/begin AXIS_PTS AX_0BC "ось #0BC" 0x08060F80 AXIN_0BC RL_AX_SBYTE_2 0 CM_RAW 2 -128 127 /end AXIS_PTS
/begin AXIS_PTS AX_0BD "ось #0BD" 0x08060624 AXIN_0BD RL_AX_SBYTE_3 0 CM_RAW 3 -128 127 /end AXIS_PTS
/begin AXIS_PTS AX_0BE "ось #0BE" 0x08060684 AXIN_0BE RL_AX_SBYTE_10 0 CM_RAW 10 -128 127 /end AXIS_PTS
/begin AXIS_PTS AX_0BF "ось #0BF" 0x0806060C AXIN_0BF RL_AX_UWORD_9 0 CM_RAW 9 0 65535 /end AXIS_PTS
/begin AXIS_PTS AX_0C0 "ось #0C0" 0x08060620 AXIN_0C0 RL_AX_SBYTE_4 0 CM_RAW 4 -128 127 /end AXIS_PTS
/begin AXIS_PTS AX_0C1 "ось #0C1" 0x08060018 AXIN_0C1 RL_AX_UWORD_4 0 CM_RAW 4 0 65535 /end AXIS_PTS
/begin AXIS_PTS AX_0C2 "ось #0C2" 0x08060020 AXIN_0C2 RL_AX_UWORD_4 0 CM_RAW 4 0 65535 /end AXIS_PTS
/begin AXIS_PTS AX_0C3 "ось #0C3" 0x08060028 AXIN_0C3 RL_AX_UWORD_4 0 CM_RAW 4 0 65535 /end AXIS_PTS
/begin AXIS_PTS AX_0C4 "ось #0C4" 0x080608C8 AXIN_0C4 RL_AX_UWORD_8 0 CM_RAW 8 0 65535 /end AXIS_PTS
/begin AXIS_PTS AX_0C5_N "ось #0C5, обороты двигателя [да (60e6/период в 0x1FD40; единица 0,5 об/мин — вероятно)]" 0x08060928 AXIN_0C5_N RL_AX_UWORD_24 0 CM_RPM2 24 0 32767.5 /end AXIS_PTS
/begin AXIS_PTS AX_0C6_N "ось #0C6, обороты двигателя [да (60e6/период в 0x1FD40; единица 0,5 об/мин — вероятно)]" 0x080608F8 AXIN_0C6_N RL_AX_UWORD_24 0 CM_RPM2 24 0 32767.5 /end AXIS_PTS
/begin AXIS_PTS AX_0C7 "ось #0C7" 0x08060884 AXIN_0C7 RL_AX_UWORD_25 0 CM_RAW 25 0 65535 /end AXIS_PTS
/begin AXIS_PTS AX_0C8 "ось #0C8, педаль 0…100 %" 0x080608D8 AXIN_0C8 RL_AX_UWORD_16 0 CM_P128 16 0 511.992 /end AXIS_PTS
/begin AXIS_PTS AX_0C9 "ось #0C9" 0x080608B8 AXIN_0C9 RL_AX_UWORD_8 0 CM_RAW 8 0 65535 /end AXIS_PTS
/begin AXIS_PTS AX_0CA "ось #0CA" 0x08060384 AXIN_0CA RL_AX_UWORD_9 0 CM_RAW 9 0 65535 /end AXIS_PTS
/begin AXIS_PTS AX_0CB "ось #0CB" 0x08060374 AXIN_0CB RL_AX_UWORD_7 0 CM_RAW 7 0 65535 /end AXIS_PTS
/begin AXIS_PTS AX_0CC "ось #0CC" 0x08060448 AXIN_0CC RL_AX_UWORD_17 0 CM_RAW 17 0 65535 /end AXIS_PTS
/begin AXIS_PTS AX_0CE "ось #0CE" 0x08060190 AXIN_0CE RL_AX_SBYTE_1 0 CM_RAW 1 -128 127 /end AXIS_PTS
/begin AXIS_PTS AX_0CF "ось #0CF" 0x08060194 AXIN_0CF RL_AX_UWORD_9 0 CM_RAW 9 0 65535 /end AXIS_PTS
/begin AXIS_PTS AX_0D0 "ось #0D0" 0x080601A8 AXIN_0D0 RL_AX_SWORD_10 0 CM_RAW 10 -32768 32767 /end AXIS_PTS
/begin AXIS_PTS AX_0D1 "ось #0D1" 0x080601BC AXIN_0D1 RL_AX_UWORD_11 0 CM_RAW 11 0 65535 /end AXIS_PTS
/begin AXIS_PTS AX_0D2 "ось #0D2" 0x08060958 AXIN_0D2 RL_AX_UWORD_12 0 CM_RAW 12 0 65535 /end AXIS_PTS
/begin AXIS_PTS AX_0D3_TCOOL "ось #0D3, температура двигателя (ОЖ), АЦП канал 9 [вероятно]" 0x08061168 AXIN_0D3_TCOOL RL_AX_SWORD_16 0 CM_C128 16 -256 255.992 /end AXIS_PTS
/begin AXIS_PTS AX_0D4 "ось #0D4" 0x08060828 AXIN_0D4 RL_AX_SBYTE_2 0 CM_RAW 2 -128 127 /end AXIS_PTS
/begin AXIS_PTS AX_0D5 "ось #0D5, индекс 0…7 (похоже, передача)" 0x0806082C AXIN_0D5 RL_AX_SBYTE_8 0 CM_RAW 8 -128 127 /end AXIS_PTS
/begin AXIS_PTS AX_0D6 "ось #0D6" 0x08060B60 AXIN_0D6 RL_AX_SBYTE_3 0 CM_RAW 3 -128 127 /end AXIS_PTS
/begin AXIS_PTS AX_0D7 "ось #0D7" 0x08060420 AXIN_0D7 RL_AX_SBYTE_4 0 CM_RAW 4 -128 127 /end AXIS_PTS
/begin AXIS_PTS AX_0D8_N "ось #0D8, обороты двигателя [да (60e6/период в 0x1FD40; единица 0,5 об/мин — вероятно)]" 0x0806142C AXIN_0D8_N RL_AX_UWORD_19 0 CM_RPM2 19 0 32767.5 /end AXIS_PTS
/begin AXIS_PTS AX_0D9 "ось #0D9" 0x080612C4 AXIN_0D9 RL_AX_UWORD_11 0 CM_RAW 11 0 65535 /end AXIS_PTS
/begin AXIS_PTS AX_0DA "ось #0DA" 0x08060970 AXIN_0DA RL_AX_UWORD_42 0 CM_RAW 42 0 65535 /end AXIS_PTS
/begin AXIS_PTS AX_0DB "ось #0DB" 0x08061240 AXIN_0DB RL_AX_UWORD_17 0 CM_RAW 17 0 65535 /end AXIS_PTS
/begin AXIS_PTS AX_0DC_N "ось #0DC, обороты двигателя [да (60e6/период в 0x1FD40; единица 0,5 об/мин — вероятно)]" 0x08061398 AXIN_0DC_N RL_AX_UWORD_17 0 CM_RPM2 17 0 32767.5 /end AXIS_PTS
/begin AXIS_PTS AX_0DD "ось #0DD" 0x08061318 AXIN_0DD RL_AX_UWORD_16 0 CM_RAW 16 0 65535 /end AXIS_PTS
/begin AXIS_PTS AX_0DF "ось #0DF" 0x08060A48 AXIN_0DF RL_AX_SBYTE_2 0 CM_RAW 2 -128 127 /end AXIS_PTS
/begin AXIS_PTS AX_0E0 "ось #0E0" 0x0806087C AXIN_0E0 RL_AX_SBYTE_1 0 CM_RAW 1 -128 127 /end AXIS_PTS
/begin AXIS_PTS AX_0E1 "ось #0E1" 0x08060030 AXIN_0E1 RL_AX_SBYTE_3 0 CM_RAW 3 -128 127 /end AXIS_PTS
/begin AXIS_PTS AX_0E2 "ось #0E2" 0x08060B64 AXIN_0E2 RL_AX_SBYTE_2 0 CM_RAW 2 -128 127 /end AXIS_PTS
/begin AXIS_PTS AX_0E3 "ось #0E3" 0x08061504 AXIN_0E3 RL_AX_UWORD_9 0 CM_RAW 9 0 65535 /end AXIS_PTS
/begin AXIS_PTS AX_0E4 "ось #0E4" 0x080609C4 AXIN_0E4 RL_AX_SBYTE_2 0 CM_RAW 2 -128 127 /end AXIS_PTS
/begin AXIS_PTS AX_0E5 "ось #0E5, индекс 0…7 (похоже, передача)" 0x08060364 AXIN_0E5 RL_AX_SBYTE_8 0 CM_RAW 8 -128 127 /end AXIS_PTS
/begin AXIS_PTS AX_0E6 "ось #0E6" 0x08060E9C AXIN_0E6 RL_AX_UWORD_17 0 CM_RAW 17 0 65535 /end AXIS_PTS
/begin AXIS_PTS AX_0E7 "ось #0E7" 0x0806014C AXIN_0E7 RL_AX_SBYTE_5 0 CM_RAW 5 -128 127 /end AXIS_PTS
/begin AXIS_PTS AX_0E8 "ось #0E8" 0x0806025C AXIN_0E8 RL_AX_SBYTE_2 0 CM_RAW 2 -128 127 /end AXIS_PTS
/begin AXIS_PTS AX_0E9 "ось #0E9" 0x08060234 AXIN_0E9 RL_AX_SBYTE_2 0 CM_RAW 2 -128 127 /end AXIS_PTS
/begin AXIS_PTS AX_0EA "ось #0EA" 0x0806009C AXIN_0EA RL_AX_SBYTE_2 0 CM_RAW 2 -128 127 /end AXIS_PTS
/begin AXIS_PTS AX_0EB "ось #0EB" 0x080600A0 AXIN_0EB RL_AX_SBYTE_2 0 CM_RAW 2 -128 127 /end AXIS_PTS
/begin AXIS_PTS AX_0EC "ось #0EC" 0x08060098 AXIN_0EC RL_AX_SBYTE_4 0 CM_RAW 4 -128 127 /end AXIS_PTS
/begin AXIS_PTS AX_0ED "ось #0ED" 0x08060004 AXIN_0ED RL_AX_UBYTE_2 0 CM_RAW 2 0 255 /end AXIS_PTS
/begin AXIS_PTS AX_0EE "ось #0EE" 0x080606DC AXIN_0EE RL_AX_SBYTE_3 0 CM_RAW 3 -128 127 /end AXIS_PTS
/begin AXIS_PTS AX_0EF "ось #0EF" 0x08060418 AXIN_0EF RL_AX_SBYTE_2 0 CM_RAW 2 -128 127 /end AXIS_PTS
/begin AXIS_PTS AX_0F0 "ось #0F0" 0x0806041C AXIN_0F0 RL_AX_SBYTE_4 0 CM_RAW 4 -128 127 /end AXIS_PTS
/begin AXIS_PTS AX_0F1 "ось #0F1" 0x080605F4 AXIN_0F1 RL_AX_SBYTE_3 0 CM_RAW 3 -128 127 /end AXIS_PTS
/begin AXIS_PTS AX_0F2 "ось #0F2" 0x08060074 AXIN_0F2 RL_AX_UBYTE_10 0 CM_RAW 10 0 255 /end AXIS_PTS
/begin AXIS_PTS AX_0F3 "ось #0F3" 0x0806040C AXIN_0F3 RL_AX_SBYTE_2 0 CM_RAW 2 -128 127 /end AXIS_PTS
/begin AXIS_PTS AX_0F4 "ось #0F4" 0x08060410 AXIN_0F4 RL_AX_SBYTE_5 0 CM_RAW 5 -128 127 /end AXIS_PTS
/begin AXIS_PTS AX_0F5 "ось #0F5" 0x080602B4 AXIN_0F5 RL_AX_SBYTE_1 0 CM_RAW 1 -128 127 /end AXIS_PTS
/begin AXIS_PTS AX_0F6 "ось #0F6" 0x080602B8 AXIN_0F6 RL_AX_SBYTE_9 0 CM_RAW 9 -128 127 /end AXIS_PTS
/begin AXIS_PTS AX_0F7 "ось #0F7" 0x080602C4 AXIN_0F7 RL_AX_SBYTE_6 0 CM_RAW 6 -128 127 /end AXIS_PTS
/begin AXIS_PTS AX_0F8 "ось #0F8, индекс 0…7 (похоже, передача)" 0x08060820 AXIN_0F8 RL_AX_SBYTE_8 0 CM_RAW 8 -128 127 /end AXIS_PTS
/begin AXIS_PTS AX_0F9 "ось #0F9" 0x080607D0 AXIN_0F9 RL_AX_SBYTE_5 0 CM_RAW 5 -128 127 /end AXIS_PTS
/begin AXIS_PTS AX_0FA_N "ось #0FA, обороты двигателя [да (60e6/период в 0x1FD40; единица 0,5 об/мин — вероятно)]" 0x08061468 AXIN_0FA_N RL_AX_UWORD_20 0 CM_RPM2 20 0 32767.5 /end AXIS_PTS
/begin AXIS_PTS AX_0FB "ось #0FB" 0x08061028 AXIN_0FB RL_AX_UWORD_6 0 CM_RAW 6 0 65535 /end AXIS_PTS
/begin AXIS_PTS AX_0FC "ось #0FC" 0x08061034 AXIN_0FC RL_AX_UWORD_16 0 CM_RAW 16 0 65535 /end AXIS_PTS
/begin AXIS_PTS AX_0FD "ось #0FD" 0x0806109C AXIN_0FD RL_AX_SWORD_15 0 CM_RAW 15 -32768 32767 /end AXIS_PTS
/begin AXIS_PTS AX_0FF "ось #0FF" 0x0806017C AXIN_0FF RL_AX_UBYTE_3 0 CM_RAW 3 0 255 /end AXIS_PTS
/begin AXIS_PTS AX_100 "ось #100" 0x080600A4 AXIN_100 RL_AX_SBYTE_4 0 CM_RAW 4 -128 127 /end AXIS_PTS
/begin AXIS_PTS AX_101 "ось #101" 0x080615F0 AXIN_101 RL_AX_UWORD_8 0 CM_RAW 8 0 65535 /end AXIS_PTS
/begin AXIS_PTS AX_102 "ось #102" 0x08060A4C AXIN_102 RL_AX_SBYTE_1 0 CM_RAW 1 -128 127 /end AXIS_PTS
/begin CHARACTERISTIC CAL_676 "массив #676" VAL_BLK 0x080702C8 RL_FNC_SBYTE 0 CM_RAW -128 127 MATRIX_DIM 7 1 1 /end CHARACTERISTIC
/begin CHARACTERISTIC CAL_677 "массив #677" VAL_BLK 0x08070258 RL_FNC_SWORD 0 CM_RAW -32768 32767 MATRIX_DIM 7 1 1 /end CHARACTERISTIC
/begin CHARACTERISTIC CAL_678 "массив #678" VAL_BLK 0x08070268 RL_FNC_SWORD 0 CM_RAW -32768 32767 MATRIX_DIM 7 1 1 /end CHARACTERISTIC
/begin CHARACTERISTIC CAL_679 "массив #679" VAL_BLK 0x080702E4 RL_FNC_UWORD 0 CM_RAW 0 65535 MATRIX_DIM 8 1 1 /end CHARACTERISTIC
/begin CHARACTERISTIC CAL_67A "массив #67A" VAL_BLK 0x080702D4 RL_FNC_UWORD 0 CM_RAW 0 65535 MATRIX_DIM 8 1 1 /end CHARACTERISTIC
/begin CHARACTERISTIC CAL_67B "значение #67B" VALUE 0x080702FC RL_FNC_SBYTE 0 CM_RAW -128 127 /end CHARACTERISTIC
/begin CHARACTERISTIC CAL_67C "массив #67C" VAL_BLK 0x08070300 RL_FNC_SBYTE 0 CM_RAW -128 127 MATRIX_DIM 8 1 1 /end CHARACTERISTIC
/begin CHARACTERISTIC CAL_67D "массив #67D" VAL_BLK 0x08070308 RL_FNC_UWORD 0 CM_RAW 0 65535 MATRIX_DIM 8 1 1 /end CHARACTERISTIC
/begin CHARACTERISTIC CAL_67E "значение #67E" VALUE 0x0807031A RL_FNC_SWORD 0 CM_RAW -32768 32767 /end CHARACTERISTIC
/begin CHARACTERISTIC CAL_67F "значение #67F" VALUE 0x08074996 RL_FNC_SBYTE 0 CM_RAW -128 127 /end CHARACTERISTIC
/begin CHARACTERISTIC CAL_680 "значение #680" VALUE 0x080713D0 RL_FNC_UWORD 0 CM_RAW 0 65535 /end CHARACTERISTIC
/begin CHARACTERISTIC CAL_681 "кривая #681 8: GEAR" CURVE 0x08072AC8 RL_FNC_UWORD 0 CM_RAW 0 65535
 /begin AXIS_DESCR COM_AXIS AXIN_05E_GEAR CM_RAW 8 -128 127 AXIS_PTS_REF AX_05E_GEAR /end AXIS_DESCR
/end CHARACTERISTIC
/begin CHARACTERISTIC CAL_682 "значение #682" VALUE 0x08073A24 RL_FNC_SWORD 0 CM_RAW -32768 32767 /end CHARACTERISTIC
/begin CHARACTERISTIC CAL_683 "карта #683 17x17: N × LOAD" MAP 0x08072AD8 RL_FNC_UWORD 0 CM_RAW 0 65535
 /begin AXIS_DESCR COM_AXIS AXIN_05F_N CM_RPM2 17 0 32767.5 AXIS_PTS_REF AX_05F_N /end AXIS_DESCR
 /begin AXIS_DESCR COM_AXIS AXIN_0B7_LOAD CM_RAW 17 0 65535 AXIS_PTS_REF AX_0B7_LOAD /end AXIS_DESCR
/end CHARACTERISTIC
/begin CHARACTERISTIC CAL_684 "массив #684" VAL_BLK 0x08073944 RL_FNC_UWORD 0 CM_RAW 0 65535 MATRIX_DIM 2 1 1 /end CHARACTERISTIC
/begin CHARACTERISTIC CAL_685 "кривая #685 11: ?" CURVE 0x080706D4 RL_FNC_UWORD 0 CM_RAW 0 65535 /begin AXIS_DESCR COM_AXIS AXIN_08E CM_RAW 11 0 65535 AXIS_PTS_REF AX_08E /end AXIS_DESCR /end CHARACTERISTIC
/begin CHARACTERISTIC CAL_686 "кривая #686 11: ?" CURVE 0x080706EC RL_FNC_UWORD 0 CM_RAW 0 65535 /begin AXIS_DESCR COM_AXIS AXIN_0B3 CM_P128 11 0 511.992 AXIS_PTS_REF AX_0B3 /end AXIS_DESCR /end CHARACTERISTIC
/begin CHARACTERISTIC CAL_687 "кривая #687 11: ?" CURVE 0x0807071C RL_FNC_UWORD 0 CM_RAW 0 65535 /begin AXIS_DESCR COM_AXIS AXIN_0B3 CM_P128 11 0 511.992 AXIS_PTS_REF AX_0B3 /end AXIS_DESCR /end CHARACTERISTIC
/begin CHARACTERISTIC CAL_688 "кривая #688 11: ?" CURVE 0x08070704 RL_FNC_UWORD 0 CM_RAW 0 65535 /begin AXIS_DESCR COM_AXIS AXIN_0B3 CM_P128 11 0 511.992 AXIS_PTS_REF AX_0B3 /end AXIS_DESCR /end CHARACTERISTIC
/begin CHARACTERISTIC CAL_689 "кривая #689 11: ?" CURVE 0x08070748 RL_FNC_UWORD 0 CM_RAW 0 65535 /begin AXIS_DESCR COM_AXIS AXIN_0B3 CM_P128 11 0 511.992 AXIS_PTS_REF AX_0B3 /end AXIS_DESCR /end CHARACTERISTIC
/begin CHARACTERISTIC CAL_68A "кривая #68A 11: ?" CURVE 0x08070760 RL_FNC_UWORD 0 CM_RAW 0 65535 /begin AXIS_DESCR COM_AXIS AXIN_0B3 CM_P128 11 0 511.992 AXIS_PTS_REF AX_0B3 /end AXIS_DESCR /end CHARACTERISTIC
/begin CHARACTERISTIC CAL_68B "кривая #68B 11: ?" CURVE 0x08070778 RL_FNC_UWORD 0 CM_RAW 0 65535 /begin AXIS_DESCR COM_AXIS AXIN_0B3 CM_P128 11 0 511.992 AXIS_PTS_REF AX_0B3 /end AXIS_DESCR /end CHARACTERISTIC
/begin CHARACTERISTIC CAL_68C "кривая #68C 11: ?" CURVE 0x08070790 RL_FNC_UWORD 0 CM_RAW 0 65535 /begin AXIS_DESCR COM_AXIS AXIN_0B3 CM_P128 11 0 511.992 AXIS_PTS_REF AX_0B3 /end AXIS_DESCR /end CHARACTERISTIC
/begin CHARACTERISTIC CAL_68D "карта #68D 11x8: GEAR × ?" MAP 0x080707CC RL_FNC_UWORD 0 CM_RAW 0 65535
 /begin AXIS_DESCR COM_AXIS AXIN_05E_GEAR CM_RAW 8 -128 127 AXIS_PTS_REF AX_05E_GEAR /end AXIS_DESCR
 /begin AXIS_DESCR COM_AXIS AXIN_0D9 CM_RAW 11 0 65535 AXIS_PTS_REF AX_0D9 /end AXIS_DESCR
/end CHARACTERISTIC
/begin CHARACTERISTIC CAL_68E "карта #68E 11x8: GEAR × ?" MAP 0x0807087C RL_FNC_UWORD 0 CM_RAW 0 65535
 /begin AXIS_DESCR COM_AXIS AXIN_05E_GEAR CM_RAW 8 -128 127 AXIS_PTS_REF AX_05E_GEAR /end AXIS_DESCR
 /begin AXIS_DESCR COM_AXIS AXIN_0D9 CM_RAW 11 0 65535 AXIS_PTS_REF AX_0D9 /end AXIS_DESCR
/end CHARACTERISTIC
/begin CHARACTERISTIC CAL_68F "карта #68F 11x8: GEAR × N [знак по значениям]" MAP 0x0807092C RL_FNC_SWORD 0 CM_RAW -32768 32767
 /begin AXIS_DESCR COM_AXIS AXIN_05E_GEAR CM_RAW 8 -128 127 AXIS_PTS_REF AX_05E_GEAR /end AXIS_DESCR
 /begin AXIS_DESCR COM_AXIS AXIN_0B1_N CM_RPM2 11 0 32767.5 AXIS_PTS_REF AX_0B1_N /end AXIS_DESCR
/end CHARACTERISTIC
/begin CHARACTERISTIC CAL_690 "карта #690 11x8: GEAR × N" MAP 0x080709DC RL_FNC_UWORD 0 CM_RAW 0 65535
 /begin AXIS_DESCR COM_AXIS AXIN_05E_GEAR CM_RAW 8 -128 127 AXIS_PTS_REF AX_05E_GEAR /end AXIS_DESCR
 /begin AXIS_DESCR COM_AXIS AXIN_0B1_N CM_RPM2 11 0 32767.5 AXIS_PTS_REF AX_0B1_N /end AXIS_DESCR
/end CHARACTERISTIC
/begin CHARACTERISTIC CAL_691 "кривая #691 8: GEAR" CURVE 0x08070A9C RL_FNC_UWORD 0 CM_RAW 0 65535
 /begin AXIS_DESCR COM_AXIS AXIN_05E_GEAR CM_RAW 8 -128 127 AXIS_PTS_REF AX_05E_GEAR /end AXIS_DESCR
/end CHARACTERISTIC
/begin CHARACTERISTIC CAL_692 "карта #692 11x8: GEAR × N" MAP 0x08070D88 RL_FNC_UWORD 0 CM_RAW 0 65535
 /begin AXIS_DESCR COM_AXIS AXIN_05E_GEAR CM_RAW 8 -128 127 AXIS_PTS_REF AX_05E_GEAR /end AXIS_DESCR
 /begin AXIS_DESCR COM_AXIS AXIN_0B1_N CM_RPM2 11 0 32767.5 AXIS_PTS_REF AX_0B1_N /end AXIS_DESCR
/end CHARACTERISTIC
/begin CHARACTERISTIC CAL_693 "карта #693 11x8: N × ?" MAP 0x08070CD8 RL_FNC_UWORD 0 CM_RAW 0 65535
 /begin AXIS_DESCR COM_AXIS AXIN_050_N CM_RPM2 8 0 32767.5 AXIS_PTS_REF AX_050_N /end AXIS_DESCR
 /begin AXIS_DESCR COM_AXIS AXIN_08E CM_RAW 11 0 65535 AXIS_PTS_REF AX_08E /end AXIS_DESCR
/end CHARACTERISTIC
/begin CHARACTERISTIC CAL_694 "карта #694 11x8: GEAR × N" MAP 0x08070F98 RL_FNC_UWORD 0 CM_RAW 0 65535
 /begin AXIS_DESCR COM_AXIS AXIN_05E_GEAR CM_RAW 8 -128 127 AXIS_PTS_REF AX_05E_GEAR /end AXIS_DESCR
 /begin AXIS_DESCR COM_AXIS AXIN_0B1_N CM_RPM2 11 0 32767.5 AXIS_PTS_REF AX_0B1_N /end AXIS_DESCR
/end CHARACTERISTIC
/begin CHARACTERISTIC CAL_695 "карта #695 11x16: PEDAL × ?" MAP 0x08070E38 RL_FNC_UWORD 0 CM_RAW 0 65535
 /begin AXIS_DESCR COM_AXIS AXIN_01B_PEDAL CM_P128 16 0 511.992 AXIS_PTS_REF AX_01B_PEDAL /end AXIS_DESCR
 /begin AXIS_DESCR COM_AXIS AXIN_08E CM_RAW 11 0 65535 AXIS_PTS_REF AX_08E /end AXIS_DESCR
/end CHARACTERISTIC
/begin CHARACTERISTIC CAL_696 "кривая #696 8: N" CURVE 0x08071CFC RL_FNC_UWORD 0 CM_RAW 0 65535
 /begin AXIS_DESCR COM_AXIS AXIN_050_N CM_RPM2 8 0 32767.5 AXIS_PTS_REF AX_050_N /end AXIS_DESCR
/end CHARACTERISTIC
/begin CHARACTERISTIC CAL_697 "карта #697 8x9: N × GEAR" MAP 0x08071DD4 RL_FNC_UWORD 0 CM_RAW 0 65535
 /begin AXIS_DESCR COM_AXIS AXIN_0AD_N CM_RPM2 9 0 32767.5 AXIS_PTS_REF AX_0AD_N /end AXIS_DESCR
 /begin AXIS_DESCR COM_AXIS AXIN_05E_GEAR CM_RAW 8 -128 127 AXIS_PTS_REF AX_05E_GEAR /end AXIS_DESCR
/end CHARACTERISTIC
/begin CHARACTERISTIC CAL_698 "кривая #698 8: GEAR" CURVE 0x08071D0C RL_FNC_UWORD 0 CM_RAW 0 65535
 /begin AXIS_DESCR COM_AXIS AXIN_05E_GEAR CM_RAW 8 -128 127 AXIS_PTS_REF AX_05E_GEAR /end AXIS_DESCR
/end CHARACTERISTIC
/begin CHARACTERISTIC CAL_699 "карта #699 11x8: GEAR × N" MAP 0x08073974 RL_FNC_SBYTE 0 CM_RAW -128 127
 /begin AXIS_DESCR COM_AXIS AXIN_05E_GEAR CM_RAW 8 -128 127 AXIS_PTS_REF AX_05E_GEAR /end AXIS_DESCR
 /begin AXIS_DESCR COM_AXIS AXIN_0B1_N CM_RPM2 11 0 32767.5 AXIS_PTS_REF AX_0B1_N /end AXIS_DESCR
/end CHARACTERISTIC
/begin CHARACTERISTIC CAL_69A "карта #69A 11x8: GEAR × N" MAP 0x080739CC RL_FNC_SBYTE 0 CM_RAW -128 127
 /begin AXIS_DESCR COM_AXIS AXIN_05E_GEAR CM_RAW 8 -128 127 AXIS_PTS_REF AX_05E_GEAR /end AXIS_DESCR
 /begin AXIS_DESCR COM_AXIS AXIN_0B1_N CM_RPM2 11 0 32767.5 AXIS_PTS_REF AX_0B1_N /end AXIS_DESCR
/end CHARACTERISTIC
/begin CHARACTERISTIC CAL_69B "карта #69B 11x8: GEAR × N" MAP 0x08073A28 RL_FNC_SBYTE 0 CM_RAW -128 127
 /begin AXIS_DESCR COM_AXIS AXIN_05E_GEAR CM_RAW 8 -128 127 AXIS_PTS_REF AX_05E_GEAR /end AXIS_DESCR
 /begin AXIS_DESCR COM_AXIS AXIN_0B1_N CM_RPM2 11 0 32767.5 AXIS_PTS_REF AX_0B1_N /end AXIS_DESCR
/end CHARACTERISTIC
/begin CHARACTERISTIC CAL_69C "карта #69C 11x8: GEAR × N" MAP 0x08073A80 RL_FNC_SBYTE 0 CM_RAW -128 127
 /begin AXIS_DESCR COM_AXIS AXIN_05E_GEAR CM_RAW 8 -128 127 AXIS_PTS_REF AX_05E_GEAR /end AXIS_DESCR
 /begin AXIS_DESCR COM_AXIS AXIN_0B1_N CM_RPM2 11 0 32767.5 AXIS_PTS_REF AX_0B1_N /end AXIS_DESCR
/end CHARACTERISTIC
/begin CHARACTERISTIC CAL_69D "значение #69D" VALUE 0x08073BA4 RL_FNC_SBYTE 0 CM_RAW -128 127 /end CHARACTERISTIC
/begin CHARACTERISTIC CAL_69E_0 "кривая #69E 9: TCOOL [1/2]" CURVE 0x080707A8 RL_FNC_UWORD 0 CM_RAW 0 65535
 /begin AXIS_DESCR COM_AXIS AXIN_00A_TCOOL CM_C128 9 -256 255.992 AXIS_PTS_REF AX_00A_TCOOL /end AXIS_DESCR
/end CHARACTERISTIC
/begin CHARACTERISTIC CAL_69E_1 "кривая #69E 9: TCOOL [2/2]" CURVE 0x080707BA RL_FNC_UWORD 0 CM_RAW 0 65535
 /begin AXIS_DESCR COM_AXIS AXIN_00A_TCOOL CM_C128 9 -256 255.992 AXIS_PTS_REF AX_00A_TCOOL /end AXIS_DESCR
/end CHARACTERISTIC
/begin CHARACTERISTIC CAL_69F "кривая #69F 8: ?" CURVE 0x08070A8C RL_FNC_UWORD 0 CM_RAW 0 65535 /begin AXIS_DESCR COM_AXIS AXIN_05D CM_RAW 8 -128 127 AXIS_PTS_REF AX_05D /end AXIS_DESCR /end CHARACTERISTIC
/begin CHARACTERISTIC CAL_6A0 "кривая #6A0 8: GEAR" CURVE 0x080713A8 RL_FNC_UWORD 0 CM_RAW 0 65535
 /begin AXIS_DESCR COM_AXIS AXIN_05E_GEAR CM_RAW 8 -128 127 AXIS_PTS_REF AX_05E_GEAR /end AXIS_DESCR
/end CHARACTERISTIC
/begin CHARACTERISTIC CAL_6A1 "кривая #6A1 8: GEAR" CURVE 0x080713B8 RL_FNC_UWORD 0 CM_RAW 0 65535
 /begin AXIS_DESCR COM_AXIS AXIN_05E_GEAR CM_RAW 8 -128 127 AXIS_PTS_REF AX_05E_GEAR /end AXIS_DESCR
/end CHARACTERISTIC
/begin CHARACTERISTIC CAL_6A2 "массив #6A2" VAL_BLK 0x080713D4 RL_FNC_SBYTE 0 CM_RAW -128 127 MATRIX_DIM 10 1 1 /end CHARACTERISTIC
/begin CHARACTERISTIC CAL_6A3 "массив #6A3" VAL_BLK 0x080713E0 RL_FNC_SBYTE 0 CM_RAW -128 127 MATRIX_DIM 10 1 1 /end CHARACTERISTIC
/begin CHARACTERISTIC CAL_6A4_0 "кривая #6A4 12: ? [1/2]" CURVE 0x08072A68 RL_FNC_UWORD 0 CM_RAW 0 65535 /begin AXIS_DESCR COM_AXIS AXIN_0B2 CM_RAW 12 0 65535 AXIS_PTS_REF AX_0B2 /end AXIS_DESCR /end CHARACTERISTIC
/begin CHARACTERISTIC CAL_6A4_1 "кривая #6A4 12: ? [2/2]" CURVE 0x08072A80 RL_FNC_UWORD 0 CM_RAW 0 65535 /begin AXIS_DESCR COM_AXIS AXIN_0B2 CM_RAW 12 0 65535 AXIS_PTS_REF AX_0B2 /end AXIS_DESCR /end CHARACTERISTIC
/begin CHARACTERISTIC CAL_6A5 "карта #6A5 10x8: GEAR × N [знак по значениям]" MAP 0x080729C8 RL_FNC_SWORD 0 CM_RAW -32768 32767
 /begin AXIS_DESCR COM_AXIS AXIN_05E_GEAR CM_RAW 8 -128 127 AXIS_PTS_REF AX_05E_GEAR /end AXIS_DESCR
 /begin AXIS_DESCR COM_AXIS AXIN_00C_N CM_RPM2 10 0 32767.5 AXIS_PTS_REF AX_00C_N /end AXIS_DESCR
/end CHARACTERISTIC
/begin CHARACTERISTIC CAL_6A6 "кривая #6A6 12: ?" CURVE 0x08072A98 RL_FNC_UWORD 0 CM_RAW 0 65535 /begin AXIS_DESCR COM_AXIS AXIN_0B2 CM_RAW 12 0 65535 AXIS_PTS_REF AX_0B2 /end AXIS_DESCR /end CHARACTERISTIC
/begin CHARACTERISTIC CAL_6A7 "кривая #6A7 12: ?" CURVE 0x08072AB0 RL_FNC_UWORD 0 CM_RAW 0 65535 /begin AXIS_DESCR COM_AXIS AXIN_0B2 CM_RAW 12 0 65535 AXIS_PTS_REF AX_0B2 /end AXIS_DESCR /end CHARACTERISTIC
/begin CHARACTERISTIC CAL_6A8_0 "карта #6A8 16x12: ? × PEDAL [1/3]" MAP 0x08072D1C RL_FNC_UWORD 0 CM_RAW 0 65535 /begin AXIS_DESCR COM_AXIS AXIN_0B2 CM_RAW 12 0 65535 AXIS_PTS_REF AX_0B2 /end AXIS_DESCR
 /begin AXIS_DESCR COM_AXIS AXIN_01B_PEDAL CM_P128 16 0 511.992 AXIS_PTS_REF AX_01B_PEDAL /end AXIS_DESCR
/end CHARACTERISTIC
/begin CHARACTERISTIC CAL_6A8_1 "карта #6A8 16x12: ? × PEDAL [2/3]" MAP 0x08072E9C RL_FNC_UWORD 0 CM_RAW 0 65535 /begin AXIS_DESCR COM_AXIS AXIN_0B2 CM_RAW 12 0 65535 AXIS_PTS_REF AX_0B2 /end AXIS_DESCR
 /begin AXIS_DESCR COM_AXIS AXIN_01B_PEDAL CM_P128 16 0 511.992 AXIS_PTS_REF AX_01B_PEDAL /end AXIS_DESCR
/end CHARACTERISTIC
/begin CHARACTERISTIC CAL_6A8_2 "карта #6A8 16x12: ? × PEDAL [3/3]" MAP 0x0807301C RL_FNC_UWORD 0 CM_RAW 0 65535 /begin AXIS_DESCR COM_AXIS AXIN_0B2 CM_RAW 12 0 65535 AXIS_PTS_REF AX_0B2 /end AXIS_DESCR
 /begin AXIS_DESCR COM_AXIS AXIN_01B_PEDAL CM_P128 16 0 511.992 AXIS_PTS_REF AX_01B_PEDAL /end AXIS_DESCR
/end CHARACTERISTIC
/begin CHARACTERISTIC CAL_6A9_0 "карта #6A9 16x12: ? × PEDAL [1/3]" MAP 0x0807319C RL_FNC_UWORD 0 CM_RAW 0 65535 /begin AXIS_DESCR COM_AXIS AXIN_0B2 CM_RAW 12 0 65535 AXIS_PTS_REF AX_0B2 /end AXIS_DESCR
 /begin AXIS_DESCR COM_AXIS AXIN_01B_PEDAL CM_P128 16 0 511.992 AXIS_PTS_REF AX_01B_PEDAL /end AXIS_DESCR
/end CHARACTERISTIC
/begin CHARACTERISTIC CAL_6A9_1 "карта #6A9 16x12: ? × PEDAL [2/3]" MAP 0x0807331C RL_FNC_UWORD 0 CM_RAW 0 65535 /begin AXIS_DESCR COM_AXIS AXIN_0B2 CM_RAW 12 0 65535 AXIS_PTS_REF AX_0B2 /end AXIS_DESCR
 /begin AXIS_DESCR COM_AXIS AXIN_01B_PEDAL CM_P128 16 0 511.992 AXIS_PTS_REF AX_01B_PEDAL /end AXIS_DESCR
/end CHARACTERISTIC
/begin CHARACTERISTIC CAL_6A9_2 "карта #6A9 16x12: ? × PEDAL [3/3]" MAP 0x0807349C RL_FNC_UWORD 0 CM_RAW 0 65535 /begin AXIS_DESCR COM_AXIS AXIN_0B2 CM_RAW 12 0 65535 AXIS_PTS_REF AX_0B2 /end AXIS_DESCR
 /begin AXIS_DESCR COM_AXIS AXIN_01B_PEDAL CM_P128 16 0 511.992 AXIS_PTS_REF AX_01B_PEDAL /end AXIS_DESCR
/end CHARACTERISTIC
/begin CHARACTERISTIC CAL_6AA "кривая #6AA 9: TCOOL" CURVE 0x08073960 RL_FNC_UWORD 0 CM_RAW 0 65535
 /begin AXIS_DESCR COM_AXIS AXIN_00A_TCOOL CM_C128 9 -256 255.992 AXIS_PTS_REF AX_00A_TCOOL /end AXIS_DESCR
/end CHARACTERISTIC
/begin CHARACTERISTIC CAL_6AB "значение #6AB" VALUE 0x08073A26 RL_FNC_SWORD 0 CM_RAW -32768 32767 /end CHARACTERISTIC
/begin CHARACTERISTIC CAL_6AC "значение #6AC" VALUE 0x08073AD8 RL_FNC_SWORD 0 CM_RAW -32768 32767 /end CHARACTERISTIC
/begin CHARACTERISTIC CAL_6AD "значение #6AD" VALUE 0x08070C76 RL_FNC_UWORD 0 CM_RAW 0 65535 /end CHARACTERISTIC
/begin CHARACTERISTIC CAL_6AE_0 "кривая #6AE 17: ? [1/2]" CURVE 0x08071070 RL_FNC_UWORD 0 CM_RAW 0 65535 /begin AXIS_DESCR COM_AXIS AXIN_093 CM_RAW 17 0 65535 AXIS_PTS_REF AX_093 /end AXIS_DESCR /end CHARACTERISTIC
/begin CHARACTERISTIC CAL_6AE_1 "кривая #6AE 17: ? [2/2]" CURVE 0x08071092 RL_FNC_UWORD 0 CM_RAW 0 65535 /begin AXIS_DESCR COM_AXIS AXIN_093 CM_RAW 17 0 65535 AXIS_PTS_REF AX_093 /end AXIS_DESCR /end CHARACTERISTIC
/begin CHARACTERISTIC CAL_6AF_0 "карта #6AF 11x17: ? × ? [1/2]" MAP 0x080710B4 RL_FNC_UWORD 0 CM_RAW 0 65535 /begin AXIS_DESCR COM_AXIS AXIN_093 CM_RAW 17 0 65535 AXIS_PTS_REF AX_093 /end AXIS_DESCR /begin AXIS_DESCR COM_AXIS AXIN_08E CM_RAW 11 0 65535 AXIS_PTS_REF AX_08E /end AXIS_DESCR /end CHARACTERISTIC
/begin CHARACTERISTIC CAL_6AF_1 "карта #6AF 11x17: ? × ? [2/2]" MAP 0x0807122A RL_FNC_UWORD 0 CM_RAW 0 65535 /begin AXIS_DESCR COM_AXIS AXIN_093 CM_RAW 17 0 65535 AXIS_PTS_REF AX_093 /end AXIS_DESCR /begin AXIS_DESCR COM_AXIS AXIN_08E CM_RAW 11 0 65535 AXIS_PTS_REF AX_08E /end AXIS_DESCR /end CHARACTERISTIC
/begin CHARACTERISTIC CAL_6B1 "значение #6B1" VALUE 0x080713CE RL_FNC_UWORD 0 CM_RAW 0 65535 /end CHARACTERISTIC
/begin CHARACTERISTIC CAL_6B2 "значение #6B2" VALUE 0x080713CC RL_FNC_UWORD 0 CM_RAW 0 65535 /end CHARACTERISTIC
/begin CHARACTERISTIC CAL_6B3 "массив #6B3 [знак по значениям]" VAL_BLK 0x08071EF4 RL_FNC_SWORD 0 CM_RAW -32768 32767 MATRIX_DIM 2 1 1 /end CHARACTERISTIC
/begin CHARACTERISTIC CAL_6B4 "массив #6B4 [знак по значениям]" VAL_BLK 0x08071EF0 RL_FNC_SWORD 0 CM_RAW -32768 32767 MATRIX_DIM 2 1 1 /end CHARACTERISTIC
/begin CHARACTERISTIC CAL_6B5 "массив #6B5" VAL_BLK 0x0807394C RL_FNC_UWORD 0 CM_RAW 0 65535 MATRIX_DIM 2 1 1 /end CHARACTERISTIC
/begin CHARACTERISTIC CAL_6B6 "значение #6B6" VALUE 0x08073950 RL_FNC_SLONG 0 CM_RAW -2.14748e+09 2.14748e+09 /end CHARACTERISTIC
/begin CHARACTERISTIC CAL_6B7 "значение #6B7" VALUE 0x08073954 RL_FNC_UWORD 0 CM_RAW 0 65535 /end CHARACTERISTIC
/begin CHARACTERISTIC CAL_6B8 "массив #6B8 [знак по значениям]" VAL_BLK 0x0807395C RL_FNC_SWORD 0 CM_RAW -32768 32767 MATRIX_DIM 2 1 1 /end CHARACTERISTIC
/begin CHARACTERISTIC CAL_6B9 "массив #6B9 [знак по значениям]" VAL_BLK 0x08073958 RL_FNC_SWORD 0 CM_RAW -32768 32767 MATRIX_DIM 2 1 1 /end CHARACTERISTIC
/begin CHARACTERISTIC CAL_6BA "кривая #6BA 11: ?" CURVE 0x08071F10 RL_FNC_UWORD 0 CM_RAW 0 65535
 /begin AXIS_DESCR COM_AXIS AXIN_0B4 CM_RAW 11 -32768 32767 AXIS_PTS_REF AX_0B4 /end AXIS_DESCR
/end CHARACTERISTIC
/begin CHARACTERISTIC CAL_6BB "кривая #6BB 8: GEAR" CURVE 0x08071F94 RL_FNC_UWORD 0 CM_RAW 0 65535
 /begin AXIS_DESCR COM_AXIS AXIN_05E_GEAR CM_RAW 8 -128 127 AXIS_PTS_REF AX_05E_GEAR /end AXIS_DESCR
/end CHARACTERISTIC
/begin CHARACTERISTIC CAL_6BC "кривая #6BC 8: GEAR" CURVE 0x08071F74 RL_FNC_UWORD 0 CM_RAW 0 65535
 /begin AXIS_DESCR COM_AXIS AXIN_05E_GEAR CM_RAW 8 -128 127 AXIS_PTS_REF AX_05E_GEAR /end AXIS_DESCR
/end CHARACTERISTIC
/begin CHARACTERISTIC CAL_6BD "кривая #6BD 8: GEAR" CURVE 0x08071F84 RL_FNC_UWORD 0 CM_RAW 0 65535
 /begin AXIS_DESCR COM_AXIS AXIN_05E_GEAR CM_RAW 8 -128 127 AXIS_PTS_REF AX_05E_GEAR /end AXIS_DESCR
/end CHARACTERISTIC
/begin CHARACTERISTIC CAL_6BE_0 "карта #6BE 9x17: ? × ? [1/2] [знак по значениям]" MAP 0x08071FC4 RL_FNC_SWORD 0 CM_RAW -32768 32767 /begin AXIS_DESCR COM_AXIS AXIN_0E6 CM_RAW 17 0 65535 AXIS_PTS_REF AX_0E6 /end AXIS_DESCR /begin AXIS_DESCR COM_AXIS AXIN_0B6 CM_RAW 9 0 65535 AXIS_PTS_REF AX_0B6 /end AXIS_DESCR /end CHARACTERISTIC
/begin CHARACTERISTIC CAL_6BE_1 "карта #6BE 9x17: ? × ? [2/2] [знак по значениям]" MAP 0x080720F6 RL_FNC_SWORD 0 CM_RAW -32768 32767 /begin AXIS_DESCR COM_AXIS AXIN_0E6 CM_RAW 17 0 65535 AXIS_PTS_REF AX_0E6 /end AXIS_DESCR /begin AXIS_DESCR COM_AXIS AXIN_0B6 CM_RAW 9 0 65535 AXIS_PTS_REF AX_0B6 /end AXIS_DESCR /end CHARACTERISTIC
/begin CHARACTERISTIC CAL_6BF_0 "кривая #6BF 8: N [1/2]" CURVE 0x08071FA4 RL_FNC_UWORD 0 CM_RAW 0 65535
 /begin AXIS_DESCR COM_AXIS AXIN_050_N CM_RPM2 8 0 32767.5 AXIS_PTS_REF AX_050_N /end AXIS_DESCR
/end CHARACTERISTIC
/begin CHARACTERISTIC CAL_6BF_1 "кривая #6BF 8: N [2/2]" CURVE 0x08071FB4 RL_FNC_UWORD 0 CM_RAW 0 65535
 /begin AXIS_DESCR COM_AXIS AXIN_050_N CM_RPM2 8 0 32767.5 AXIS_PTS_REF AX_050_N /end AXIS_DESCR
/end CHARACTERISTIC
/begin CHARACTERISTIC CAL_6C0_0 "карта #6C0 9x17: ? × ? [1/2] [знак по значениям]" MAP 0x08072228 RL_FNC_SWORD 0 CM_RAW -32768 32767 /begin AXIS_DESCR COM_AXIS AXIN_093 CM_RAW 17 0 65535 AXIS_PTS_REF AX_093 /end AXIS_DESCR /begin AXIS_DESCR COM_AXIS AXIN_0B6 CM_RAW 9 0 65535 AXIS_PTS_REF AX_0B6 /end AXIS_DESCR /end CHARACTERISTIC
/begin CHARACTERISTIC CAL_6C0_1 "карта #6C0 9x17: ? × ? [2/2] [знак по значениям]" MAP 0x0807235A RL_FNC_SWORD 0 CM_RAW -32768 32767 /begin AXIS_DESCR COM_AXIS AXIN_093 CM_RAW 17 0 65535 AXIS_PTS_REF AX_093 /end AXIS_DESCR /begin AXIS_DESCR COM_AXIS AXIN_0B6 CM_RAW 9 0 65535 AXIS_PTS_REF AX_0B6 /end AXIS_DESCR /end CHARACTERISTIC
/begin CHARACTERISTIC CAL_6C1_0 "кривая #6C1 17: ? [1/2] [знак по значениям]" CURVE 0x0807248C RL_FNC_SWORD 0 CM_RAW -32768 32767 /begin AXIS_DESCR COM_AXIS AXIN_0E6 CM_RAW 17 0 65535 AXIS_PTS_REF AX_0E6 /end AXIS_DESCR /end CHARACTERISTIC
/begin CHARACTERISTIC CAL_6C1_1 "кривая #6C1 17: ? [2/2] [знак по значениям]" CURVE 0x080724AE RL_FNC_SWORD 0 CM_RAW -32768 32767 /begin AXIS_DESCR COM_AXIS AXIN_0E6 CM_RAW 17 0 65535 AXIS_PTS_REF AX_0E6 /end AXIS_DESCR /end CHARACTERISTIC
/begin CHARACTERISTIC CAL_6C2 "массив #6C2" VAL_BLK 0x080724D0 RL_FNC_UWORD 0 CM_RAW 0 65535 MATRIX_DIM 2 1 1 /end CHARACTERISTIC
/begin CHARACTERISTIC CAL_6C3_0 "карта #6C3 9x17: ? × ? [1/2] [знак по значениям]" MAP 0x080724D4 RL_FNC_SWORD 0 CM_RAW -32768 32767 /begin AXIS_DESCR COM_AXIS AXIN_0B5 CM_RAW 17 0 65535 AXIS_PTS_REF AX_0B5 /end AXIS_DESCR /begin AXIS_DESCR COM_AXIS AXIN_0B6 CM_RAW 9 0 65535 AXIS_PTS_REF AX_0B6 /end AXIS_DESCR /end CHARACTERISTIC
/begin CHARACTERISTIC CAL_6C3_1 "карта #6C3 9x17: ? × ? [2/2] [знак по значениям]" MAP 0x08072606 RL_FNC_SWORD 0 CM_RAW -32768 32767 /begin AXIS_DESCR COM_AXIS AXIN_0B5 CM_RAW 17 0 65535 AXIS_PTS_REF AX_0B5 /end AXIS_DESCR /begin AXIS_DESCR COM_AXIS AXIN_0B6 CM_RAW 9 0 65535 AXIS_PTS_REF AX_0B6 /end AXIS_DESCR /end CHARACTERISTIC
/begin CHARACTERISTIC CAL_6C4_0 "карта #6C4 9x17: ? × ? [1/2]" MAP 0x08072738 RL_FNC_UWORD 0 CM_RAW 0 65535 /begin AXIS_DESCR COM_AXIS AXIN_0E6 CM_RAW 17 0 65535 AXIS_PTS_REF AX_0E6 /end AXIS_DESCR /begin AXIS_DESCR COM_AXIS AXIN_0B6 CM_RAW 9 0 65535 AXIS_PTS_REF AX_0B6 /end AXIS_DESCR /end CHARACTERISTIC
/begin CHARACTERISTIC CAL_6C4_1 "карта #6C4 9x17: ? × ? [2/2]" MAP 0x0807286A RL_FNC_UWORD 0 CM_RAW 0 65535 /begin AXIS_DESCR COM_AXIS AXIN_0E6 CM_RAW 17 0 65535 AXIS_PTS_REF AX_0E6 /end AXIS_DESCR /begin AXIS_DESCR COM_AXIS AXIN_0B6 CM_RAW 9 0 65535 AXIS_PTS_REF AX_0B6 /end AXIS_DESCR /end CHARACTERISTIC
/begin CHARACTERISTIC CAL_6C5 "значение #6C5" VALUE 0x0807299C RL_FNC_UWORD 0 CM_RAW 0 65535 /end CHARACTERISTIC
/begin CHARACTERISTIC CAL_6C6 "массив #6C6" VAL_BLK 0x080729A0 RL_FNC_UWORD 0 CM_RAW 0 65535 MATRIX_DIM 2 1 1 /end CHARACTERISTIC
/begin CHARACTERISTIC CAL_6C7 "массив #6C7" VAL_BLK 0x080729A4 RL_FNC_UWORD 0 CM_RAW 0 65535 MATRIX_DIM 2 1 1 /end CHARACTERISTIC
/begin CHARACTERISTIC CAL_6C8 "массив #6C8" VAL_BLK 0x080729A8 RL_FNC_UWORD 0 CM_RAW 0 65535 MATRIX_DIM 2 1 1 /end CHARACTERISTIC
/begin CHARACTERISTIC CAL_6C9 "кривая #6C9 9: TCOOL" CURVE 0x080729B0 RL_FNC_UWORD 0 CM_RAW 0 65535
 /begin AXIS_DESCR COM_AXIS AXIN_00A_TCOOL CM_C128 9 -256 255.992 AXIS_PTS_REF AX_00A_TCOOL /end AXIS_DESCR
/end CHARACTERISTIC
/begin CHARACTERISTIC CAL_6CA "массив #6CA" VAL_BLK 0x080729C4 RL_FNC_UWORD 0 CM_RAW 0 65535 MATRIX_DIM 2 1 1 /end CHARACTERISTIC
/begin CHARACTERISTIC CAL_6CB "кривая #6CB 195: ?" CURVE 0x08070AAC RL_FNC_UWORD 0 CM_RAW 0 65535 /begin AXIS_DESCR COM_AXIS AXIN_0B9 CM_RAW 195 0 65535 AXIS_PTS_REF AX_0B9 /end AXIS_DESCR /end CHARACTERISTIC
/begin CHARACTERISTIC CAL_6CC "кривая #6CC 28: ?" CURVE 0x08070C9C RL_FNC_UWORD 0 CM_RAW 0 65535 /begin AXIS_DESCR COM_AXIS AXIN_0B8 CM_RAW 28 0 65535 AXIS_PTS_REF AX_0B8 /end AXIS_DESCR /end CHARACTERISTIC
/begin CHARACTERISTIC CAL_6CD "массив #6CD" VAL_BLK 0x08070CD4 RL_FNC_UWORD 0 CM_RAW 0 65535 MATRIX_DIM 2 1 1 /end CHARACTERISTIC
/begin CHARACTERISTIC CAL_6CE "массив #6CE" VAL_BLK 0x080713C8 RL_FNC_UWORD 0 CM_RAW 0 65535 MATRIX_DIM 2 1 1 /end CHARACTERISTIC
/begin CHARACTERISTIC CAL_6CF "карта #6CF 17x17: N × LOAD [знак по значениям]" MAP 0x08071630 RL_FNC_SWORD 0 CM_RAW -32768 32767
 /begin AXIS_DESCR COM_AXIS AXIN_05F_N CM_RPM2 17 0 32767.5 AXIS_PTS_REF AX_05F_N /end AXIS_DESCR
 /begin AXIS_DESCR COM_AXIS AXIN_0B7_LOAD CM_RAW 17 0 65535 AXIS_PTS_REF AX_0B7_LOAD /end AXIS_DESCR
/end CHARACTERISTIC
/begin CHARACTERISTIC CAL_6D0 "карта #6D0 17x17: N × LOAD [знак по значениям]" MAP 0x080713EC RL_FNC_SWORD 0 CM_RAW -32768 32767
 /begin AXIS_DESCR COM_AXIS AXIN_05F_N CM_RPM2 17 0 32767.5 AXIS_PTS_REF AX_05F_N /end AXIS_DESCR
 /begin AXIS_DESCR COM_AXIS AXIN_0B7_LOAD CM_RAW 17 0 65535 AXIS_PTS_REF AX_0B7_LOAD /end AXIS_DESCR
/end CHARACTERISTIC
/begin CHARACTERISTIC CAL_6D1 "карта #6D1 17x17: N × LOAD [знак по значениям]" MAP 0x08071874 RL_FNC_SWORD 0 CM_RAW -32768 32767
 /begin AXIS_DESCR COM_AXIS AXIN_05F_N CM_RPM2 17 0 32767.5 AXIS_PTS_REF AX_05F_N /end AXIS_DESCR
 /begin AXIS_DESCR COM_AXIS AXIN_0B7_LOAD CM_RAW 17 0 65535 AXIS_PTS_REF AX_0B7_LOAD /end AXIS_DESCR
/end CHARACTERISTIC
/begin CHARACTERISTIC CAL_6D2 "карта #6D2 17x17: N × LOAD [знак по значениям]" MAP 0x08071AB8 RL_FNC_SWORD 0 CM_RAW -32768 32767
 /begin AXIS_DESCR COM_AXIS AXIN_05F_N CM_RPM2 17 0 32767.5 AXIS_PTS_REF AX_05F_N /end AXIS_DESCR
 /begin AXIS_DESCR COM_AXIS AXIN_0B7_LOAD CM_RAW 17 0 65535 AXIS_PTS_REF AX_0B7_LOAD /end AXIS_DESCR
/end CHARACTERISTIC
/begin CHARACTERISTIC CAL_6D3 "массив #6D3 [знак по значениям]" VAL_BLK 0x08071E64 RL_FNC_SWORD 0 CM_RAW -32768 32767 MATRIX_DIM 2 1 1 /end CHARACTERISTIC
/begin CHARACTERISTIC CAL_6D4 "кривая #6D4 9: TCOOL" CURVE 0x08070C50 RL_FNC_UWORD 0 CM_RAW 0 65535
 /begin AXIS_DESCR COM_AXIS AXIN_00A_TCOOL CM_C128 9 -256 255.992 AXIS_PTS_REF AX_00A_TCOOL /end AXIS_DESCR
/end CHARACTERISTIC
/begin CHARACTERISTIC CAL_6D5 "кривая #6D5 17: N" CURVE 0x08070C78 RL_FNC_UWORD 0 CM_RAW 0 65535
 /begin AXIS_DESCR COM_AXIS AXIN_05F_N CM_RPM2 17 0 32767.5 AXIS_PTS_REF AX_05F_N /end AXIS_DESCR
/end CHARACTERISTIC
/begin CHARACTERISTIC CAL_6D6 "карта #6D6 9x9: N × TCOOL" MAP 0x08071D30 RL_FNC_UWORD 0 CM_RAW 0 65535
 /begin AXIS_DESCR COM_AXIS AXIN_0AD_N CM_RPM2 9 0 32767.5 AXIS_PTS_REF AX_0AD_N /end AXIS_DESCR
 /begin AXIS_DESCR COM_AXIS AXIN_00A_TCOOL CM_C128 9 -256 255.992 AXIS_PTS_REF AX_00A_TCOOL /end AXIS_DESCR
/end CHARACTERISTIC
/begin CHARACTERISTIC CAL_6D7 "кривая #6D7 9: TCOOL" CURVE 0x08071D1C RL_FNC_UWORD 0 CM_RAW 0 65535
 /begin AXIS_DESCR COM_AXIS AXIN_00A_TCOOL CM_C128 9 -256 255.992 AXIS_PTS_REF AX_00A_TCOOL /end AXIS_DESCR
/end CHARACTERISTIC
/begin CHARACTERISTIC CAL_6D8 "значение #6D8" VALUE 0x080736AC RL_FNC_UWORD 0 CM_RAW 0 65535 /end CHARACTERISTIC
/begin CHARACTERISTIC CAL_6D9 "карта #6D9 9x9: N × TCOOL" MAP 0x08073AF0 RL_FNC_UWORD 0 CM_RAW 0 65535
 /begin AXIS_DESCR COM_AXIS AXIN_0AD_N CM_RPM2 9 0 32767.5 AXIS_PTS_REF AX_0AD_N /end AXIS_DESCR
 /begin AXIS_DESCR COM_AXIS AXIN_00A_TCOOL CM_C128 9 -256 255.992 AXIS_PTS_REF AX_00A_TCOOL /end AXIS_DESCR
/end CHARACTERISTIC
/begin CHARACTERISTIC CAL_6DA "кривая #6DA 9: N" CURVE 0x08073ADC RL_FNC_UWORD 0 CM_RAW 0 65535
 /begin AXIS_DESCR COM_AXIS AXIN_0AD_N CM_RPM2 9 0 32767.5 AXIS_PTS_REF AX_0AD_N /end AXIS_DESCR
/end CHARACTERISTIC
/begin CHARACTERISTIC CAL_6DB "кривая #6DB 14: ?" CURVE 0x08070C34 RL_FNC_UWORD 0 CM_RAW 0 65535 /begin AXIS_DESCR COM_AXIS AXIN_081 CM_RAW 14 0 65535 AXIS_PTS_REF AX_081 /end AXIS_DESCR /end CHARACTERISTIC
/begin CHARACTERISTIC CAL_6DC "массив #6DC" VAL_BLK 0x080713A0 RL_FNC_UWORD 0 CM_RAW 0 65535 MATRIX_DIM 2 1 1 /end CHARACTERISTIC
/begin CHARACTERISTIC CAL_6DD "массив #6DD" VAL_BLK 0x080713A4 RL_FNC_UWORD 0 CM_RAW 0 65535 MATRIX_DIM 2 1 1 /end CHARACTERISTIC
/begin CHARACTERISTIC CAL_6DE "карта #6DE 8x9: ? × ?" MAP 0x0807361C RL_FNC_UWORD 0 CM_RAW 0 65535 /begin AXIS_DESCR COM_AXIS AXIN_0AE CM_RAW 9 0 65535 AXIS_PTS_REF AX_0AE /end AXIS_DESCR /begin AXIS_DESCR COM_AXIS AXIN_0B0 CM_RAW 8 0 65535 AXIS_PTS_REF AX_0B0 /end AXIS_DESCR /end CHARACTERISTIC
/begin CHARACTERISTIC CAL_6DF "значение #6DF" VALUE 0x080736AE RL_FNC_UWORD 0 CM_RAW 0 65535 /end CHARACTERISTIC
/begin CHARACTERISTIC CAL_6E0 "карта #6E0 8x8: N × ?" MAP 0x08073730 RL_FNC_UWORD 0 CM_RAW 0 65535
 /begin AXIS_DESCR COM_AXIS AXIN_0AC_N CM_RPM2 8 0 32767.5 AXIS_PTS_REF AX_0AC_N /end AXIS_DESCR
 /begin AXIS_DESCR COM_AXIS AXIN_0AF CM_RAW 8 0 65535 AXIS_PTS_REF AX_0AF /end AXIS_DESCR
/end CHARACTERISTIC
/begin CHARACTERISTIC CAL_6E1 "карта #6E1 8x8: N × ?" MAP 0x080736B0 RL_FNC_UWORD 0 CM_RAW 0 65535
 /begin AXIS_DESCR COM_AXIS AXIN_0AC_N CM_RPM2 8 0 32767.5 AXIS_PTS_REF AX_0AC_N /end AXIS_DESCR
 /begin AXIS_DESCR COM_AXIS AXIN_0AF CM_RAW 8 0 65535 AXIS_PTS_REF AX_0AF /end AXIS_DESCR
/end CHARACTERISTIC
/begin CHARACTERISTIC CAL_6E2 "карта #6E2 8x8: N × ?" MAP 0x08073830 RL_FNC_UWORD 0 CM_RAW 0 65535
 /begin AXIS_DESCR COM_AXIS AXIN_0AC_N CM_RPM2 8 0 32767.5 AXIS_PTS_REF AX_0AC_N /end AXIS_DESCR
 /begin AXIS_DESCR COM_AXIS AXIN_0AF CM_RAW 8 0 65535 AXIS_PTS_REF AX_0AF /end AXIS_DESCR
/end CHARACTERISTIC
/begin CHARACTERISTIC CAL_6E3 "карта #6E3 8x9: N × GEAR" MAP 0x080738B0 RL_FNC_UWORD 0 CM_RAW 0 65535
 /begin AXIS_DESCR COM_AXIS AXIN_0AD_N CM_RPM2 9 0 32767.5 AXIS_PTS_REF AX_0AD_N /end AXIS_DESCR
 /begin AXIS_DESCR COM_AXIS AXIN_05E_GEAR CM_RAW 8 -128 127 AXIS_PTS_REF AX_05E_GEAR /end AXIS_DESCR
/end CHARACTERISTIC
/begin CHARACTERISTIC CAL_6E4 "кривая #6E4 8: ?" CURVE 0x08073B94 RL_FNC_SWORD 0 CM_RAW -32768 32767 /begin AXIS_DESCR COM_AXIS AXIN_0AF CM_RAW 8 0 65535 AXIS_PTS_REF AX_0AF /end AXIS_DESCR /end CHARACTERISTIC
/begin CHARACTERISTIC CAL_6E5 "кривая #6E5 17: N" CURVE 0x080691CC RL_FNC_UWORD 0 CM_RAW 0 65535
 /begin AXIS_DESCR COM_AXIS AXIN_001_N CM_RPM2 17 0 32767.5 AXIS_PTS_REF AX_001_N /end AXIS_DESCR
/end CHARACTERISTIC
/begin CHARACTERISTIC CAL_6E6 "значение #6E6" VALUE 0x080691F8 RL_FNC_UWORD 0 CM_RAW 0 65535 /end CHARACTERISTIC
/begin CHARACTERISTIC CAL_6E7 "значение #6E7" VALUE 0x08069288 RL_FNC_SBYTE 0 CM_RAW -128 127 /end CHARACTERISTIC
/begin CHARACTERISTIC CAL_6E8 "значение #6E8" VALUE 0x08069289 RL_FNC_SBYTE 0 CM_RAW -128 127 /end CHARACTERISTIC
/begin CHARACTERISTIC CAL_6E9_0 "кривая #6E9 17: N [1/2]" CURVE 0x08069398 RL_FNC_UWORD 0 CM_RAW 0 65535
 /begin AXIS_DESCR COM_AXIS AXIN_001_N CM_RPM2 17 0 32767.5 AXIS_PTS_REF AX_001_N /end AXIS_DESCR
/end CHARACTERISTIC
/begin CHARACTERISTIC CAL_6E9_1 "кривая #6E9 17: N [2/2]" CURVE 0x080693BA RL_FNC_UWORD 0 CM_RAW 0 65535
 /begin AXIS_DESCR COM_AXIS AXIN_001_N CM_RPM2 17 0 32767.5 AXIS_PTS_REF AX_001_N /end AXIS_DESCR
/end CHARACTERISTIC
/begin CHARACTERISTIC CAL_6EA "значение #6EA" VALUE 0x08073BA6 RL_FNC_UWORD 0 CM_RAW 0 65535 /end CHARACTERISTIC
/begin CHARACTERISTIC CAL_6EB "значение #6EB" VALUE 0x08073DC2 RL_FNC_UWORD 0 CM_RAW 0 65535 /end CHARACTERISTIC
/begin CHARACTERISTIC CAL_6EC_0 "кривая #6EC 8: N [1/13]" CURVE 0x08073BB8 RL_FNC_UWORD 0 CM_RAW 0 65535
 /begin AXIS_DESCR COM_AXIS AXIN_050_N CM_RPM2 8 0 32767.5 AXIS_PTS_REF AX_050_N /end AXIS_DESCR
/end CHARACTERISTIC
/begin CHARACTERISTIC CAL_6EC_1 "кривая #6EC 8: N [2/13]" CURVE 0x08073BC8 RL_FNC_UWORD 0 CM_RAW 0 65535
 /begin AXIS_DESCR COM_AXIS AXIN_050_N CM_RPM2 8 0 32767.5 AXIS_PTS_REF AX_050_N /end AXIS_DESCR
/end CHARACTERISTIC
/begin CHARACTERISTIC CAL_6EC_2 "кривая #6EC 8: N [3/13]" CURVE 0x08073BD8 RL_FNC_UWORD 0 CM_RAW 0 65535
 /begin AXIS_DESCR COM_AXIS AXIN_050_N CM_RPM2 8 0 32767.5 AXIS_PTS_REF AX_050_N /end AXIS_DESCR
/end CHARACTERISTIC
/begin CHARACTERISTIC CAL_6EC_3 "кривая #6EC 8: N [4/13]" CURVE 0x08073BE8 RL_FNC_UWORD 0 CM_RAW 0 65535
 /begin AXIS_DESCR COM_AXIS AXIN_050_N CM_RPM2 8 0 32767.5 AXIS_PTS_REF AX_050_N /end AXIS_DESCR
/end CHARACTERISTIC
/begin CHARACTERISTIC CAL_6EC_4 "кривая #6EC 8: N [5/13]" CURVE 0x08073BF8 RL_FNC_UWORD 0 CM_RAW 0 65535
 /begin AXIS_DESCR COM_AXIS AXIN_050_N CM_RPM2 8 0 32767.5 AXIS_PTS_REF AX_050_N /end AXIS_DESCR
/end CHARACTERISTIC
/begin CHARACTERISTIC CAL_6EC_5 "кривая #6EC 8: N [6/13]" CURVE 0x08073C08 RL_FNC_UWORD 0 CM_RAW 0 65535
 /begin AXIS_DESCR COM_AXIS AXIN_050_N CM_RPM2 8 0 32767.5 AXIS_PTS_REF AX_050_N /end AXIS_DESCR
/end CHARACTERISTIC
/begin CHARACTERISTIC CAL_6EC_6 "кривая #6EC 8: N [7/13]" CURVE 0x08073C18 RL_FNC_UWORD 0 CM_RAW 0 65535
 /begin AXIS_DESCR COM_AXIS AXIN_050_N CM_RPM2 8 0 32767.5 AXIS_PTS_REF AX_050_N /end AXIS_DESCR
/end CHARACTERISTIC
/begin CHARACTERISTIC CAL_6EC_7 "кривая #6EC 8: N [8/13]" CURVE 0x08073C28 RL_FNC_UWORD 0 CM_RAW 0 65535
 /begin AXIS_DESCR COM_AXIS AXIN_050_N CM_RPM2 8 0 32767.5 AXIS_PTS_REF AX_050_N /end AXIS_DESCR
/end CHARACTERISTIC
/begin CHARACTERISTIC CAL_6EC_8 "кривая #6EC 8: N [9/13]" CURVE 0x08073C38 RL_FNC_UWORD 0 CM_RAW 0 65535
 /begin AXIS_DESCR COM_AXIS AXIN_050_N CM_RPM2 8 0 32767.5 AXIS_PTS_REF AX_050_N /end AXIS_DESCR
/end CHARACTERISTIC
/begin CHARACTERISTIC CAL_6EC_9 "кривая #6EC 8: N [10/13]" CURVE 0x08073C48 RL_FNC_UWORD 0 CM_RAW 0 65535
 /begin AXIS_DESCR COM_AXIS AXIN_050_N CM_RPM2 8 0 32767.5 AXIS_PTS_REF AX_050_N /end AXIS_DESCR
/end CHARACTERISTIC
/begin CHARACTERISTIC CAL_6EC_10 "кривая #6EC 8: N [11/13]" CURVE 0x08073C58 RL_FNC_UWORD 0 CM_RAW 0 65535
 /begin AXIS_DESCR COM_AXIS AXIN_050_N CM_RPM2 8 0 32767.5 AXIS_PTS_REF AX_050_N /end AXIS_DESCR
/end CHARACTERISTIC
/begin CHARACTERISTIC CAL_6EC_11 "кривая #6EC 8: N [12/13]" CURVE 0x08073C68 RL_FNC_UWORD 0 CM_RAW 0 65535
 /begin AXIS_DESCR COM_AXIS AXIN_050_N CM_RPM2 8 0 32767.5 AXIS_PTS_REF AX_050_N /end AXIS_DESCR
/end CHARACTERISTIC
/begin CHARACTERISTIC CAL_6EC_12 "кривая #6EC 8: N [13/13]" CURVE 0x08073C78 RL_FNC_UWORD 0 CM_RAW 0 65535
 /begin AXIS_DESCR COM_AXIS AXIN_050_N CM_RPM2 8 0 32767.5 AXIS_PTS_REF AX_050_N /end AXIS_DESCR
/end CHARACTERISTIC
/begin CHARACTERISTIC CAL_6ED "карта #6ED 13x2: ? × ?" MAP 0x08073DA8 RL_FNC_SBYTE 0 CM_RAW -128 127 /begin AXIS_DESCR COM_AXIS AXIN_0BC CM_RAW 2 -128 127 AXIS_PTS_REF AX_0BC /end AXIS_DESCR /begin AXIS_DESCR COM_AXIS AXIN_0BA CM_RAW 13 -128 127 AXIS_PTS_REF AX_0BA /end AXIS_DESCR /end CHARACTERISTIC
/begin CHARACTERISTIC CAL_6EE "карта #6EE 13x2: ? × ?" MAP 0x08073D8C RL_FNC_SBYTE 0 CM_RAW -128 127 /begin AXIS_DESCR COM_AXIS AXIN_0BC CM_RAW 2 -128 127 AXIS_PTS_REF AX_0BC /end AXIS_DESCR /begin AXIS_DESCR COM_AXIS AXIN_0BA CM_RAW 13 -128 127 AXIS_PTS_REF AX_0BA /end AXIS_DESCR /end CHARACTERISTIC
/begin CHARACTERISTIC CAL_6EF_0 "кривая #6EF 10: N [1/13]" CURVE 0x08073C88 RL_FNC_UWORD 0 CM_RAW 0 65535
 /begin AXIS_DESCR COM_AXIS AXIN_00C_N CM_RPM2 10 0 32767.5 AXIS_PTS_REF AX_00C_N /end AXIS_DESCR
/end CHARACTERISTIC
/begin CHARACTERISTIC CAL_6EF_1 "кривая #6EF 10: N [2/13]" CURVE 0x08073C9C RL_FNC_UWORD 0 CM_RAW 0 65535
 /begin AXIS_DESCR COM_AXIS AXIN_00C_N CM_RPM2 10 0 32767.5 AXIS_PTS_REF AX_00C_N /end AXIS_DESCR
/end CHARACTERISTIC
/begin CHARACTERISTIC CAL_6EF_2 "кривая #6EF 10: N [3/13]" CURVE 0x08073CB0 RL_FNC_UWORD 0 CM_RAW 0 65535
 /begin AXIS_DESCR COM_AXIS AXIN_00C_N CM_RPM2 10 0 32767.5 AXIS_PTS_REF AX_00C_N /end AXIS_DESCR
/end CHARACTERISTIC
/begin CHARACTERISTIC CAL_6EF_3 "кривая #6EF 10: N [4/13]" CURVE 0x08073CC4 RL_FNC_UWORD 0 CM_RAW 0 65535
 /begin AXIS_DESCR COM_AXIS AXIN_00C_N CM_RPM2 10 0 32767.5 AXIS_PTS_REF AX_00C_N /end AXIS_DESCR
/end CHARACTERISTIC
/begin CHARACTERISTIC CAL_6EF_4 "кривая #6EF 10: N [5/13]" CURVE 0x08073CD8 RL_FNC_UWORD 0 CM_RAW 0 65535
 /begin AXIS_DESCR COM_AXIS AXIN_00C_N CM_RPM2 10 0 32767.5 AXIS_PTS_REF AX_00C_N /end AXIS_DESCR
/end CHARACTERISTIC
/begin CHARACTERISTIC CAL_6EF_5 "кривая #6EF 10: N [6/13]" CURVE 0x08073CEC RL_FNC_UWORD 0 CM_RAW 0 65535
 /begin AXIS_DESCR COM_AXIS AXIN_00C_N CM_RPM2 10 0 32767.5 AXIS_PTS_REF AX_00C_N /end AXIS_DESCR
/end CHARACTERISTIC
/begin CHARACTERISTIC CAL_6EF_6 "кривая #6EF 10: N [7/13]" CURVE 0x08073D00 RL_FNC_UWORD 0 CM_RAW 0 65535
 /begin AXIS_DESCR COM_AXIS AXIN_00C_N CM_RPM2 10 0 32767.5 AXIS_PTS_REF AX_00C_N /end AXIS_DESCR
/end CHARACTERISTIC
/begin CHARACTERISTIC CAL_6EF_7 "кривая #6EF 10: N [8/13]" CURVE 0x08073D14 RL_FNC_UWORD 0 CM_RAW 0 65535
 /begin AXIS_DESCR COM_AXIS AXIN_00C_N CM_RPM2 10 0 32767.5 AXIS_PTS_REF AX_00C_N /end AXIS_DESCR
/end CHARACTERISTIC
/begin CHARACTERISTIC CAL_6EF_8 "кривая #6EF 10: N [9/13]" CURVE 0x08073D28 RL_FNC_UWORD 0 CM_RAW 0 65535
 /begin AXIS_DESCR COM_AXIS AXIN_00C_N CM_RPM2 10 0 32767.5 AXIS_PTS_REF AX_00C_N /end AXIS_DESCR
/end CHARACTERISTIC
/begin CHARACTERISTIC CAL_6EF_9 "кривая #6EF 10: N [10/13]" CURVE 0x08073D3C RL_FNC_UWORD 0 CM_RAW 0 65535
 /begin AXIS_DESCR COM_AXIS AXIN_00C_N CM_RPM2 10 0 32767.5 AXIS_PTS_REF AX_00C_N /end AXIS_DESCR
/end CHARACTERISTIC
/begin CHARACTERISTIC CAL_6EF_10 "кривая #6EF 10: N [11/13]" CURVE 0x08073D50 RL_FNC_UWORD 0 CM_RAW 0 65535
 /begin AXIS_DESCR COM_AXIS AXIN_00C_N CM_RPM2 10 0 32767.5 AXIS_PTS_REF AX_00C_N /end AXIS_DESCR
/end CHARACTERISTIC
/begin CHARACTERISTIC CAL_6EF_11 "кривая #6EF 10: N [12/13]" CURVE 0x08073D64 RL_FNC_UWORD 0 CM_RAW 0 65535
 /begin AXIS_DESCR COM_AXIS AXIN_00C_N CM_RPM2 10 0 32767.5 AXIS_PTS_REF AX_00C_N /end AXIS_DESCR
/end CHARACTERISTIC
/begin CHARACTERISTIC CAL_6EF_12 "кривая #6EF 10: N [13/13]" CURVE 0x08073D78 RL_FNC_UWORD 0 CM_RAW 0 65535
 /begin AXIS_DESCR COM_AXIS AXIN_00C_N CM_RPM2 10 0 32767.5 AXIS_PTS_REF AX_00C_N /end AXIS_DESCR
/end CHARACTERISTIC
/begin CHARACTERISTIC CAL_6F0 "значение #6F0" VALUE 0x08073DC6 RL_FNC_UWORD 0 CM_RAW 0 65535 /end CHARACTERISTIC
/begin CHARACTERISTIC CAL_6F1_0 "кривая #6F1 8: ? [1/2]" CURVE 0x08073DC8 RL_FNC_UWORD 0 CM_RAW 0 65535 /begin AXIS_DESCR COM_AXIS AXIN_0BB CM_RAW 8 0 65535 AXIS_PTS_REF AX_0BB /end AXIS_DESCR /end CHARACTERISTIC
/begin CHARACTERISTIC CAL_6F1_1 "кривая #6F1 8: ? [2/2]" CURVE 0x08073DD8 RL_FNC_UWORD 0 CM_RAW 0 65535 /begin AXIS_DESCR COM_AXIS AXIN_0BB CM_RAW 8 0 65535 AXIS_PTS_REF AX_0BB /end AXIS_DESCR /end CHARACTERISTIC
/begin CHARACTERISTIC CAL_6F2_0 "кривая #6F2 8: ? [1/2]" CURVE 0x08073DE8 RL_FNC_UWORD 0 CM_RAW 0 65535 /begin AXIS_DESCR COM_AXIS AXIN_0BB CM_RAW 8 0 65535 AXIS_PTS_REF AX_0BB /end AXIS_DESCR /end CHARACTERISTIC
/begin CHARACTERISTIC CAL_6F2_1 "кривая #6F2 8: ? [2/2]" CURVE 0x08073DF8 RL_FNC_UWORD 0 CM_RAW 0 65535 /begin AXIS_DESCR COM_AXIS AXIN_0BB CM_RAW 8 0 65535 AXIS_PTS_REF AX_0BB /end AXIS_DESCR /end CHARACTERISTIC
/begin CHARACTERISTIC CAL_6F3 "карта #6F3 13x2: ? × ?" MAP 0x08073E08 RL_FNC_UWORD 0 CM_RAW 0 65535 /begin AXIS_DESCR COM_AXIS AXIN_0BC CM_RAW 2 -128 127 AXIS_PTS_REF AX_0BC /end AXIS_DESCR /begin AXIS_DESCR COM_AXIS AXIN_0BA CM_RAW 13 -128 127 AXIS_PTS_REF AX_0BA /end AXIS_DESCR /end CHARACTERISTIC
/begin CHARACTERISTIC CAL_6F4 "значение #6F4" VALUE 0x08073F5C RL_FNC_SWORD 0 CM_RAW -32768 32767 /end CHARACTERISTIC
/begin CHARACTERISTIC CAL_6F5 "значение #6F5" VALUE 0x08073E3C RL_FNC_SWORD 0 CM_RAW -32768 32767 /end CHARACTERISTIC
/begin CHARACTERISTIC CAL_6F6 "карта #6F6 2x2: ? × ?" MAP 0x08073E40 RL_FNC_UWORD 0 CM_RAW 0 65535 /begin AXIS_DESCR COM_AXIS AXIN_0BC CM_RAW 2 -128 127 AXIS_PTS_REF AX_0BC /end AXIS_DESCR /begin AXIS_DESCR COM_AXIS AXIN_0BC CM_RAW 2 -128 127 AXIS_PTS_REF AX_0BC /end AXIS_DESCR /end CHARACTERISTIC
/begin CHARACTERISTIC CAL_6F7_0 "кривая #6F7 8: ? [1/2]" CURVE 0x08073EE8 RL_FNC_UWORD 0 CM_RAW 0 65535 /begin AXIS_DESCR COM_AXIS AXIN_0BB CM_RAW 8 0 65535 AXIS_PTS_REF AX_0BB /end AXIS_DESCR /end CHARACTERISTIC
/begin CHARACTERISTIC CAL_6F7_1 "кривая #6F7 8: ? [2/2]" CURVE 0x08073EF8 RL_FNC_UWORD 0 CM_RAW 0 65535 /begin AXIS_DESCR COM_AXIS AXIN_0BB CM_RAW 8 0 65535 AXIS_PTS_REF AX_0BB /end AXIS_DESCR /end CHARACTERISTIC
/begin CHARACTERISTIC CAL_6F8_0 "кривая #6F8 8: ? [1/2]" CURVE 0x08073F08 RL_FNC_UWORD 0 CM_RAW 0 65535 /begin AXIS_DESCR COM_AXIS AXIN_0BB CM_RAW 8 0 65535 AXIS_PTS_REF AX_0BB /end AXIS_DESCR /end CHARACTERISTIC
/begin CHARACTERISTIC CAL_6F8_1 "кривая #6F8 8: ? [2/2]" CURVE 0x08073F18 RL_FNC_UWORD 0 CM_RAW 0 65535 /begin AXIS_DESCR COM_AXIS AXIN_0BB CM_RAW 8 0 65535 AXIS_PTS_REF AX_0BB /end AXIS_DESCR /end CHARACTERISTIC
/begin CHARACTERISTIC CAL_6F9 "карта #6F9 13x2: ? × ?" MAP 0x08073F28 RL_FNC_UWORD 0 CM_RAW 0 65535 /begin AXIS_DESCR COM_AXIS AXIN_0BC CM_RAW 2 -128 127 AXIS_PTS_REF AX_0BC /end AXIS_DESCR /begin AXIS_DESCR COM_AXIS AXIN_0BA CM_RAW 13 -128 127 AXIS_PTS_REF AX_0BA /end AXIS_DESCR /end CHARACTERISTIC
/begin CHARACTERISTIC CAL_6FA "карта #6FA 8x10: N × ?" MAP 0x08073E48 RL_FNC_UWORD 0 CM_RAW 0 65535
 /begin AXIS_DESCR COM_AXIS AXIN_00C_N CM_RPM2 10 0 32767.5 AXIS_PTS_REF AX_00C_N /end AXIS_DESCR
 /begin AXIS_DESCR COM_AXIS AXIN_0BB CM_RAW 8 0 65535 AXIS_PTS_REF AX_0BB /end AXIS_DESCR
/end CHARACTERISTIC
/begin CHARACTERISTIC CAL_6FC "массив #6FC" VAL_BLK 0x0806842C RL_FNC_SBYTE 0 CM_RAW -128 127 MATRIX_DIM 4 1 1 /end CHARACTERISTIC
/begin CHARACTERISTIC CAL_6FD "значение #6FD" VALUE 0x08068494 RL_FNC_SLONG 0 CM_RAW -2.14748e+09 2.14748e+09 /end CHARACTERISTIC
/begin CHARACTERISTIC CAL_6FE "карта #6FE 3x9: ? × ?" MAP 0x08068478 RL_FNC_SBYTE 0 CM_RAW -128 127 /begin AXIS_DESCR COM_AXIS AXIN_070 CM_RAW 9 -128 127 AXIS_PTS_REF AX_070 /end AXIS_DESCR /begin AXIS_DESCR COM_AXIS AXIN_0BD CM_RAW 3 -128 127 AXIS_PTS_REF AX_0BD /end AXIS_DESCR /end CHARACTERISTIC
/begin CHARACTERISTIC CAL_6FF_0 "карта #6FF 3x6: ? × ? [1/4]" MAP 0x08068430 RL_FNC_SBYTE 0 CM_RAW -128 127 /begin AXIS_DESCR COM_AXIS AXIN_071 CM_RAW 6 -128 127 AXIS_PTS_REF AX_071 /end AXIS_DESCR /begin AXIS_DESCR COM_AXIS AXIN_0BD CM_RAW 3 -128 127 AXIS_PTS_REF AX_0BD /end AXIS_DESCR /end CHARACTERISTIC
/begin CHARACTERISTIC CAL_6FF_1 "карта #6FF 3x6: ? × ? [2/4]" MAP 0x08068442 RL_FNC_SBYTE 0 CM_RAW -128 127 /begin AXIS_DESCR COM_AXIS AXIN_071 CM_RAW 6 -128 127 AXIS_PTS_REF AX_071 /end AXIS_DESCR /begin AXIS_DESCR COM_AXIS AXIN_0BD CM_RAW 3 -128 127 AXIS_PTS_REF AX_0BD /end AXIS_DESCR /end CHARACTERISTIC
/begin CHARACTERISTIC CAL_6FF_2 "карта #6FF 3x6: ? × ? [3/4]" MAP 0x08068454 RL_FNC_SBYTE 0 CM_RAW -128 127 /begin AXIS_DESCR COM_AXIS AXIN_071 CM_RAW 6 -128 127 AXIS_PTS_REF AX_071 /end AXIS_DESCR /begin AXIS_DESCR COM_AXIS AXIN_0BD CM_RAW 3 -128 127 AXIS_PTS_REF AX_0BD /end AXIS_DESCR /end CHARACTERISTIC
/begin CHARACTERISTIC CAL_6FF_3 "карта #6FF 3x6: ? × ? [4/4]" MAP 0x08068466 RL_FNC_SBYTE 0 CM_RAW -128 127 /begin AXIS_DESCR COM_AXIS AXIN_071 CM_RAW 6 -128 127 AXIS_PTS_REF AX_071 /end AXIS_DESCR /begin AXIS_DESCR COM_AXIS AXIN_0BD CM_RAW 3 -128 127 AXIS_PTS_REF AX_0BD /end AXIS_DESCR /end CHARACTERISTIC
/begin CHARACTERISTIC CAL_700 "массив #700" VAL_BLK 0x08068F70 RL_FNC_SBYTE 0 CM_RAW -128 127 MATRIX_DIM 4 1 1 /end CHARACTERISTIC
/begin CHARACTERISTIC CAL_701 "значение #701" VALUE 0x08068F84 RL_FNC_SBYTE 0 CM_RAW -128 127 /end CHARACTERISTIC
/begin CHARACTERISTIC CAL_702 "массив #702" VAL_BLK 0x08068F90 RL_FNC_SLONG 0 CM_RAW -2.14748e+09 2.14748e+09 MATRIX_DIM 7 1 1 /end CHARACTERISTIC
/begin CHARACTERISTIC CAL_704 "значение #704" VALUE 0x08068254 RL_FNC_UWORD 0 CM_RAW 0 65535 /end CHARACTERISTIC
/begin CHARACTERISTIC CAL_705 "кривая #705 9: ?" CURVE 0x08068258 RL_FNC_UWORD 0 CM_RAW 0 65535 /begin AXIS_DESCR COM_AXIS AXIN_0BF CM_RAW 9 0 65535 AXIS_PTS_REF AX_0BF /end AXIS_DESCR /end CHARACTERISTIC
/begin CHARACTERISTIC CAL_706 "значение #706" VALUE 0x08068288 RL_FNC_UWORD 0 CM_RAW 0 65535 /end CHARACTERISTIC
/begin CHARACTERISTIC CAL_707 "карта #707 9x14: UBAT × TCOOL" MAP 0x080682EC RL_FNC_UWORD 0 CM_RAW 0 65535
 /begin AXIS_DESCR COM_AXIS AXIN_003_UBAT CM_RAW 14 0 65535 AXIS_PTS_REF AX_003_UBAT /end AXIS_DESCR
 /begin AXIS_DESCR COM_AXIS AXIN_00A_TCOOL CM_C128 9 -256 255.992 AXIS_PTS_REF AX_00A_TCOOL /end AXIS_DESCR
/end CHARACTERISTIC
/begin CHARACTERISTIC CAL_708 "значение #708" VALUE 0x080683E8 RL_FNC_UWORD 0 CM_RAW 0 65535 /end CHARACTERISTIC
/begin CHARACTERISTIC CAL_709 "кривая #709 17: N" CURVE 0x080682C8 RL_FNC_UWORD 0 CM_RAW 0 65535
 /begin AXIS_DESCR COM_AXIS AXIN_001_N CM_RPM2 17 0 32767.5 AXIS_PTS_REF AX_001_N /end AXIS_DESCR
/end CHARACTERISTIC
/begin CHARACTERISTIC CAL_70A "значение #70A" VALUE 0x080683EC RL_FNC_SLONG 0 CM_RAW -2.14748e+09 2.14748e+09 /end CHARACTERISTIC
/begin CHARACTERISTIC CAL_70B "кривая #70B 14: UBAT" CURVE 0x080683F0 RL_FNC_SLONG 0 CM_RAW -2.14748e+09 2.14748e+09
 /begin AXIS_DESCR COM_AXIS AXIN_003_UBAT CM_RAW 14 0 65535 AXIS_PTS_REF AX_003_UBAT /end AXIS_DESCR
/end CHARACTERISTIC
/begin CHARACTERISTIC CAL_70C "массив #70C [знак по значениям]" VAL_BLK 0x0806828C RL_FNC_SWORD 0 CM_RAW -32768 32767 MATRIX_DIM 2 1 1 /end CHARACTERISTIC
/begin CHARACTERISTIC CAL_70D "массив #70D" VAL_BLK 0x08068294 RL_FNC_SWORD 0 CM_RAW -32768 32767 MATRIX_DIM 2 1 1 /end CHARACTERISTIC
/begin CHARACTERISTIC CAL_70E "значение #70E" VALUE 0x080682A0 RL_FNC_UWORD 0 CM_RAW 0 65535 /end CHARACTERISTIC
/begin CHARACTERISTIC CAL_70F "массив #70F" VAL_BLK 0x080681E4 RL_FNC_SWORD 0 CM_RAW -32768 32767 MATRIX_DIM 16 1 1 /end CHARACTERISTIC
/begin CHARACTERISTIC CAL_714 "массив #714" VAL_BLK 0x08068250 RL_FNC_SBYTE 0 CM_RAW -128 127 MATRIX_DIM 4 1 1 /end CHARACTERISTIC
/begin CHARACTERISTIC CAL_715 "значение #715" VALUE 0x08068280 RL_FNC_SBYTE 0 CM_RAW -128 127 /end CHARACTERISTIC
/begin CHARACTERISTIC CAL_716 "кривая #716 4: ?" CURVE 0x08061A50 RL_FNC_UWORD 0 CM_RAW 0 65535 /begin AXIS_DESCR COM_AXIS AXIN_0C2 CM_RAW 4 0 65535 AXIS_PTS_REF AX_0C2 /end AXIS_DESCR /end CHARACTERISTIC
/begin CHARACTERISTIC CAL_717 "значение #717" VALUE 0x08061A58 RL_FNC_UWORD 0 CM_RAW 0 65535 /end CHARACTERISTIC
/begin CHARACTERISTIC CAL_718 "кривая #718 4: ?" CURVE 0x08061A5C RL_FNC_UWORD 0 CM_RAW 0 65535 /begin AXIS_DESCR COM_AXIS AXIN_0C3 CM_RAW 4 0 65535 AXIS_PTS_REF AX_0C3 /end AXIS_DESCR /end CHARACTERISTIC
/begin CHARACTERISTIC CAL_719 "кривая #719 4: ?" CURVE 0x08061A68 RL_FNC_UWORD 0 CM_RAW 0 65535 /begin AXIS_DESCR COM_AXIS AXIN_0C1 CM_RAW 4 0 65535 AXIS_PTS_REF AX_0C1 /end AXIS_DESCR /end CHARACTERISTIC
/begin CHARACTERISTIC CAL_71A "значение #71A" VALUE 0x08061A64 RL_FNC_UWORD 0 CM_RAW 0 65535 /end CHARACTERISTIC
/begin CHARACTERISTIC CAL_71B "массив #71B" VAL_BLK 0x08061A74 RL_FNC_SWORD 0 CM_RAW -32768 32767 MATRIX_DIM 2 1 1 /end CHARACTERISTIC
/begin CHARACTERISTIC CAL_71C "значение #71C" VALUE 0x08061A70 RL_FNC_UWORD 0 CM_RAW 0 65535 /end CHARACTERISTIC
/begin CHARACTERISTIC CAL_71D "значение #71D" VALUE 0x08061A72 RL_FNC_UWORD 0 CM_RAW 0 65535 /end CHARACTERISTIC
/begin CHARACTERISTIC CAL_71E "значение #71E" VALUE 0x0807495A RL_FNC_UWORD 0 CM_RAW 0 65535 /end CHARACTERISTIC
/begin CHARACTERISTIC CAL_71F "массив #71F" VAL_BLK 0x0806BDD8 RL_FNC_UWORD 0 CM_RAW 0 65535 MATRIX_DIM 2 1 1 /end CHARACTERISTIC
/begin CHARACTERISTIC CAL_720_0 "кривая #720 10: N [1/2]" CURVE 0x0806BDF4 RL_FNC_UWORD 0 CM_RAW 0 65535
 /begin AXIS_DESCR COM_AXIS AXIN_00C_N CM_RPM2 10 0 32767.5 AXIS_PTS_REF AX_00C_N /end AXIS_DESCR
/end CHARACTERISTIC
/begin CHARACTERISTIC CAL_720_1 "кривая #720 10: N [2/2]" CURVE 0x0806BE08 RL_FNC_UWORD 0 CM_RAW 0 65535
 /begin AXIS_DESCR COM_AXIS AXIN_00C_N CM_RPM2 10 0 32767.5 AXIS_PTS_REF AX_00C_N /end AXIS_DESCR
/end CHARACTERISTIC
/begin CHARACTERISTIC CAL_721 "значение #721" VALUE 0x0806C2EE RL_FNC_UWORD 0 CM_RAW 0 65535 /end CHARACTERISTIC
/begin CHARACTERISTIC CAL_722_0 "кривая #722 8: ? [1/2] [знак по значениям]" CURVE 0x0806CCA4 RL_FNC_SWORD 0 CM_RAW -32768 32767 /begin AXIS_DESCR COM_AXIS AXIN_0C4 CM_RAW 8 0 65535 AXIS_PTS_REF AX_0C4 /end AXIS_DESCR /end CHARACTERISTIC
/begin CHARACTERISTIC CAL_722_1 "кривая #722 8: ? [2/2] [знак по значениям]" CURVE 0x0806CCB4 RL_FNC_SWORD 0 CM_RAW -32768 32767 /begin AXIS_DESCR COM_AXIS AXIN_0C4 CM_RAW 8 0 65535 AXIS_PTS_REF AX_0C4 /end AXIS_DESCR /end CHARACTERISTIC
/begin CHARACTERISTIC CAL_723_0 "кривая #723 8: ? [1/2]" CURVE 0x0806CCD0 RL_FNC_UWORD 0 CM_RAW 0 65535 /begin AXIS_DESCR COM_AXIS AXIN_0C4 CM_RAW 8 0 65535 AXIS_PTS_REF AX_0C4 /end AXIS_DESCR /end CHARACTERISTIC
/begin CHARACTERISTIC CAL_723_1 "кривая #723 8: ? [2/2]" CURVE 0x0806CCE0 RL_FNC_UWORD 0 CM_RAW 0 65535 /begin AXIS_DESCR COM_AXIS AXIN_0C4 CM_RAW 8 0 65535 AXIS_PTS_REF AX_0C4 /end AXIS_DESCR /end CHARACTERISTIC
/begin CHARACTERISTIC CAL_724_0 "кривая #724 8: ? [1/2]" CURVE 0x0806CCF0 RL_FNC_UWORD 0 CM_RAW 0 65535 /begin AXIS_DESCR COM_AXIS AXIN_0C4 CM_RAW 8 0 65535 AXIS_PTS_REF AX_0C4 /end AXIS_DESCR /end CHARACTERISTIC
/begin CHARACTERISTIC CAL_724_1 "кривая #724 8: ? [2/2]" CURVE 0x0806CD00 RL_FNC_UWORD 0 CM_RAW 0 65535 /begin AXIS_DESCR COM_AXIS AXIN_0C4 CM_RAW 8 0 65535 AXIS_PTS_REF AX_0C4 /end AXIS_DESCR /end CHARACTERISTIC
/begin CHARACTERISTIC CAL_725 "массив #725" VAL_BLK 0x0806CD1C RL_FNC_UWORD 0 CM_RAW 0 65535 MATRIX_DIM 2 1 1 /end CHARACTERISTIC
/begin CHARACTERISTIC CAL_726 "значение #726" VALUE 0x0806BE1C RL_FNC_UWORD 0 CM_RAW 0 65535 /end CHARACTERISTIC
/begin CHARACTERISTIC CAL_727 "карта #727 25x24: N × ?" MAP 0x0806BE20 RL_FNC_UWORD 0 CM_RAW 0 65535
 /begin AXIS_DESCR COM_AXIS AXIN_0C5_N CM_RPM2 24 0 32767.5 AXIS_PTS_REF AX_0C5_N /end AXIS_DESCR
 /begin AXIS_DESCR COM_AXIS AXIN_0C7 CM_RAW 25 0 65535 AXIS_PTS_REF AX_0C7 /end AXIS_DESCR
/end CHARACTERISTIC
/begin CHARACTERISTIC CAL_728 "значение #728" VALUE 0x0806C2D0 RL_FNC_UWORD 0 CM_RAW 0 65535 /end CHARACTERISTIC
/begin CHARACTERISTIC CAL_729 "значение #729" VALUE 0x0806C2D2 RL_FNC_UWORD 0 CM_RAW 0 65535 /end CHARACTERISTIC
/begin CHARACTERISTIC CAL_72A "значение #72A" VALUE 0x0806C2EC RL_FNC_UWORD 0 CM_RAW 0 65535 /end CHARACTERISTIC
/begin CHARACTERISTIC CAL_72B_0 "кривая #72B 8: ? [1/2]" CURVE 0x0806CC64 RL_FNC_UWORD 0 CM_RAW 0 65535 /begin AXIS_DESCR COM_AXIS AXIN_0C9 CM_RAW 8 0 65535 AXIS_PTS_REF AX_0C9 /end AXIS_DESCR /end CHARACTERISTIC
/begin CHARACTERISTIC CAL_72B_1 "кривая #72B 8: ? [2/2]" CURVE 0x0806CC74 RL_FNC_UWORD 0 CM_RAW 0 65535 /begin AXIS_DESCR COM_AXIS AXIN_0C9 CM_RAW 8 0 65535 AXIS_PTS_REF AX_0C9 /end AXIS_DESCR /end CHARACTERISTIC
/begin CHARACTERISTIC CAL_72C_0 "кривая #72C 8: ? [1/2]" CURVE 0x0806CC84 RL_FNC_UWORD 0 CM_RAW 0 65535 /begin AXIS_DESCR COM_AXIS AXIN_0C9 CM_RAW 8 0 65535 AXIS_PTS_REF AX_0C9 /end AXIS_DESCR /end CHARACTERISTIC
/begin CHARACTERISTIC CAL_72C_1 "кривая #72C 8: ? [2/2]" CURVE 0x0806CC94 RL_FNC_UWORD 0 CM_RAW 0 65535 /begin AXIS_DESCR COM_AXIS AXIN_0C9 CM_RAW 8 0 65535 AXIS_PTS_REF AX_0C9 /end AXIS_DESCR /end CHARACTERISTIC
/begin CHARACTERISTIC CAL_72D "массив #72D" VAL_BLK 0x0806CCC4 RL_FNC_UWORD 0 CM_RAW 0 65535 MATRIX_DIM 5 1 1 /end CHARACTERISTIC
/begin CHARACTERISTIC CAL_72E "массив #72E" VAL_BLK 0x0806CD10 RL_FNC_UWORD 0 CM_RAW 0 65535 MATRIX_DIM 3 1 1 /end CHARACTERISTIC
/begin CHARACTERISTIC CAL_72F "массив #72F [знак по значениям]" VAL_BLK 0x0806CD20 RL_FNC_SWORD 0 CM_RAW -32768 32767 MATRIX_DIM 2 1 1 /end CHARACTERISTIC
/begin CHARACTERISTIC CAL_730 "массив #730" VAL_BLK 0x0806CD24 RL_FNC_UWORD 0 CM_RAW 0 65535 MATRIX_DIM 5 1 1 /end CHARACTERISTIC
/begin CHARACTERISTIC CAL_731 "карта #731 25x24: N × ?" MAP 0x0806C304 RL_FNC_UWORD 0 CM_RAW 0 65535
 /begin AXIS_DESCR COM_AXIS AXIN_0C5_N CM_RPM2 24 0 32767.5 AXIS_PTS_REF AX_0C5_N /end AXIS_DESCR
 /begin AXIS_DESCR COM_AXIS AXIN_0C7 CM_RAW 25 0 65535 AXIS_PTS_REF AX_0C7 /end AXIS_DESCR
/end CHARACTERISTIC
/begin CHARACTERISTIC CAL_732 "карта #732 25x24: N × ?" MAP 0x0806C7B4 RL_FNC_UWORD 0 CM_RAW 0 65535
 /begin AXIS_DESCR COM_AXIS AXIN_0C6_N CM_RPM2 24 0 32767.5 AXIS_PTS_REF AX_0C6_N /end AXIS_DESCR
 /begin AXIS_DESCR COM_AXIS AXIN_0C7 CM_RAW 25 0 65535 AXIS_PTS_REF AX_0C7 /end AXIS_DESCR
/end CHARACTERISTIC
/begin CHARACTERISTIC CAL_733_0 "кривая #733 5: ? [1/2]" CURVE 0x0806BDC4 RL_FNC_UWORD 0 CM_RAW 0 65535 /begin AXIS_DESCR COM_AXIS AXIN_06E CM_RAW 5 0 65535 AXIS_PTS_REF AX_06E /end AXIS_DESCR /end CHARACTERISTIC
/begin CHARACTERISTIC CAL_733_1 "кривая #733 5: ? [2/2]" CURVE 0x0806BDCE RL_FNC_UWORD 0 CM_RAW 0 65535 /begin AXIS_DESCR COM_AXIS AXIN_06E CM_RAW 5 0 65535 AXIS_PTS_REF AX_06E /end AXIS_DESCR /end CHARACTERISTIC
/begin CHARACTERISTIC CAL_734_0 "кривая #734 5: ? [1/2]" CURVE 0x0806BDB0 RL_FNC_UWORD 0 CM_RAW 0 65535 /begin AXIS_DESCR COM_AXIS AXIN_06E CM_RAW 5 0 65535 AXIS_PTS_REF AX_06E /end AXIS_DESCR /end CHARACTERISTIC
/begin CHARACTERISTIC CAL_734_1 "кривая #734 5: ? [2/2]" CURVE 0x0806BDBA RL_FNC_UWORD 0 CM_RAW 0 65535 /begin AXIS_DESCR COM_AXIS AXIN_06E CM_RAW 5 0 65535 AXIS_PTS_REF AX_06E /end AXIS_DESCR /end CHARACTERISTIC
/begin CHARACTERISTIC CAL_735 "массив #735" VAL_BLK 0x0806BDDC RL_FNC_UWORD 0 CM_RAW 0 65535 MATRIX_DIM 2 1 1 /end CHARACTERISTIC
/begin CHARACTERISTIC CAL_736 "кривая #736 10: N" CURVE 0x0806BDE0 RL_FNC_UWORD 0 CM_RAW 0 65535
 /begin AXIS_DESCR COM_AXIS AXIN_00C_N CM_RPM2 10 0 32767.5 AXIS_PTS_REF AX_00C_N /end AXIS_DESCR
/end CHARACTERISTIC
/begin CHARACTERISTIC CAL_737 "значение #737" VALUE 0x0806C2D4 RL_FNC_SBYTE 0 CM_RAW -128 127 /end CHARACTERISTIC
/begin CHARACTERISTIC CAL_738 "кривая #738 10: N" CURVE 0x0806C2F0 RL_FNC_UWORD 0 CM_RAW 0 65535
 /begin AXIS_DESCR COM_AXIS AXIN_00C_N CM_RPM2 10 0 32767.5 AXIS_PTS_REF AX_00C_N /end AXIS_DESCR
/end CHARACTERISTIC
/begin CHARACTERISTIC CAL_739 "кривая #739 8: ?" CURVE 0x08065C4C RL_FNC_UWORD 0 CM_RAW 0 65535 /begin AXIS_DESCR COM_AXIS AXIN_05D CM_RAW 8 -128 127 AXIS_PTS_REF AX_05D /end AXIS_DESCR /end CHARACTERISTIC
/begin CHARACTERISTIC CAL_73A "кривая #73A 9: TCOOL [знак по значениям]" CURVE 0x08065A58 RL_FNC_SWORD 0 CM_RAW -32768 32767
 /begin AXIS_DESCR COM_AXIS AXIN_00A_TCOOL CM_C128 9 -256 255.992 AXIS_PTS_REF AX_00A_TCOOL /end AXIS_DESCR
/end CHARACTERISTIC
/begin CHARACTERISTIC CAL_73B "кривая #73B 9: ?" CURVE 0x08065A6C RL_FNC_UWORD 0 CM_RAW 0 65535 /begin AXIS_DESCR COM_AXIS AXIN_0CA CM_RAW 9 0 65535 AXIS_PTS_REF AX_0CA /end AXIS_DESCR /end CHARACTERISTIC
/begin CHARACTERISTIC CAL_73C "значение #73C" VALUE 0x08065A7E RL_FNC_SBYTE 0 CM_RAW -128 127 /end CHARACTERISTIC
/begin CHARACTERISTIC CAL_73D_0 "кривая #73D 8: GEAR [1/2]" CURVE 0x08065A80 RL_FNC_UWORD 0 CM_RAW 0 65535
 /begin AXIS_DESCR COM_AXIS AXIN_05E_GEAR CM_RAW 8 -128 127 AXIS_PTS_REF AX_05E_GEAR /end AXIS_DESCR
/end CHARACTERISTIC
/begin CHARACTERISTIC CAL_73D_1 "кривая #73D 8: GEAR [2/2]" CURVE 0x08065A90 RL_FNC_UWORD 0 CM_RAW 0 65535
 /begin AXIS_DESCR COM_AXIS AXIN_05E_GEAR CM_RAW 8 -128 127 AXIS_PTS_REF AX_05E_GEAR /end AXIS_DESCR
/end CHARACTERISTIC
/begin CHARACTERISTIC CAL_73E "кривая #73E 8: GEAR" CURVE 0x08065AA0 RL_FNC_UWORD 0 CM_RAW 0 65535
 /begin AXIS_DESCR COM_AXIS AXIN_05E_GEAR CM_RAW 8 -128 127 AXIS_PTS_REF AX_05E_GEAR /end AXIS_DESCR
/end CHARACTERISTIC
/begin CHARACTERISTIC CAL_73F "кривая #73F 8: GEAR" CURVE 0x08065AB0 RL_FNC_UWORD 0 CM_RAW 0 65535
 /begin AXIS_DESCR COM_AXIS AXIN_05E_GEAR CM_RAW 8 -128 127 AXIS_PTS_REF AX_05E_GEAR /end AXIS_DESCR
/end CHARACTERISTIC
/begin CHARACTERISTIC CAL_740_0 "кривая #740 9: ? [1/8]" CURVE 0x08065B30 RL_FNC_UWORD 0 CM_RAW 0 65535 /begin AXIS_DESCR COM_AXIS AXIN_0CA CM_RAW 9 0 65535 AXIS_PTS_REF AX_0CA /end AXIS_DESCR /end CHARACTERISTIC
/begin CHARACTERISTIC CAL_740_1 "кривая #740 9: ? [2/8]" CURVE 0x08065B42 RL_FNC_UWORD 0 CM_RAW 0 65535 /begin AXIS_DESCR COM_AXIS AXIN_0CA CM_RAW 9 0 65535 AXIS_PTS_REF AX_0CA /end AXIS_DESCR /end CHARACTERISTIC
/begin CHARACTERISTIC CAL_740_2 "кривая #740 9: ? [3/8]" CURVE 0x08065B54 RL_FNC_UWORD 0 CM_RAW 0 65535 /begin AXIS_DESCR COM_AXIS AXIN_0CA CM_RAW 9 0 65535 AXIS_PTS_REF AX_0CA /end AXIS_DESCR /end CHARACTERISTIC
/begin CHARACTERISTIC CAL_740_3 "кривая #740 9: ? [4/8]" CURVE 0x08065B66 RL_FNC_UWORD 0 CM_RAW 0 65535 /begin AXIS_DESCR COM_AXIS AXIN_0CA CM_RAW 9 0 65535 AXIS_PTS_REF AX_0CA /end AXIS_DESCR /end CHARACTERISTIC
/begin CHARACTERISTIC CAL_740_4 "кривая #740 9: ? [5/8]" CURVE 0x08065B78 RL_FNC_UWORD 0 CM_RAW 0 65535 /begin AXIS_DESCR COM_AXIS AXIN_0CA CM_RAW 9 0 65535 AXIS_PTS_REF AX_0CA /end AXIS_DESCR /end CHARACTERISTIC
/begin CHARACTERISTIC CAL_740_5 "кривая #740 9: ? [6/8]" CURVE 0x08065B8A RL_FNC_UWORD 0 CM_RAW 0 65535 /begin AXIS_DESCR COM_AXIS AXIN_0CA CM_RAW 9 0 65535 AXIS_PTS_REF AX_0CA /end AXIS_DESCR /end CHARACTERISTIC
/begin CHARACTERISTIC CAL_740_6 "кривая #740 9: ? [7/8]" CURVE 0x08065B9C RL_FNC_UWORD 0 CM_RAW 0 65535 /begin AXIS_DESCR COM_AXIS AXIN_0CA CM_RAW 9 0 65535 AXIS_PTS_REF AX_0CA /end AXIS_DESCR /end CHARACTERISTIC
/begin CHARACTERISTIC CAL_740_7 "кривая #740 9: ? [8/8]" CURVE 0x08065BAE RL_FNC_UWORD 0 CM_RAW 0 65535 /begin AXIS_DESCR COM_AXIS AXIN_0CA CM_RAW 9 0 65535 AXIS_PTS_REF AX_0CA /end AXIS_DESCR /end CHARACTERISTIC
/begin CHARACTERISTIC CAL_741 "карта #741 8x7: ? × GEAR [знак по значениям]" MAP 0x08065AC0 RL_FNC_SWORD 0 CM_RAW -32768 32767 /begin AXIS_DESCR COM_AXIS AXIN_0CB CM_RAW 7 0 65535 AXIS_PTS_REF AX_0CB /end AXIS_DESCR
 /begin AXIS_DESCR COM_AXIS AXIN_05E_GEAR CM_RAW 8 -128 127 AXIS_PTS_REF AX_05E_GEAR /end AXIS_DESCR
/end CHARACTERISTIC
/begin CHARACTERISTIC CAL_742 "значение #742" VALUE 0x08065BCA RL_FNC_UWORD 0 CM_RAW 0 65535 /end CHARACTERISTIC
/begin CHARACTERISTIC CAL_743 "значение #743" VALUE 0x08065BC8 RL_FNC_UWORD 0 CM_RAW 0 65535 /end CHARACTERISTIC
/begin CHARACTERISTIC CAL_744 "карта #744 8x7: ? × GEAR [знак по значениям]" MAP 0x08065BCC RL_FNC_SWORD 0 CM_RAW -32768 32767 /begin AXIS_DESCR COM_AXIS AXIN_0CB CM_RAW 7 0 65535 AXIS_PTS_REF AX_0CB /end AXIS_DESCR
 /begin AXIS_DESCR COM_AXIS AXIN_05E_GEAR CM_RAW 8 -128 127 AXIS_PTS_REF AX_05E_GEAR /end AXIS_DESCR
/end CHARACTERISTIC
/begin CHARACTERISTIC CAL_745 "значение #745" VALUE 0x08065C3C RL_FNC_UWORD 0 CM_RAW 0 65535 /end CHARACTERISTIC
/begin CHARACTERISTIC CAL_746 "массив #746" VAL_BLK 0x08065C40 RL_FNC_UWORD 0 CM_RAW 0 65535 MATRIX_DIM 4 1 1 /end CHARACTERISTIC
/begin CHARACTERISTIC CAL_747 "значение #747" VALUE 0x08065C3E RL_FNC_UWORD 0 CM_RAW 0 65535 /end CHARACTERISTIC
/begin CHARACTERISTIC CAL_748 "значение #748" VALUE 0x08065C48 RL_FNC_UWORD 0 CM_RAW 0 65535 /end CHARACTERISTIC
/begin CHARACTERISTIC CAL_749 "кривая #749 17: ?" CURVE 0x08066338 RL_FNC_UWORD 0 CM_RAW 0 65535 /begin AXIS_DESCR COM_AXIS AXIN_0CC CM_RAW 17 0 65535 AXIS_PTS_REF AX_0CC /end AXIS_DESCR /end CHARACTERISTIC
/begin CHARACTERISTIC CAL_74A "массив #74A" VAL_BLK 0x0806900C RL_FNC_SWORD 0 CM_RAW -32768 32767 MATRIX_DIM 18 1 1 /end CHARACTERISTIC
/begin CHARACTERISTIC CAL_74B "кривая #74B 16: TCOOL" CURVE 0x08064088 RL_FNC_UWORD 0 CM_RAW 0 65535
 /begin AXIS_DESCR COM_AXIS AXIN_0D3_TCOOL CM_C128 16 -256 255.992 AXIS_PTS_REF AX_0D3_TCOOL /end AXIS_DESCR
/end CHARACTERISTIC
/begin CHARACTERISTIC CAL_74C "карта #74C 1x6: ? × ?" MAP 0x0806403C RL_FNC_SBYTE 0 CM_RAW -128 127 /begin AXIS_DESCR COM_AXIS AXIN_071 CM_RAW 6 -128 127 AXIS_PTS_REF AX_071 /end AXIS_DESCR /begin AXIS_DESCR COM_AXIS AXIN_0CE CM_RAW 1 -128 127 AXIS_PTS_REF AX_0CE /end AXIS_DESCR /end CHARACTERISTIC
/begin CHARACTERISTIC CAL_74D_0 "кривая #74D 10: N [1/2]" CURVE 0x08063FD0 RL_FNC_UWORD 0 CM_RAW 0 65535
 /begin AXIS_DESCR COM_AXIS AXIN_00C_N CM_RPM2 10 0 32767.5 AXIS_PTS_REF AX_00C_N /end AXIS_DESCR
/end CHARACTERISTIC
/begin CHARACTERISTIC CAL_74D_1 "кривая #74D 10: N [2/2]" CURVE 0x08063FE4 RL_FNC_UWORD 0 CM_RAW 0 65535
 /begin AXIS_DESCR COM_AXIS AXIN_00C_N CM_RPM2 10 0 32767.5 AXIS_PTS_REF AX_00C_N /end AXIS_DESCR
/end CHARACTERISTIC
/begin CHARACTERISTIC CAL_74E "значение #74E" VALUE 0x08063FCE RL_FNC_UWORD 0 CM_RAW 0 65535 /end CHARACTERISTIC
/begin CHARACTERISTIC CAL_74F "значение #74F" VALUE 0x08063FF8 RL_FNC_SBYTE 0 CM_RAW -128 127 /end CHARACTERISTIC
/begin CHARACTERISTIC CAL_750 "массив #750" VAL_BLK 0x08063FFC RL_FNC_UWORD 0 CM_RAW 0 65535 MATRIX_DIM 2 1 1 /end CHARACTERISTIC
/begin CHARACTERISTIC CAL_751 "массив #751" VAL_BLK 0x08064000 RL_FNC_UWORD 0 CM_RAW 0 65535 MATRIX_DIM 2 1 1 /end CHARACTERISTIC
/begin CHARACTERISTIC CAL_752 "кривая #752 11: ?" CURVE 0x08064004 RL_FNC_UWORD 0 CM_RAW 0 65535 /begin AXIS_DESCR COM_AXIS AXIN_0D1 CM_RAW 11 0 65535 AXIS_PTS_REF AX_0D1 /end AXIS_DESCR /end CHARACTERISTIC
/begin CHARACTERISTIC CAL_753 "значение #753" VALUE 0x0806401A RL_FNC_SBYTE 0 CM_RAW -128 127 /end CHARACTERISTIC
/begin CHARACTERISTIC CAL_754 "значение #754" VALUE 0x0806401C RL_FNC_UWORD 0 CM_RAW 0 65535 /end CHARACTERISTIC
/begin CHARACTERISTIC CAL_755 "кривая #755 10: ?" CURVE 0x08064020 RL_FNC_UWORD 0 CM_RAW 0 65535
 /begin AXIS_DESCR COM_AXIS AXIN_0D0 CM_RAW 10 -32768 32767 AXIS_PTS_REF AX_0D0 /end AXIS_DESCR
/end CHARACTERISTIC
/begin CHARACTERISTIC CAL_756 "значение #756" VALUE 0x08064034 RL_FNC_UWORD 0 CM_RAW 0 65535 /end CHARACTERISTIC
/begin CHARACTERISTIC CAL_757 "значение #757" VALUE 0x08064036 RL_FNC_SBYTE 0 CM_RAW -128 127 /end CHARACTERISTIC
/begin CHARACTERISTIC CAL_758 "значение #758" VALUE 0x08064038 RL_FNC_ULONG 0 CM_RAW 0 4.29497e+09 /end CHARACTERISTIC
/begin CHARACTERISTIC CAL_759 "значение #759" VALUE 0x0806406A RL_FNC_UWORD 0 CM_RAW 0 65535 /end CHARACTERISTIC
/begin CHARACTERISTIC CAL_75A "массив #75A" VAL_BLK 0x0806406C RL_FNC_UWORD 0 CM_RAW 0 65535 MATRIX_DIM 2 1 1 /end CHARACTERISTIC
/begin CHARACTERISTIC CAL_75B "карта #75B 1x9: ? × ?" MAP 0x08064044 RL_FNC_SBYTE 0 CM_RAW -128 127 /begin AXIS_DESCR COM_AXIS AXIN_070 CM_RAW 9 -128 127 AXIS_PTS_REF AX_070 /end AXIS_DESCR /begin AXIS_DESCR COM_AXIS AXIN_0CE CM_RAW 1 -128 127 AXIS_PTS_REF AX_0CE /end AXIS_DESCR /end CHARACTERISTIC
/begin CHARACTERISTIC CAL_75C "кривая #75C 9: ?" CURVE 0x08064050 RL_FNC_UWORD 0 CM_RAW 0 65535 /begin AXIS_DESCR COM_AXIS AXIN_0CF CM_RAW 9 0 65535 AXIS_PTS_REF AX_0CF /end AXIS_DESCR /end CHARACTERISTIC
/begin CHARACTERISTIC CAL_75D "значение #75D" VALUE 0x08064062 RL_FNC_UWORD 0 CM_RAW 0 65535 /end CHARACTERISTIC
/begin CHARACTERISTIC CAL_75E "значение #75E" VALUE 0x08064064 RL_FNC_UWORD 0 CM_RAW 0 65535 /end CHARACTERISTIC
/begin CHARACTERISTIC CAL_75F "значение #75F" VALUE 0x08064066 RL_FNC_UWORD 0 CM_RAW 0 65535 /end CHARACTERISTIC
/begin CHARACTERISTIC CAL_760 "значение #760" VALUE 0x08064068 RL_FNC_UWORD 0 CM_RAW 0 65535 /end CHARACTERISTIC
/begin CHARACTERISTIC CAL_761 "карта #761 12x24: N × ?" MAP 0x0806CD84 RL_FNC_UWORD 0 CM_RAW 0 65535
 /begin AXIS_DESCR COM_AXIS AXIN_0C5_N CM_RPM2 24 0 32767.5 AXIS_PTS_REF AX_0C5_N /end AXIS_DESCR
 /begin AXIS_DESCR COM_AXIS AXIN_0D2 CM_RAW 12 0 65535 AXIS_PTS_REF AX_0D2 /end AXIS_DESCR
/end CHARACTERISTIC
/begin CHARACTERISTIC CAL_762 "кривая #762 16: TAIR" CURVE 0x0806CFC8 RL_FNC_UWORD 0 CM_RAW 0 65535
 /begin AXIS_DESCR COM_AXIS AXIN_002_TAIR CM_C128 16 -256 255.992 AXIS_PTS_REF AX_002_TAIR /end AXIS_DESCR
/end CHARACTERISTIC
/begin CHARACTERISTIC CAL_763 "значение #763" VALUE 0x0807497C RL_FNC_SBYTE 0 CM_RAW -128 127 /end CHARACTERISTIC
/begin CHARACTERISTIC CAL_766 "кривая #766 2: ?" CURVE 0x080748D0 RL_FNC_SBYTE 0 CM_RAW -128 127 /begin AXIS_DESCR COM_AXIS AXIN_0EB CM_RAW 2 -128 127 AXIS_PTS_REF AX_0EB /end AXIS_DESCR /end CHARACTERISTIC
/begin CHARACTERISTIC CAL_767 "значение #767" VALUE 0x080748D4 RL_FNC_UWORD 0 CM_RAW 0 65535 /end CHARACTERISTIC
/begin CHARACTERISTIC CAL_76A "значение #76A" VALUE 0x080748D6 RL_FNC_UWORD 0 CM_RAW 0 65535 /end CHARACTERISTIC
/begin CHARACTERISTIC CAL_76C "значение #76C" VALUE 0x080748CE RL_FNC_UWORD 0 CM_RAW 0 65535 /end CHARACTERISTIC
/begin CHARACTERISTIC CAL_76E "значение #76E" VALUE 0x080748D2 RL_FNC_SWORD 0 CM_RAW -32768 32767 /end CHARACTERISTIC
/begin CHARACTERISTIC CAL_770 "значение #770" VALUE 0x08074A0A RL_FNC_SBYTE 0 CM_RAW -128 127 /end CHARACTERISTIC
/begin CHARACTERISTIC CAL_771 "значение #771" VALUE 0x08074A0B RL_FNC_SBYTE 0 CM_RAW -128 127 /end CHARACTERISTIC
/begin CHARACTERISTIC CAL_772 "значение #772" VALUE 0x0806538B RL_FNC_SBYTE 0 CM_RAW -128 127 /end CHARACTERISTIC
/begin CHARACTERISTIC CAL_775 "значение #775" VALUE 0x0806B722 RL_FNC_SBYTE 0 CM_RAW -128 127 /end CHARACTERISTIC
/begin CHARACTERISTIC CAL_776 "карта #776 3x9: ? × ?" MAP 0x0806B738 RL_FNC_SBYTE 0 CM_RAW -128 127 /begin AXIS_DESCR COM_AXIS AXIN_070 CM_RAW 9 -128 127 AXIS_PTS_REF AX_070 /end AXIS_DESCR /begin AXIS_DESCR COM_AXIS AXIN_08B CM_RAW 3 -128 127 AXIS_PTS_REF AX_08B /end AXIS_DESCR /end CHARACTERISTIC
/begin CHARACTERISTIC CAL_777 "карта #777 3x6: ? × ?" MAP 0x0806B724 RL_FNC_SBYTE 0 CM_RAW -128 127 /begin AXIS_DESCR COM_AXIS AXIN_071 CM_RAW 6 -128 127 AXIS_PTS_REF AX_071 /end AXIS_DESCR /begin AXIS_DESCR COM_AXIS AXIN_08B CM_RAW 3 -128 127 AXIS_PTS_REF AX_08B /end AXIS_DESCR /end CHARACTERISTIC
/begin CHARACTERISTIC CAL_778 "значение #778" VALUE 0x0806B754 RL_FNC_UWORD 0 CM_RAW 0 65535 /end CHARACTERISTIC
/begin CHARACTERISTIC CAL_779 "значение #779" VALUE 0x0806B756 RL_FNC_UWORD 0 CM_RAW 0 65535 /end CHARACTERISTIC
/begin CHARACTERISTIC CAL_77A "значение #77A" VALUE 0x08063E20 RL_FNC_SWORD 0 CM_RAW -32768 32767 /end CHARACTERISTIC
/begin CHARACTERISTIC CAL_77B "значение #77B" VALUE 0x0806B4FC RL_FNC_UWORD 0 CM_RAW 0 65535 /end CHARACTERISTIC
/begin CHARACTERISTIC CAL_77C "значение #77C" VALUE 0x08073DC4 RL_FNC_UWORD 0 CM_RAW 0 65535 /end CHARACTERISTIC
/begin CHARACTERISTIC CAL_77E "значение #77E" VALUE 0x08063ED3 RL_FNC_SBYTE 0 CM_RAW -128 127 /end CHARACTERISTIC
/begin CHARACTERISTIC CAL_77F "массив #77F" VAL_BLK 0x0806826C RL_FNC_SBYTE 0 CM_RAW -128 127 MATRIX_DIM 4 1 1 /end CHARACTERISTIC
/begin CHARACTERISTIC CAL_782 "значение #782" VALUE 0x0807031E RL_FNC_UWORD 0 CM_RAW 0 65535 /end CHARACTERISTIC
/begin CHARACTERISTIC CAL_783 "значение #783" VALUE 0x08070320 RL_FNC_UWORD 0 CM_RAW 0 65535 /end CHARACTERISTIC
/begin CHARACTERISTIC CAL_784 "карта #784 3x9: ? × ?" MAP 0x08070324 RL_FNC_SBYTE 0 CM_RAW -128 127 /begin AXIS_DESCR COM_AXIS AXIN_070 CM_RAW 9 -128 127 AXIS_PTS_REF AX_070 /end AXIS_DESCR /begin AXIS_DESCR COM_AXIS AXIN_0D6 CM_RAW 3 -128 127 AXIS_PTS_REF AX_0D6 /end AXIS_DESCR /end CHARACTERISTIC
/begin CHARACTERISTIC CAL_785 "массив #785" VAL_BLK 0x08070340 RL_FNC_UWORD 0 CM_RAW 0 65535 MATRIX_DIM 2 1 1 /end CHARACTERISTIC
/begin CHARACTERISTIC CAL_786 "значение #786" VALUE 0x08070344 RL_FNC_SBYTE 0 CM_RAW -128 127 /end CHARACTERISTIC
/begin CHARACTERISTIC CAL_787 "карта #787 3x6: ? × ?" MAP 0x08070348 RL_FNC_SBYTE 0 CM_RAW -128 127 /begin AXIS_DESCR COM_AXIS AXIN_071 CM_RAW 6 -128 127 AXIS_PTS_REF AX_071 /end AXIS_DESCR /begin AXIS_DESCR COM_AXIS AXIN_0D6 CM_RAW 3 -128 127 AXIS_PTS_REF AX_0D6 /end AXIS_DESCR /end CHARACTERISTIC
/begin CHARACTERISTIC CAL_788 "значение #788" VALUE 0x0807035A RL_FNC_UWORD 0 CM_RAW 0 65535 /end CHARACTERISTIC
/begin CHARACTERISTIC CAL_789 "значение #789" VALUE 0x0807035C RL_FNC_UWORD 0 CM_RAW 0 65535 /end CHARACTERISTIC
/begin CHARACTERISTIC CAL_78A "значение #78A" VALUE 0x0807035E RL_FNC_UWORD 0 CM_RAW 0 65535 /end CHARACTERISTIC
/begin CHARACTERISTIC CAL_78B "значение #78B" VALUE 0x08070360 RL_FNC_UWORD 0 CM_RAW 0 65535 /end CHARACTERISTIC
/begin CHARACTERISTIC CAL_78E "массив #78E" VAL_BLK 0x0806E7E0 RL_FNC_SBYTE 0 CM_RAW -128 127 MATRIX_DIM 13 1 1 /end CHARACTERISTIC
/begin CHARACTERISTIC CAL_78F "массив #78F" VAL_BLK 0x0806E7F0 RL_FNC_SWORD 0 CM_RAW -32768 32767 MATRIX_DIM 21 1 1 /end CHARACTERISTIC
/begin CHARACTERISTIC CAL_790 "массив #790" VAL_BLK 0x0806E81C RL_FNC_SWORD 0 CM_RAW -32768 32767 MATRIX_DIM 21 1 1 /end CHARACTERISTIC
/begin CHARACTERISTIC CAL_791 "массив #791" VAL_BLK 0x0806E848 RL_FNC_SBYTE 0 CM_RAW -128 127 MATRIX_DIM 21 1 1 /end CHARACTERISTIC
/begin CHARACTERISTIC CAL_792 "массив #792" VAL_BLK 0x0806E860 RL_FNC_SBYTE 0 CM_RAW -128 127 MATRIX_DIM 21 1 1 /end CHARACTERISTIC
/begin CHARACTERISTIC CAL_793 "массив #793" VAL_BLK 0x0806E878 RL_FNC_SBYTE 0 CM_RAW -128 127 MATRIX_DIM 21 1 1 /end CHARACTERISTIC
/begin CHARACTERISTIC CAL_794 "значение #794" VALUE 0x080748DA RL_FNC_UWORD 0 CM_RAW 0 65535 /end CHARACTERISTIC
/begin CHARACTERISTIC CAL_799 "массив #799" VAL_BLK 0x080662D4 RL_FNC_SWORD 0 CM_RAW -32768 32767 MATRIX_DIM 4 1 1 /end CHARACTERISTIC
/begin CHARACTERISTIC CAL_79A "значение #79A" VALUE 0x080662DC RL_FNC_UWORD 0 CM_RAW 0 65535 /end CHARACTERISTIC
/begin CHARACTERISTIC CAL_79B_0 "кривая #79B 4: ? [1/2]" CURVE 0x080662E0 RL_FNC_SWORD 0 CM_RAW -32768 32767 /begin AXIS_DESCR COM_AXIS AXIN_0D7 CM_RAW 4 -128 127 AXIS_PTS_REF AX_0D7 /end AXIS_DESCR /end CHARACTERISTIC
/begin CHARACTERISTIC CAL_79B_1 "кривая #79B 4: ? [2/2]" CURVE 0x080662E8 RL_FNC_SWORD 0 CM_RAW -32768 32767 /begin AXIS_DESCR COM_AXIS AXIN_0D7 CM_RAW 4 -128 127 AXIS_PTS_REF AX_0D7 /end AXIS_DESCR /end CHARACTERISTIC
/begin CHARACTERISTIC CAL_79C "значение #79C" VALUE 0x080703B4 RL_FNC_SWORD 0 CM_RAW -32768 32767 /end CHARACTERISTIC
/begin CHARACTERISTIC CAL_79D "значение #79D" VALUE 0x080703B6 RL_FNC_UWORD 0 CM_RAW 0 65535 /end CHARACTERISTIC
/begin CHARACTERISTIC CAL_79E "массив #79E" VAL_BLK 0x08064464 RL_FNC_SBYTE 0 CM_RAW -128 127 MATRIX_DIM 2 1 1 /end CHARACTERISTIC
/begin CHARACTERISTIC CAL_79F "значение #79F" VALUE 0x08064466 RL_FNC_UWORD 0 CM_RAW 0 65535 /end CHARACTERISTIC
/begin CHARACTERISTIC CAL_7A0 "значение #7A0" VALUE 0x08064468 RL_FNC_UWORD 0 CM_RAW 0 65535 /end CHARACTERISTIC
/begin CHARACTERISTIC CAL_7A1 "значение #7A1" VALUE 0x08070368 RL_FNC_SWORD 0 CM_RAW -32768 32767 /end CHARACTERISTIC
/begin CHARACTERISTIC CAL_7A2 "значение #7A2" VALUE 0x0807036A RL_FNC_SWORD 0 CM_RAW -32768 32767 /end CHARACTERISTIC
/begin CHARACTERISTIC CAL_7A3 "значение #7A3" VALUE 0x0807036E RL_FNC_UWORD 0 CM_RAW 0 65535 /end CHARACTERISTIC
/begin CHARACTERISTIC CAL_7A4 "значение #7A4" VALUE 0x080703B2 RL_FNC_SBYTE 0 CM_RAW -128 127 /end CHARACTERISTIC
/begin CHARACTERISTIC CAL_7A5 "значение #7A5" VALUE 0x08070374 RL_FNC_UWORD 0 CM_RAW 0 65535 /end CHARACTERISTIC
/begin CHARACTERISTIC CAL_7A6 "значение #7A6" VALUE 0x08070376 RL_FNC_UWORD 0 CM_RAW 0 65535 /end CHARACTERISTIC
/begin CHARACTERISTIC CAL_7A7 "значение #7A7" VALUE 0x08070378 RL_FNC_SLONG 0 CM_RAW -2.14748e+09 2.14748e+09 /end CHARACTERISTIC
/begin CHARACTERISTIC CAL_7A8 "значение #7A8" VALUE 0x0807037C RL_FNC_SWORD 0 CM_RAW -32768 32767 /end CHARACTERISTIC
/begin CHARACTERISTIC CAL_7A9 "значение #7A9" VALUE 0x0806CFEA RL_FNC_SBYTE 0 CM_RAW -128 127 /end CHARACTERISTIC
/begin CHARACTERISTIC CAL_7AA "кривая #7AA 42: ?" CURVE 0x0806CD30 RL_FNC_UWORD 0 CM_RAW 0 65535 /begin AXIS_DESCR COM_AXIS AXIN_0DA CM_RAW 42 0 65535 AXIS_PTS_REF AX_0DA /end AXIS_DESCR /end CHARACTERISTIC
/begin CHARACTERISTIC CAL_7AB "значение #7AB" VALUE 0x08074997 RL_FNC_SBYTE 0 CM_RAW -128 127 /end CHARACTERISTIC
/begin CHARACTERISTIC CAL_7AC "кривая #7AC 9: N" CURVE 0x08070C64 RL_FNC_UWORD 0 CM_RAW 0 65535
 /begin AXIS_DESCR COM_AXIS AXIN_0AD_N CM_RPM2 9 0 32767.5 AXIS_PTS_REF AX_0AD_N /end AXIS_DESCR
/end CHARACTERISTIC
/begin CHARACTERISTIC CAL_7AD "массив #7AD" VAL_BLK 0x0806BC7C RL_FNC_UWORD 0 CM_RAW 0 65535 MATRIX_DIM 2 1 1 /end CHARACTERISTIC
/begin CHARACTERISTIC CAL_7AE "значение #7AE" VALUE 0x08068290 RL_FNC_UWORD 0 CM_RAW 0 65535 /end CHARACTERISTIC
/begin CHARACTERISTIC CAL_7AF "массив #7AF" VAL_BLK 0x0806BC84 RL_FNC_UWORD 0 CM_RAW 0 65535 MATRIX_DIM 2 1 1 /end CHARACTERISTIC
/begin CHARACTERISTIC CAL_7B0 "массив #7B0" VAL_BLK 0x0806BC5C RL_FNC_UWORD 0 CM_RAW 0 65535 MATRIX_DIM 2 1 1 /end CHARACTERISTIC
/begin CHARACTERISTIC CAL_7B1 "массив #7B1" VAL_BLK 0x08068204 RL_FNC_SBYTE 0 CM_RAW -128 127 MATRIX_DIM 3 1 1 /end CHARACTERISTIC
/begin CHARACTERISTIC CAL_7B3 "значение #7B3" VALUE 0x0806E8AA RL_FNC_SBYTE 0 CM_RAW -128 127 /end CHARACTERISTIC
/begin CHARACTERISTIC CAL_7B4 "карта #7B4 2x9: ? × ?" MAP 0x0806E898 RL_FNC_SBYTE 0 CM_RAW -128 127 /begin AXIS_DESCR COM_AXIS AXIN_070 CM_RAW 9 -128 127 AXIS_PTS_REF AX_070 /end AXIS_DESCR /begin AXIS_DESCR COM_AXIS AXIN_0DF CM_RAW 2 -128 127 AXIS_PTS_REF AX_0DF /end AXIS_DESCR /end CHARACTERISTIC
/begin CHARACTERISTIC CAL_7B5 "карта #7B5 2x6: ? × ?" MAP 0x0806E8AC RL_FNC_SBYTE 0 CM_RAW -128 127 /begin AXIS_DESCR COM_AXIS AXIN_071 CM_RAW 6 -128 127 AXIS_PTS_REF AX_071 /end AXIS_DESCR /begin AXIS_DESCR COM_AXIS AXIN_0DF CM_RAW 2 -128 127 AXIS_PTS_REF AX_0DF /end AXIS_DESCR /end CHARACTERISTIC
/begin CHARACTERISTIC CAL_7B6 "карта #7B6 9x14: N × LOAD" MAP 0x0806A39C RL_FNC_UWORD 0 CM_RAW 0 65535
 /begin AXIS_DESCR COM_AXIS AXIN_027_N CM_RPM2 14 0 32767.5 AXIS_PTS_REF AX_027_N /end AXIS_DESCR
 /begin AXIS_DESCR COM_AXIS AXIN_039_LOAD CM_RAW 9 0 65535 AXIS_PTS_REF AX_039_LOAD /end AXIS_DESCR
/end CHARACTERISTIC
/begin CHARACTERISTIC CAL_7B7 "массив #7B7" VAL_BLK 0x0806E8B8 RL_FNC_SBYTE 0 CM_RAW -128 127 MATRIX_DIM 2 1 1 /end CHARACTERISTIC
/begin CHARACTERISTIC CAL_7B8_0 "кривая #7B8 10: N [1/2]" CURVE 0x0806245C RL_FNC_UWORD 0 CM_RAW 0 65535
 /begin AXIS_DESCR COM_AXIS AXIN_00C_N CM_RPM2 10 0 32767.5 AXIS_PTS_REF AX_00C_N /end AXIS_DESCR
/end CHARACTERISTIC
/begin CHARACTERISTIC CAL_7B8_1 "кривая #7B8 10: N [2/2]" CURVE 0x08062470 RL_FNC_UWORD 0 CM_RAW 0 65535
 /begin AXIS_DESCR COM_AXIS AXIN_00C_N CM_RPM2 10 0 32767.5 AXIS_PTS_REF AX_00C_N /end AXIS_DESCR
/end CHARACTERISTIC
/begin CHARACTERISTIC CAL_7BA "массив #7BA" VAL_BLK 0x0806BCAC RL_FNC_UWORD 0 CM_RAW 0 65535 MATRIX_DIM 2 1 1 /end CHARACTERISTIC
/begin CHARACTERISTIC CAL_7BB "значение #7BB" VALUE 0x0806BCB0 RL_FNC_UWORD 0 CM_RAW 0 65535 /end CHARACTERISTIC
/begin CHARACTERISTIC CAL_7BC "массив #7BC" VAL_BLK 0x0806BCB4 RL_FNC_UWORD 0 CM_RAW 0 65535 MATRIX_DIM 2 1 1 /end CHARACTERISTIC
/begin CHARACTERISTIC CAL_7BD "значение #7BD" VALUE 0x0806BCB8 RL_FNC_UWORD 0 CM_RAW 0 65535 /end CHARACTERISTIC
/begin CHARACTERISTIC CAL_7BE "значение #7BE" VALUE 0x0806BC8C RL_FNC_SBYTE 0 CM_RAW -128 127 /end CHARACTERISTIC
/begin CHARACTERISTIC CAL_7BF "значение #7BF" VALUE 0x0806BC8D RL_FNC_SBYTE 0 CM_RAW -128 127 /end CHARACTERISTIC
/begin CHARACTERISTIC CAL_7C0 "карта #7C0 1x9: ? × ?" MAP 0x0806BC98 RL_FNC_SBYTE 0 CM_RAW -128 127 /begin AXIS_DESCR COM_AXIS AXIN_070 CM_RAW 9 -128 127 AXIS_PTS_REF AX_070 /end AXIS_DESCR /begin AXIS_DESCR COM_AXIS AXIN_0E0 CM_RAW 1 -128 127 AXIS_PTS_REF AX_0E0 /end AXIS_DESCR /end CHARACTERISTIC
/begin CHARACTERISTIC CAL_7C1 "карта #7C1 1x6: ? × ?" MAP 0x0806BC90 RL_FNC_SBYTE 0 CM_RAW -128 127 /begin AXIS_DESCR COM_AXIS AXIN_071 CM_RAW 6 -128 127 AXIS_PTS_REF AX_071 /end AXIS_DESCR /begin AXIS_DESCR COM_AXIS AXIN_0E0 CM_RAW 1 -128 127 AXIS_PTS_REF AX_0E0 /end AXIS_DESCR /end CHARACTERISTIC
/begin CHARACTERISTIC CAL_7C2 "значение #7C2" VALUE 0x0806BCA2 RL_FNC_UWORD 0 CM_RAW 0 65535 /end CHARACTERISTIC
/begin CHARACTERISTIC CAL_7C3 "массив #7C3" VAL_BLK 0x0806BCA8 RL_FNC_SBYTE 0 CM_RAW -128 127 MATRIX_DIM 2 1 1 /end CHARACTERISTIC
/begin CHARACTERISTIC CAL_7C4 "значение #7C4" VALUE 0x0806BCAA RL_FNC_SBYTE 0 CM_RAW -128 127 /end CHARACTERISTIC
/begin CHARACTERISTIC CAL_7C5 "значение #7C5" VALUE 0x0806BCA4 RL_FNC_SBYTE 0 CM_RAW -128 127 /end CHARACTERISTIC
/begin CHARACTERISTIC CAL_7C7 "карта #7C7 3x9: ? × ?" MAP 0x08062684 RL_FNC_SBYTE 0 CM_RAW -128 127 /begin AXIS_DESCR COM_AXIS AXIN_070 CM_RAW 9 -128 127 AXIS_PTS_REF AX_070 /end AXIS_DESCR /begin AXIS_DESCR COM_AXIS AXIN_0E1 CM_RAW 3 -128 127 AXIS_PTS_REF AX_0E1 /end AXIS_DESCR /end CHARACTERISTIC
/begin CHARACTERISTIC CAL_7C8 "карта #7C8 3x6: ? × ?" MAP 0x08062670 RL_FNC_SBYTE 0 CM_RAW -128 127 /begin AXIS_DESCR COM_AXIS AXIN_071 CM_RAW 6 -128 127 AXIS_PTS_REF AX_071 /end AXIS_DESCR /begin AXIS_DESCR COM_AXIS AXIN_0E1 CM_RAW 3 -128 127 AXIS_PTS_REF AX_0E1 /end AXIS_DESCR /end CHARACTERISTIC
/begin CHARACTERISTIC CAL_7C9 "значение #7C9" VALUE 0x080624FE RL_FNC_SBYTE 0 CM_RAW -128 127 /end CHARACTERISTIC
/begin CHARACTERISTIC CAL_7CA "значение #7CA" VALUE 0x080706AA RL_FNC_UBYTE 0 CM_RAW 0 255 /end CHARACTERISTIC
/begin CHARACTERISTIC CAL_7CB "значение #7CB" VALUE 0x080748D8 RL_FNC_UWORD 0 CM_RAW 0 65535 /end CHARACTERISTIC
/begin CHARACTERISTIC CAL_7CC "значение #7CC" VALUE 0x080706A8 RL_FNC_UWORD 0 CM_RAW 0 65535 /end CHARACTERISTIC
/begin CHARACTERISTIC CAL_7CD "значение #7CD" VALUE 0x080706A6 RL_FNC_UWORD 0 CM_RAW 0 65535 /end CHARACTERISTIC
/begin CHARACTERISTIC CAL_7CF "значение #7CF" VALUE 0x08070384 RL_FNC_UWORD 0 CM_RAW 0 65535 /end CHARACTERISTIC
/begin CHARACTERISTIC CAL_7D0 "значение #7D0" VALUE 0x08070386 RL_FNC_UWORD 0 CM_RAW 0 65535 /end CHARACTERISTIC
/begin CHARACTERISTIC CAL_7D1 "массив #7D1" VAL_BLK 0x08070388 RL_FNC_UWORD 0 CM_RAW 0 65535 MATRIX_DIM 2 1 1 /end CHARACTERISTIC
/begin CHARACTERISTIC CAL_7D2 "значение #7D2" VALUE 0x0807038C RL_FNC_SBYTE 0 CM_RAW -128 127 /end CHARACTERISTIC
/begin CHARACTERISTIC CAL_7D3 "значение #7D3" VALUE 0x0807038E RL_FNC_UWORD 0 CM_RAW 0 65535 /end CHARACTERISTIC
/begin CHARACTERISTIC CAL_7D4 "карта #7D4 2x9: ? × ?" MAP 0x0807039C RL_FNC_SBYTE 0 CM_RAW -128 127 /begin AXIS_DESCR COM_AXIS AXIN_070 CM_RAW 9 -128 127 AXIS_PTS_REF AX_070 /end AXIS_DESCR /begin AXIS_DESCR COM_AXIS AXIN_0E2 CM_RAW 2 -128 127 AXIS_PTS_REF AX_0E2 /end AXIS_DESCR /end CHARACTERISTIC
/begin CHARACTERISTIC CAL_7D5 "карта #7D5 2x6: ? × ?" MAP 0x08070390 RL_FNC_SBYTE 0 CM_RAW -128 127 /begin AXIS_DESCR COM_AXIS AXIN_071 CM_RAW 6 -128 127 AXIS_PTS_REF AX_071 /end AXIS_DESCR /begin AXIS_DESCR COM_AXIS AXIN_0E2 CM_RAW 2 -128 127 AXIS_PTS_REF AX_0E2 /end AXIS_DESCR /end CHARACTERISTIC
/begin CHARACTERISTIC CAL_7D6 "значение #7D6" VALUE 0x080703AE RL_FNC_UWORD 0 CM_RAW 0 65535 /end CHARACTERISTIC
/begin CHARACTERISTIC CAL_7D7 "значение #7D7" VALUE 0x080703B0 RL_FNC_UWORD 0 CM_RAW 0 65535 /end CHARACTERISTIC
/begin CHARACTERISTIC CAL_7D8 "кривая #7D8 9: ?" CURVE 0x0806ABF0 RL_FNC_UWORD 0 CM_RAW 0 65535 /begin AXIS_DESCR COM_AXIS AXIN_0E3 CM_RAW 9 0 65535 AXIS_PTS_REF AX_0E3 /end AXIS_DESCR /end CHARACTERISTIC
/begin CHARACTERISTIC CAL_7D9 "массив #7D9" VAL_BLK 0x0806F940 RL_FNC_SBYTE 0 CM_RAW -128 127 MATRIX_DIM 2 1 1 /end CHARACTERISTIC
/begin CHARACTERISTIC CAL_7DC "массив #7DC" VAL_BLK 0x0806D31C RL_FNC_SBYTE 0 CM_RAW -128 127 MATRIX_DIM 4 1 1 /end CHARACTERISTIC
/begin CHARACTERISTIC CAL_7DD_0 "карта #7DD 2x9: ? × ? [1/4]" MAP 0x0806D354 RL_FNC_SBYTE 0 CM_RAW -128 127 /begin AXIS_DESCR COM_AXIS AXIN_070 CM_RAW 9 -128 127 AXIS_PTS_REF AX_070 /end AXIS_DESCR /begin AXIS_DESCR COM_AXIS AXIN_0E4 CM_RAW 2 -128 127 AXIS_PTS_REF AX_0E4 /end AXIS_DESCR /end CHARACTERISTIC
/begin CHARACTERISTIC CAL_7DD_1 "карта #7DD 2x9: ? × ? [2/4]" MAP 0x0806D366 RL_FNC_SBYTE 0 CM_RAW -128 127 /begin AXIS_DESCR COM_AXIS AXIN_070 CM_RAW 9 -128 127 AXIS_PTS_REF AX_070 /end AXIS_DESCR /begin AXIS_DESCR COM_AXIS AXIN_0E4 CM_RAW 2 -128 127 AXIS_PTS_REF AX_0E4 /end AXIS_DESCR /end CHARACTERISTIC
/begin CHARACTERISTIC CAL_7DD_2 "карта #7DD 2x9: ? × ? [3/4]" MAP 0x0806D378 RL_FNC_SBYTE 0 CM_RAW -128 127 /begin AXIS_DESCR COM_AXIS AXIN_070 CM_RAW 9 -128 127 AXIS_PTS_REF AX_070 /end AXIS_DESCR /begin AXIS_DESCR COM_AXIS AXIN_0E4 CM_RAW 2 -128 127 AXIS_PTS_REF AX_0E4 /end AXIS_DESCR /end CHARACTERISTIC
/begin CHARACTERISTIC CAL_7DD_3 "карта #7DD 2x9: ? × ? [4/4]" MAP 0x0806D38A RL_FNC_SBYTE 0 CM_RAW -128 127 /begin AXIS_DESCR COM_AXIS AXIN_070 CM_RAW 9 -128 127 AXIS_PTS_REF AX_070 /end AXIS_DESCR /begin AXIS_DESCR COM_AXIS AXIN_0E4 CM_RAW 2 -128 127 AXIS_PTS_REF AX_0E4 /end AXIS_DESCR /end CHARACTERISTIC
/begin CHARACTERISTIC CAL_7DE_0 "карта #7DE 2x6: ? × ? [1/4]" MAP 0x0806D324 RL_FNC_SBYTE 0 CM_RAW -128 127 /begin AXIS_DESCR COM_AXIS AXIN_071 CM_RAW 6 -128 127 AXIS_PTS_REF AX_071 /end AXIS_DESCR /begin AXIS_DESCR COM_AXIS AXIN_0E4 CM_RAW 2 -128 127 AXIS_PTS_REF AX_0E4 /end AXIS_DESCR /end CHARACTERISTIC
/begin CHARACTERISTIC CAL_7DE_1 "карта #7DE 2x6: ? × ? [2/4]" MAP 0x0806D330 RL_FNC_SBYTE 0 CM_RAW -128 127 /begin AXIS_DESCR COM_AXIS AXIN_071 CM_RAW 6 -128 127 AXIS_PTS_REF AX_071 /end AXIS_DESCR /begin AXIS_DESCR COM_AXIS AXIN_0E4 CM_RAW 2 -128 127 AXIS_PTS_REF AX_0E4 /end AXIS_DESCR /end CHARACTERISTIC
/begin CHARACTERISTIC CAL_7DE_2 "карта #7DE 2x6: ? × ? [3/4]" MAP 0x0806D33C RL_FNC_SBYTE 0 CM_RAW -128 127 /begin AXIS_DESCR COM_AXIS AXIN_071 CM_RAW 6 -128 127 AXIS_PTS_REF AX_071 /end AXIS_DESCR /begin AXIS_DESCR COM_AXIS AXIN_0E4 CM_RAW 2 -128 127 AXIS_PTS_REF AX_0E4 /end AXIS_DESCR /end CHARACTERISTIC
/begin CHARACTERISTIC CAL_7DE_3 "карта #7DE 2x6: ? × ? [4/4]" MAP 0x0806D348 RL_FNC_SBYTE 0 CM_RAW -128 127 /begin AXIS_DESCR COM_AXIS AXIN_071 CM_RAW 6 -128 127 AXIS_PTS_REF AX_071 /end AXIS_DESCR /begin AXIS_DESCR COM_AXIS AXIN_0E4 CM_RAW 2 -128 127 AXIS_PTS_REF AX_0E4 /end AXIS_DESCR /end CHARACTERISTIC
/begin CHARACTERISTIC CAL_7E0 "значение #7E0" VALUE 0x08065768 RL_FNC_SBYTE 0 CM_RAW -128 127 /end CHARACTERISTIC
/begin CHARACTERISTIC CAL_7E1 "массив #7E1 [знак по значениям]" VAL_BLK 0x0806576C RL_FNC_SWORD 0 CM_RAW -32768 32767 MATRIX_DIM 2 1 1 /end CHARACTERISTIC
/begin CHARACTERISTIC CAL_7E2 "карта #7E2 8x9: ? × ?" MAP 0x080657A0 RL_FNC_SBYTE 0 CM_RAW -128 127 /begin AXIS_DESCR COM_AXIS AXIN_070 CM_RAW 9 -128 127 AXIS_PTS_REF AX_070 /end AXIS_DESCR /begin AXIS_DESCR COM_AXIS AXIN_0E5 CM_RAW 8 -128 127 AXIS_PTS_REF AX_0E5 /end AXIS_DESCR /end CHARACTERISTIC
/begin CHARACTERISTIC CAL_7E3 "карта #7E3 8x6: ? × ?" MAP 0x08065770 RL_FNC_SBYTE 0 CM_RAW -128 127 /begin AXIS_DESCR COM_AXIS AXIN_071 CM_RAW 6 -128 127 AXIS_PTS_REF AX_071 /end AXIS_DESCR /begin AXIS_DESCR COM_AXIS AXIN_0E5 CM_RAW 8 -128 127 AXIS_PTS_REF AX_0E5 /end AXIS_DESCR /end CHARACTERISTIC
/begin CHARACTERISTIC CAL_7E4 "массив #7E4 [знак по значениям]" VAL_BLK 0x080657E8 RL_FNC_SWORD 0 CM_RAW -32768 32767 MATRIX_DIM 2 1 1 /end CHARACTERISTIC
/begin CHARACTERISTIC CAL_7E5 "значение #7E5" VALUE 0x080657EC RL_FNC_UWORD 0 CM_RAW 0 65535 /end CHARACTERISTIC
/begin CHARACTERISTIC CAL_7E8 "значение #7E8" VALUE 0x08063E24 RL_FNC_SBYTE 0 CM_RAW -128 127 /end CHARACTERISTIC
/begin CHARACTERISTIC CAL_7E9 "карта #7E9 5x9: ? × ?" MAP 0x08063E48 RL_FNC_SBYTE 0 CM_RAW -128 127 /begin AXIS_DESCR COM_AXIS AXIN_070 CM_RAW 9 -128 127 AXIS_PTS_REF AX_070 /end AXIS_DESCR /begin AXIS_DESCR COM_AXIS AXIN_0E7 CM_RAW 5 -128 127 AXIS_PTS_REF AX_0E7 /end AXIS_DESCR /end CHARACTERISTIC
/begin CHARACTERISTIC CAL_7EA "карта #7EA 5x6: ? × ?" MAP 0x08063E28 RL_FNC_SBYTE 0 CM_RAW -128 127 /begin AXIS_DESCR COM_AXIS AXIN_071 CM_RAW 6 -128 127 AXIS_PTS_REF AX_071 /end AXIS_DESCR /begin AXIS_DESCR COM_AXIS AXIN_0E7 CM_RAW 5 -128 127 AXIS_PTS_REF AX_0E7 /end AXIS_DESCR /end CHARACTERISTIC
/begin CHARACTERISTIC CAL_7EB "значение #7EB" VALUE 0x0806448E RL_FNC_SBYTE 0 CM_RAW -128 127 /end CHARACTERISTIC
/begin CHARACTERISTIC CAL_7EC "карта #7EC 2x9: ? × ?" MAP 0x0806449C RL_FNC_SBYTE 0 CM_RAW -128 127 /begin AXIS_DESCR COM_AXIS AXIN_070 CM_RAW 9 -128 127 AXIS_PTS_REF AX_070 /end AXIS_DESCR /begin AXIS_DESCR COM_AXIS AXIN_0E8 CM_RAW 2 -128 127 AXIS_PTS_REF AX_0E8 /end AXIS_DESCR /end CHARACTERISTIC
/begin CHARACTERISTIC CAL_7ED "карта #7ED 2x6: ? × ?" MAP 0x08064490 RL_FNC_SBYTE 0 CM_RAW -128 127 /begin AXIS_DESCR COM_AXIS AXIN_071 CM_RAW 6 -128 127 AXIS_PTS_REF AX_071 /end AXIS_DESCR /begin AXIS_DESCR COM_AXIS AXIN_0E8 CM_RAW 2 -128 127 AXIS_PTS_REF AX_0E8 /end AXIS_DESCR /end CHARACTERISTIC
/begin CHARACTERISTIC CAL_7EE "значение #7EE" VALUE 0x080749A0 RL_FNC_SBYTE 0 CM_RAW -128 127 /end CHARACTERISTIC
/begin CHARACTERISTIC CAL_7EF "значение #7EF" VALUE 0x0807499F RL_FNC_SBYTE 0 CM_RAW -128 127 /end CHARACTERISTIC
/begin CHARACTERISTIC CAL_7F0 "значение #7F0" VALUE 0x080749A4 RL_FNC_SLONG 0 CM_RAW -2.14748e+09 2.14748e+09 /end CHARACTERISTIC
/begin CHARACTERISTIC CAL_7F1 "значение #7F1" VALUE 0x080749A8 RL_FNC_SBYTE 0 CM_RAW -128 127 /end CHARACTERISTIC
/begin CHARACTERISTIC CAL_7F2 "значение #7F2" VALUE 0x080749A9 RL_FNC_SBYTE 0 CM_RAW -128 127 /end CHARACTERISTIC
/begin CHARACTERISTIC CAL_7F3 "значение #7F3" VALUE 0x080749AA RL_FNC_SBYTE 0 CM_RAW -128 127 /end CHARACTERISTIC
/begin CHARACTERISTIC CAL_7F4 "значение #7F4" VALUE 0x080749AB RL_FNC_SBYTE 0 CM_RAW -128 127 /end CHARACTERISTIC
/begin CHARACTERISTIC CAL_7F5 "значение #7F5" VALUE 0x080749AC RL_FNC_SBYTE 0 CM_RAW -128 127 /end CHARACTERISTIC
/begin CHARACTERISTIC CAL_7F6 "значение #7F6" VALUE 0x080749AD RL_FNC_SBYTE 0 CM_RAW -128 127 /end CHARACTERISTIC
/begin CHARACTERISTIC CAL_7F7 "значение #7F7" VALUE 0x080749AE RL_FNC_SBYTE 0 CM_RAW -128 127 /end CHARACTERISTIC
/begin CHARACTERISTIC CAL_7F8 "значение #7F8" VALUE 0x080749B0 RL_FNC_ULONG 0 CM_RAW 0 4.29497e+09 /end CHARACTERISTIC
/begin CHARACTERISTIC CAL_7F9 "значение #7F9" VALUE 0x080749B4 RL_FNC_SBYTE 0 CM_RAW -128 127 /end CHARACTERISTIC
/begin CHARACTERISTIC CAL_7FA "значение #7FA" VALUE 0x080749B6 RL_FNC_UWORD 0 CM_RAW 0 65535 /end CHARACTERISTIC
/begin CHARACTERISTIC CAL_7FB "значение #7FB" VALUE 0x080749B8 RL_FNC_UWORD 0 CM_RAW 0 65535 /end CHARACTERISTIC
/begin CHARACTERISTIC CAL_7FC "значение #7FC" VALUE 0x080749BC RL_FNC_SLONG 0 CM_RAW -2.14748e+09 2.14748e+09 /end CHARACTERISTIC
/begin CHARACTERISTIC CAL_7FD "значение #7FD" VALUE 0x080749C0 RL_FNC_SLONG 0 CM_RAW -2.14748e+09 2.14748e+09 /end CHARACTERISTIC
/begin CHARACTERISTIC CAL_7FE "значение #7FE" VALUE 0x080749C4 RL_FNC_SLONG 0 CM_RAW -2.14748e+09 2.14748e+09 /end CHARACTERISTIC
/begin CHARACTERISTIC CAL_7FF "значение #7FF" VALUE 0x080749C8 RL_FNC_SBYTE 0 CM_RAW -128 127 /end CHARACTERISTIC
/begin CHARACTERISTIC CAL_800 "значение #800" VALUE 0x080749C9 RL_FNC_SBYTE 0 CM_RAW -128 127 /end CHARACTERISTIC
/begin CHARACTERISTIC CAL_801 "значение #801" VALUE 0x080749CA RL_FNC_SBYTE 0 CM_RAW -128 127 /end CHARACTERISTIC
/begin CHARACTERISTIC CAL_803 "массив #803" VAL_BLK 0x08064420 RL_FNC_SBYTE 0 CM_RAW -128 127 MATRIX_DIM 2 1 1 /end CHARACTERISTIC
/begin CHARACTERISTIC CAL_804 "значение #804" VALUE 0x08064424 RL_FNC_SBYTE 0 CM_RAW -128 127 /end CHARACTERISTIC
/begin CHARACTERISTIC CAL_805 "значение #805" VALUE 0x08064422 RL_FNC_UWORD 0 CM_RAW 0 65535 /end CHARACTERISTIC
/begin CHARACTERISTIC CAL_806 "значение #806" VALUE 0x08064426 RL_FNC_UWORD 0 CM_RAW 0 65535 /end CHARACTERISTIC
/begin CHARACTERISTIC CAL_807 "значение #807" VALUE 0x08064428 RL_FNC_SBYTE 0 CM_RAW -128 127 /end CHARACTERISTIC
/begin CHARACTERISTIC CAL_808 "массив #808" VAL_BLK 0x0806442C RL_FNC_SWORD 0 CM_RAW -32768 32767 MATRIX_DIM 2 1 1 /end CHARACTERISTIC
/begin CHARACTERISTIC CAL_809 "значение #809" VALUE 0x08064432 RL_FNC_SBYTE 0 CM_RAW -128 127 /end CHARACTERISTIC
/begin CHARACTERISTIC CAL_80B "карта #80B 2x9: ? × ?" MAP 0x0806440C RL_FNC_SBYTE 0 CM_RAW -128 127 /begin AXIS_DESCR COM_AXIS AXIN_070 CM_RAW 9 -128 127 AXIS_PTS_REF AX_070 /end AXIS_DESCR /begin AXIS_DESCR COM_AXIS AXIN_0E9 CM_RAW 2 -128 127 AXIS_PTS_REF AX_0E9 /end AXIS_DESCR /end CHARACTERISTIC
/begin CHARACTERISTIC CAL_80C "карта #80C 2x6: ? × ?" MAP 0x08064400 RL_FNC_SBYTE 0 CM_RAW -128 127 /begin AXIS_DESCR COM_AXIS AXIN_071 CM_RAW 6 -128 127 AXIS_PTS_REF AX_071 /end AXIS_DESCR /begin AXIS_DESCR COM_AXIS AXIN_0E9 CM_RAW 2 -128 127 AXIS_PTS_REF AX_0E9 /end AXIS_DESCR /end CHARACTERISTIC
/begin CHARACTERISTIC CAL_80D "массив #80D" VAL_BLK 0x08074958 RL_FNC_SBYTE 0 CM_RAW -128 127 MATRIX_DIM 2 1 1 /end CHARACTERISTIC
/begin CHARACTERISTIC CAL_80E "значение #80E" VALUE 0x08062F8C RL_FNC_UWORD 0 CM_RAW 0 65535 /end CHARACTERISTIC
/begin CHARACTERISTIC CAL_80F "значение #80F" VALUE 0x08062F8F RL_FNC_SBYTE 0 CM_RAW -128 127 /end CHARACTERISTIC
/begin CHARACTERISTIC CAL_810 "значение #810" VALUE 0x08062F90 RL_FNC_UWORD 0 CM_RAW 0 65535 /end CHARACTERISTIC
/begin CHARACTERISTIC CAL_811 "значение #811" VALUE 0x08062F94 RL_FNC_UWORD 0 CM_RAW 0 65535 /end CHARACTERISTIC
/begin CHARACTERISTIC CAL_812 "значение #812" VALUE 0x08062F96 RL_FNC_SWORD 0 CM_RAW -32768 32767 /end CHARACTERISTIC
/begin CHARACTERISTIC CAL_813 "значение #813" VALUE 0x08062F98 RL_FNC_SWORD 0 CM_RAW -32768 32767 /end CHARACTERISTIC
/begin CHARACTERISTIC CAL_814 "значение #814" VALUE 0x08062F9A RL_FNC_UWORD 0 CM_RAW 0 65535 /end CHARACTERISTIC
/begin CHARACTERISTIC CAL_815 "массив #815" VAL_BLK 0x08062F9C RL_FNC_SBYTE 0 CM_RAW -128 127 MATRIX_DIM 2 1 1 /end CHARACTERISTIC
/begin CHARACTERISTIC CAL_816 "значение #816" VALUE 0x08062F9E RL_FNC_UWORD 0 CM_RAW 0 65535 /end CHARACTERISTIC
/begin CHARACTERISTIC CAL_817 "карта #817 2x2: ? × ?" MAP 0x08062FA0 RL_FNC_SBYTE 0 CM_RAW -128 127 /begin AXIS_DESCR COM_AXIS AXIN_0EB CM_RAW 2 -128 127 AXIS_PTS_REF AX_0EB /end AXIS_DESCR /begin AXIS_DESCR COM_AXIS AXIN_0EA CM_RAW 2 -128 127 AXIS_PTS_REF AX_0EA /end AXIS_DESCR /end CHARACTERISTIC
/begin CHARACTERISTIC CAL_818 "значение #818" VALUE 0x08062FA8 RL_FNC_SBYTE 0 CM_RAW -128 127 /end CHARACTERISTIC
/begin CHARACTERISTIC CAL_81A "значение #81A" VALUE 0x08070254 RL_FNC_SBYTE 0 CM_RAW -128 127 /end CHARACTERISTIC
/begin CHARACTERISTIC CAL_81B "значение #81B" VALUE 0x0806D2F4 RL_FNC_UWORD 0 CM_RAW 0 65535 /end CHARACTERISTIC
/begin CHARACTERISTIC CAL_81C "значение #81C" VALUE 0x08063311 RL_FNC_SBYTE 0 CM_RAW -128 127 /end CHARACTERISTIC
/begin CHARACTERISTIC CAL_81D "значение #81D" VALUE 0x080632F2 RL_FNC_UWORD 0 CM_RAW 0 65535 /end CHARACTERISTIC
/begin CHARACTERISTIC CAL_81E "значение #81E" VALUE 0x08063317 RL_FNC_SBYTE 0 CM_RAW -128 127 /end CHARACTERISTIC
/begin CHARACTERISTIC CAL_81F "значение #81F" VALUE 0x08063325 RL_FNC_SBYTE 0 CM_RAW -128 127 /end CHARACTERISTIC
/begin CHARACTERISTIC CAL_820 "значение #820" VALUE 0x08063346 RL_FNC_SBYTE 0 CM_RAW -128 127 /end CHARACTERISTIC
/begin CHARACTERISTIC CAL_821 "значение #821" VALUE 0x0806334A RL_FNC_SBYTE 0 CM_RAW -128 127 /end CHARACTERISTIC
/begin CHARACTERISTIC CAL_822 "значение #822" VALUE 0x0806334B RL_FNC_SBYTE 0 CM_RAW -128 127 /end CHARACTERISTIC
/begin CHARACTERISTIC CAL_823 "значение #823" VALUE 0x08063366 RL_FNC_SBYTE 0 CM_RAW -128 127 /end CHARACTERISTIC
/begin CHARACTERISTIC CAL_824 "значение #824" VALUE 0x08063372 RL_FNC_SBYTE 0 CM_RAW -128 127 /end CHARACTERISTIC
/begin CHARACTERISTIC CAL_825 "значение #825" VALUE 0x080632FC RL_FNC_SBYTE 0 CM_RAW -128 127 /end CHARACTERISTIC
/begin CHARACTERISTIC CAL_826 "значение #826" VALUE 0x080632F8 RL_FNC_SBYTE 0 CM_RAW -128 127 /end CHARACTERISTIC
/begin CHARACTERISTIC CAL_827 "значение #827" VALUE 0x0806332A RL_FNC_SBYTE 0 CM_RAW -128 127 /end CHARACTERISTIC
/begin CHARACTERISTIC CAL_828 "значение #828" VALUE 0x0806334E RL_FNC_SBYTE 0 CM_RAW -128 127 /end CHARACTERISTIC
/begin CHARACTERISTIC CAL_829 "значение #829" VALUE 0x080632F5 RL_FNC_SBYTE 0 CM_RAW -128 127 /end CHARACTERISTIC
/begin CHARACTERISTIC CAL_82A "значение #82A" VALUE 0x08063318 RL_FNC_SBYTE 0 CM_RAW -128 127 /end CHARACTERISTIC
/begin CHARACTERISTIC CAL_82B "значение #82B" VALUE 0x08063324 RL_FNC_SBYTE 0 CM_RAW -128 127 /end CHARACTERISTIC
/begin CHARACTERISTIC CAL_82C "значение #82C" VALUE 0x0806334D RL_FNC_SBYTE 0 CM_RAW -128 127 /end CHARACTERISTIC
/begin CHARACTERISTIC CAL_82D "значение #82D" VALUE 0x08063358 RL_FNC_SLONG 0 CM_RAW -2.14748e+09 2.14748e+09 /end CHARACTERISTIC
/begin CHARACTERISTIC CAL_82E "значение #82E" VALUE 0x08063313 RL_FNC_SBYTE 0 CM_RAW -128 127 /end CHARACTERISTIC
/begin CHARACTERISTIC CAL_82F "значение #82F" VALUE 0x08063350 RL_FNC_SBYTE 0 CM_RAW -128 127 /end CHARACTERISTIC
/begin CHARACTERISTIC CAL_830 "значение #830" VALUE 0x080632F0 RL_FNC_SBYTE 0 CM_RAW -128 127 /end CHARACTERISTIC
/begin CHARACTERISTIC CAL_831 "значение #831" VALUE 0x08063342 RL_FNC_SBYTE 0 CM_RAW -128 127 /end CHARACTERISTIC
/begin CHARACTERISTIC CAL_832 "значение #832" VALUE 0x08063300 RL_FNC_SBYTE 0 CM_RAW -128 127 /end CHARACTERISTIC
/begin CHARACTERISTIC CAL_833 "значение #833" VALUE 0x08063339 RL_FNC_SBYTE 0 CM_RAW -128 127 /end CHARACTERISTIC
/begin CHARACTERISTIC CAL_834 "значение #834" VALUE 0x08063338 RL_FNC_SBYTE 0 CM_RAW -128 127 /end CHARACTERISTIC
/begin CHARACTERISTIC CAL_835 "значение #835" VALUE 0x080632E0 RL_FNC_SWORD 0 CM_RAW -32768 32767 /end CHARACTERISTIC
/begin CHARACTERISTIC CAL_836 "значение #836" VALUE 0x080632E2 RL_FNC_SWORD 0 CM_RAW -32768 32767 /end CHARACTERISTIC
/begin CHARACTERISTIC CAL_837 "значение #837" VALUE 0x08063328 RL_FNC_SBYTE 0 CM_RAW -128 127 /end CHARACTERISTIC
/begin CHARACTERISTIC CAL_838 "значение #838" VALUE 0x08063336 RL_FNC_SWORD 0 CM_RAW -32768 32767 /end CHARACTERISTIC
/begin CHARACTERISTIC CAL_839 "значение #839" VALUE 0x08063374 RL_FNC_SWORD 0 CM_RAW -32768 32767 /end CHARACTERISTIC
/begin CHARACTERISTIC CAL_83A "значение #83A" VALUE 0x08063376 RL_FNC_SWORD 0 CM_RAW -32768 32767 /end CHARACTERISTIC
/begin CHARACTERISTIC CAL_83B "значение #83B" VALUE 0x08063334 RL_FNC_SBYTE 0 CM_RAW -128 127 /end CHARACTERISTIC
/begin CHARACTERISTIC CAL_83C "значение #83C" VALUE 0x0806336E RL_FNC_SWORD 0 CM_RAW -32768 32767 /end CHARACTERISTIC
/begin CHARACTERISTIC CAL_83D "значение #83D" VALUE 0x080632DA RL_FNC_SBYTE 0 CM_RAW -128 127 /end CHARACTERISTIC
/begin CHARACTERISTIC CAL_83E "значение #83E" VALUE 0x080632DB RL_FNC_SBYTE 0 CM_RAW -128 127 /end CHARACTERISTIC
/begin CHARACTERISTIC CAL_83F "значение #83F" VALUE 0x08063347 RL_FNC_SBYTE 0 CM_RAW -128 127 /end CHARACTERISTIC
/begin CHARACTERISTIC CAL_840 "значение #840" VALUE 0x0806333C RL_FNC_SLONG 0 CM_RAW -2.14748e+09 2.14748e+09 /end CHARACTERISTIC
/begin CHARACTERISTIC CAL_841 "значение #841" VALUE 0x0806331D RL_FNC_SBYTE 0 CM_RAW -128 127 /end CHARACTERISTIC
/begin CHARACTERISTIC CAL_842 "значение #842" VALUE 0x08063329 RL_FNC_SBYTE 0 CM_RAW -128 127 /end CHARACTERISTIC
/begin CHARACTERISTIC CAL_843 "значение #843" VALUE 0x08063314 RL_FNC_SBYTE 0 CM_RAW -128 127 /end CHARACTERISTIC
/begin CHARACTERISTIC CAL_844 "значение #844" VALUE 0x080632F4 RL_FNC_SBYTE 0 CM_RAW -128 127 /end CHARACTERISTIC
/begin CHARACTERISTIC CAL_845 "значение #845" VALUE 0x08063319 RL_FNC_SBYTE 0 CM_RAW -128 127 /end CHARACTERISTIC
/begin CHARACTERISTIC CAL_846 "значение #846" VALUE 0x08063351 RL_FNC_SBYTE 0 CM_RAW -128 127 /end CHARACTERISTIC
/begin CHARACTERISTIC CAL_847 "значение #847" VALUE 0x08063303 RL_FNC_SBYTE 0 CM_RAW -128 127 /end CHARACTERISTIC
/begin CHARACTERISTIC CAL_848 "значение #848" VALUE 0x08063354 RL_FNC_SWORD 0 CM_RAW -32768 32767 /end CHARACTERISTIC
/begin CHARACTERISTIC CAL_849 "значение #849" VALUE 0x08063312 RL_FNC_SBYTE 0 CM_RAW -128 127 /end CHARACTERISTIC
/begin CHARACTERISTIC CAL_84A "значение #84A" VALUE 0x0806332C RL_FNC_SBYTE 0 CM_RAW -128 127 /end CHARACTERISTIC
/begin CHARACTERISTIC CAL_84B "значение #84B" VALUE 0x0806335E RL_FNC_SBYTE 0 CM_RAW -128 127 /end CHARACTERISTIC
/begin CHARACTERISTIC CAL_84C "значение #84C" VALUE 0x08063360 RL_FNC_SBYTE 0 CM_RAW -128 127 /end CHARACTERISTIC
/begin CHARACTERISTIC CAL_84D "значение #84D" VALUE 0x08063327 RL_FNC_SBYTE 0 CM_RAW -128 127 /end CHARACTERISTIC
/begin CHARACTERISTIC CAL_84E "значение #84E" VALUE 0x08063340 RL_FNC_SBYTE 0 CM_RAW -128 127 /end CHARACTERISTIC
/begin CHARACTERISTIC CAL_84F "значение #84F" VALUE 0x0806334C RL_FNC_SBYTE 0 CM_RAW -128 127 /end CHARACTERISTIC
/begin CHARACTERISTIC CAL_850 "значение #850" VALUE 0x0806335D RL_FNC_SBYTE 0 CM_RAW -128 127 /end CHARACTERISTIC
/begin CHARACTERISTIC CAL_851 "значение #851" VALUE 0x08063364 RL_FNC_SBYTE 0 CM_RAW -128 127 /end CHARACTERISTIC
/begin CHARACTERISTIC CAL_852 "значение #852" VALUE 0x0806336A RL_FNC_SBYTE 0 CM_RAW -128 127 /end CHARACTERISTIC
/begin CHARACTERISTIC CAL_853 "значение #853" VALUE 0x08063362 RL_FNC_SWORD 0 CM_RAW -32768 32767 /end CHARACTERISTIC
/begin CHARACTERISTIC CAL_854 "значение #854" VALUE 0x080632E7 RL_FNC_SBYTE 0 CM_RAW -128 127 /end CHARACTERISTIC
/begin CHARACTERISTIC CAL_855 "значение #855" VALUE 0x08063308 RL_FNC_SBYTE 0 CM_RAW -128 127 /end CHARACTERISTIC
/begin CHARACTERISTIC CAL_856 "значение #856" VALUE 0x08063356 RL_FNC_SBYTE 0 CM_RAW -128 127 /end CHARACTERISTIC
/begin CHARACTERISTIC CAL_857 "значение #857" VALUE 0x08063368 RL_FNC_SWORD 0 CM_RAW -32768 32767 /end CHARACTERISTIC
/begin CHARACTERISTIC CAL_858 "значение #858" VALUE 0x080632F6 RL_FNC_SBYTE 0 CM_RAW -128 127 /end CHARACTERISTIC
/begin CHARACTERISTIC CAL_859 "значение #859" VALUE 0x08063348 RL_FNC_SBYTE 0 CM_RAW -128 127 /end CHARACTERISTIC
/begin CHARACTERISTIC CAL_85A "значение #85A" VALUE 0x080632F7 RL_FNC_SBYTE 0 CM_RAW -128 127 /end CHARACTERISTIC
/begin CHARACTERISTIC CAL_85B "значение #85B" VALUE 0x08063322 RL_FNC_SBYTE 0 CM_RAW -128 127 /end CHARACTERISTIC
/begin CHARACTERISTIC CAL_85C "значение #85C" VALUE 0x0806335C RL_FNC_SBYTE 0 CM_RAW -128 127 /end CHARACTERISTIC
/begin CHARACTERISTIC CAL_85D "значение #85D" VALUE 0x080659BA RL_FNC_UWORD 0 CM_RAW 0 65535 /end CHARACTERISTIC
/begin CHARACTERISTIC CAL_85E "значение #85E" VALUE 0x080659BC RL_FNC_UWORD 0 CM_RAW 0 65535 /end CHARACTERISTIC
/begin CHARACTERISTIC CAL_85F "значение #85F" VALUE 0x080659BE RL_FNC_UWORD 0 CM_RAW 0 65535 /end CHARACTERISTIC
/begin CHARACTERISTIC CAL_860 "значение #860" VALUE 0x080659C0 RL_FNC_UWORD 0 CM_RAW 0 65535 /end CHARACTERISTIC
/begin CHARACTERISTIC CAL_861 "кривая #861 8: GEAR" CURVE 0x08071F3C RL_FNC_UWORD 0 CM_RAW 0 65535
 /begin AXIS_DESCR COM_AXIS AXIN_05E_GEAR CM_RAW 8 -128 127 AXIS_PTS_REF AX_05E_GEAR /end AXIS_DESCR
/end CHARACTERISTIC
/begin CHARACTERISTIC CAL_862_0 "кривая #862 8: GEAR [1/3]" CURVE 0x0806D0D8 RL_FNC_UWORD 0 CM_RAW 0 65535
 /begin AXIS_DESCR COM_AXIS AXIN_05E_GEAR CM_RAW 8 -128 127 AXIS_PTS_REF AX_05E_GEAR /end AXIS_DESCR
/end CHARACTERISTIC
/begin CHARACTERISTIC CAL_862_1 "кривая #862 8: GEAR [2/3]" CURVE 0x0806D0E8 RL_FNC_UWORD 0 CM_RAW 0 65535
 /begin AXIS_DESCR COM_AXIS AXIN_05E_GEAR CM_RAW 8 -128 127 AXIS_PTS_REF AX_05E_GEAR /end AXIS_DESCR
/end CHARACTERISTIC
/begin CHARACTERISTIC CAL_862_2 "кривая #862 8: GEAR [3/3]" CURVE 0x0806D0F8 RL_FNC_UWORD 0 CM_RAW 0 65535
 /begin AXIS_DESCR COM_AXIS AXIN_05E_GEAR CM_RAW 8 -128 127 AXIS_PTS_REF AX_05E_GEAR /end AXIS_DESCR
/end CHARACTERISTIC
/begin CHARACTERISTIC CAL_863 "кривая #863 11: ?" CURVE 0x08071EF8 RL_FNC_UWORD 0 CM_RAW 0 65535
 /begin AXIS_DESCR COM_AXIS AXIN_0B4 CM_RAW 11 -32768 32767 AXIS_PTS_REF AX_0B4 /end AXIS_DESCR
/end CHARACTERISTIC
/begin CHARACTERISTIC CAL_864 "значение #864" VALUE 0x0806199E RL_FNC_SBYTE 0 CM_RAW -128 127 /end CHARACTERISTIC
/begin CHARACTERISTIC CAL_865 "карта #865 2x2: ? × ?" MAP 0x080619A8 RL_FNC_UWORD 0 CM_RAW 0 65535 /begin AXIS_DESCR COM_AXIS AXIN_0ED CM_RAW 2 0 255 AXIS_PTS_REF AX_0ED /end AXIS_DESCR /begin AXIS_DESCR COM_AXIS AXIN_0ED CM_RAW 2 0 255 AXIS_PTS_REF AX_0ED /end AXIS_DESCR /end CHARACTERISTIC
/begin CHARACTERISTIC CAL_866 "массив #866" VAL_BLK 0x080748FC RL_FNC_UWORD 0 CM_RAW 0 65535 MATRIX_DIM 2 1 1 /end CHARACTERISTIC
/begin CHARACTERISTIC CAL_867 "значение #867" VALUE 0x08062C84 RL_FNC_UWORD 0 CM_RAW 0 65535 /end CHARACTERISTIC
/begin CHARACTERISTIC CAL_86D "массив #86D" VAL_BLK 0x080690B8 RL_FNC_SBYTE 0 CM_RAW -128 127 MATRIX_DIM 8 1 1 /end CHARACTERISTIC
/begin CHARACTERISTIC CAL_86E "массив #86E" VAL_BLK 0x080690C0 RL_FNC_SBYTE 0 CM_RAW -128 127 MATRIX_DIM 11 1 1 /end CHARACTERISTIC
/begin CHARACTERISTIC CAL_86F "массив #86F" VAL_BLK 0x080690DC RL_FNC_SBYTE 0 CM_RAW -128 127 MATRIX_DIM 10 1 1 /end CHARACTERISTIC
/begin CHARACTERISTIC CAL_870 "массив #870" VAL_BLK 0x080690E8 RL_FNC_SBYTE 0 CM_RAW -128 127 MATRIX_DIM 4 1 1 /end CHARACTERISTIC
/begin CHARACTERISTIC CAL_871 "массив #871" VAL_BLK 0x080690F8 RL_FNC_SBYTE 0 CM_RAW -128 127 MATRIX_DIM 15 1 1 /end CHARACTERISTIC
/begin CHARACTERISTIC CAL_872 "массив #872" VAL_BLK 0x080690EC RL_FNC_SBYTE 0 CM_RAW -128 127 MATRIX_DIM 10 1 1 /end CHARACTERISTIC
/begin CHARACTERISTIC CAL_873 "массив #873" VAL_BLK 0x08069108 RL_FNC_SBYTE 0 CM_RAW -128 127 MATRIX_DIM 10 1 1 /end CHARACTERISTIC
/begin CHARACTERISTIC CAL_874 "массив #874" VAL_BLK 0x08069114 RL_FNC_SBYTE 0 CM_RAW -128 127 MATRIX_DIM 15 1 1 /end CHARACTERISTIC
/begin CHARACTERISTIC CAL_875 "массив #875" VAL_BLK 0x08069124 RL_FNC_SBYTE 0 CM_RAW -128 127 MATRIX_DIM 10 1 1 /end CHARACTERISTIC
/begin CHARACTERISTIC CAL_876 "массив #876" VAL_BLK 0x08069130 RL_FNC_SBYTE 0 CM_RAW -128 127 MATRIX_DIM 11 1 1 /end CHARACTERISTIC
/begin CHARACTERISTIC CAL_877 "массив #877" VAL_BLK 0x08069140 RL_FNC_SBYTE 0 CM_RAW -128 127 MATRIX_DIM 16 1 1 /end CHARACTERISTIC
/begin CHARACTERISTIC CAL_878 "массив #878" VAL_BLK 0x08069150 RL_FNC_SBYTE 0 CM_RAW -128 127 MATRIX_DIM 10 1 1 /end CHARACTERISTIC
/begin CHARACTERISTIC CAL_879 "массив #879" VAL_BLK 0x08068FB0 RL_FNC_SBYTE 0 CM_RAW -128 127 MATRIX_DIM 7 1 1 /end CHARACTERISTIC
/begin CHARACTERISTIC CAL_87A "значение #87A" VALUE 0x0806913C RL_FNC_UWORD 0 CM_RAW 0 65535 /end CHARACTERISTIC
/begin CHARACTERISTIC CAL_87B "массив #87B" VAL_BLK 0x08069054 RL_FNC_SWORD 0 CM_RAW -32768 32767 MATRIX_DIM 10 1 1 /end CHARACTERISTIC
/begin CHARACTERISTIC CAL_87C "массив #87C" VAL_BLK 0x080690D0 RL_FNC_SBYTE 0 CM_RAW -128 127 MATRIX_DIM 10 1 1 /end CHARACTERISTIC
/begin CHARACTERISTIC CAL_87D "значение #87D" VALUE 0x0806EAC1 RL_FNC_SBYTE 0 CM_RAW -128 127 /end CHARACTERISTIC
/begin CHARACTERISTIC CAL_87E "значение #87E" VALUE 0x0806EAC2 RL_FNC_SBYTE 0 CM_RAW -128 127 /end CHARACTERISTIC
/begin CHARACTERISTIC CAL_87F "значение #87F" VALUE 0x0806EAC0 RL_FNC_SBYTE 0 CM_RAW -128 127 /end CHARACTERISTIC
/begin CHARACTERISTIC CAL_880 "значение #880" VALUE 0x0806EAC3 RL_FNC_SBYTE 0 CM_RAW -128 127 /end CHARACTERISTIC
/begin CHARACTERISTIC CAL_881 "значение #881" VALUE 0x0806EAC4 RL_FNC_SBYTE 0 CM_RAW -128 127 /end CHARACTERISTIC
/begin CHARACTERISTIC CAL_882 "массив #882" VAL_BLK 0x0806EAC8 RL_FNC_SBYTE 0 CM_RAW -128 127 MATRIX_DIM 20 1 1 /end CHARACTERISTIC
/begin CHARACTERISTIC CAL_883 "значение #883" VALUE 0x0806913E RL_FNC_SBYTE 0 CM_RAW -128 127 /end CHARACTERISTIC
/begin CHARACTERISTIC CAL_884 "значение #884" VALUE 0x0807497A RL_FNC_UWORD 0 CM_RAW 0 65535 /end CHARACTERISTIC
/begin CHARACTERISTIC CAL_886 "значение #886" VALUE 0x080696AA RL_FNC_SBYTE 0 CM_RAW -128 127 /end CHARACTERISTIC
/begin CHARACTERISTIC CAL_887 "карта #887 3x9: ? × ?" MAP 0x08069700 RL_FNC_SBYTE 0 CM_RAW -128 127 /begin AXIS_DESCR COM_AXIS AXIN_070 CM_RAW 9 -128 127 AXIS_PTS_REF AX_070 /end AXIS_DESCR /begin AXIS_DESCR COM_AXIS AXIN_0EE CM_RAW 3 -128 127 AXIS_PTS_REF AX_0EE /end AXIS_DESCR /end CHARACTERISTIC
/begin CHARACTERISTIC CAL_888 "карта #888 3x6: ? × ?" MAP 0x080696EC RL_FNC_SBYTE 0 CM_RAW -128 127 /begin AXIS_DESCR COM_AXIS AXIN_071 CM_RAW 6 -128 127 AXIS_PTS_REF AX_071 /end AXIS_DESCR /begin AXIS_DESCR COM_AXIS AXIN_0EE CM_RAW 3 -128 127 AXIS_PTS_REF AX_0EE /end AXIS_DESCR /end CHARACTERISTIC
/begin CHARACTERISTIC CAL_889 "массив #889" VAL_BLK 0x080690B0 RL_FNC_SWORD 0 CM_RAW -32768 32767 MATRIX_DIM 4 1 1 /end CHARACTERISTIC
/begin CHARACTERISTIC CAL_88A "значение #88A" VALUE 0x080691FA RL_FNC_UWORD 0 CM_RAW 0 65535 /end CHARACTERISTIC
/begin CHARACTERISTIC CAL_88C "значение #88C" VALUE 0x0806621E RL_FNC_UWORD 0 CM_RAW 0 65535 /end CHARACTERISTIC
/begin CHARACTERISTIC CAL_88D "значение #88D" VALUE 0x08066220 RL_FNC_UBYTE 0 CM_RAW 0 255 /end CHARACTERISTIC
/begin CHARACTERISTIC CAL_88E "кривая #88E 8: TAIR" CURVE 0x08066250 RL_FNC_UWORD 0 CM_RAW 0 65535
 /begin AXIS_DESCR COM_AXIS AXIN_049_TAIR CM_C128 8 -256 255.992 AXIS_PTS_REF AX_049_TAIR /end AXIS_DESCR
/end CHARACTERISTIC
/begin CHARACTERISTIC CAL_88F "значение #88F" VALUE 0x0806624C RL_FNC_UWORD 0 CM_RAW 0 65535 /end CHARACTERISTIC
/begin CHARACTERISTIC CAL_890 "значение #890" VALUE 0x08066260 RL_FNC_UWORD 0 CM_RAW 0 65535 /end CHARACTERISTIC
/begin CHARACTERISTIC CAL_891 "массив #891" VAL_BLK 0x08066264 RL_FNC_UWORD 0 CM_RAW 0 65535 MATRIX_DIM 4 1 1 /end CHARACTERISTIC
/begin CHARACTERISTIC CAL_892 "массив #892" VAL_BLK 0x0806626C RL_FNC_UWORD 0 CM_RAW 0 65535 MATRIX_DIM 3 1 1 /end CHARACTERISTIC
/begin CHARACTERISTIC CAL_893 "карта #893 4x2: ? × ?" MAP 0x08066290 RL_FNC_UWORD 0 CM_RAW 0 65535 /begin AXIS_DESCR COM_AXIS AXIN_0EF CM_RAW 2 -128 127 AXIS_PTS_REF AX_0EF /end AXIS_DESCR /begin AXIS_DESCR COM_AXIS AXIN_0F0 CM_RAW 4 -128 127 AXIS_PTS_REF AX_0F0 /end AXIS_DESCR /end CHARACTERISTIC
/begin CHARACTERISTIC CAL_894 "массив #894" VAL_BLK 0x080662B4 RL_FNC_UWORD 0 CM_RAW 0 65535 MATRIX_DIM 2 1 1 /end CHARACTERISTIC
/begin CHARACTERISTIC CAL_895 "массив #895" VAL_BLK 0x080662B8 RL_FNC_UWORD 0 CM_RAW 0 65535 MATRIX_DIM 2 1 1 /end CHARACTERISTIC
/begin CHARACTERISTIC CAL_896 "значение #896" VALUE 0x080662BC RL_FNC_UWORD 0 CM_RAW 0 65535 /end CHARACTERISTIC
/begin CHARACTERISTIC CAL_897 "значение #897" VALUE 0x080662BE RL_FNC_UWORD 0 CM_RAW 0 65535 /end CHARACTERISTIC
/begin CHARACTERISTIC CAL_898 "значение #898" VALUE 0x080662C0 RL_FNC_SBYTE 0 CM_RAW -128 127 /end CHARACTERISTIC
/begin CHARACTERISTIC CAL_899 "значение #899" VALUE 0x080748B4 RL_FNC_SWORD 0 CM_RAW -32768 32767 /end CHARACTERISTIC
/begin CHARACTERISTIC CAL_89A "значение #89A" VALUE 0x080748B6 RL_FNC_UWORD 0 CM_RAW 0 65535 /end CHARACTERISTIC
/begin CHARACTERISTIC CAL_89B "значение #89B" VALUE 0x080748B8 RL_FNC_UWORD 0 CM_RAW 0 65535 /end CHARACTERISTIC
/begin CHARACTERISTIC CAL_89C "массив #89C" VAL_BLK 0x080748BC RL_FNC_SWORD 0 CM_RAW -32768 32767 MATRIX_DIM 2 1 1 /end CHARACTERISTIC
/begin CHARACTERISTIC CAL_89D "значение #89D" VALUE 0x080748C0 RL_FNC_UWORD 0 CM_RAW 0 65535 /end CHARACTERISTIC
/begin CHARACTERISTIC CAL_89E "значение #89E" VALUE 0x080748C2 RL_FNC_UWORD 0 CM_RAW 0 65535 /end CHARACTERISTIC
/begin CHARACTERISTIC CAL_89F "массив #89F" VAL_BLK 0x080748C8 RL_FNC_UWORD 0 CM_RAW 0 65535 MATRIX_DIM 2 1 1 /end CHARACTERISTIC
/begin CHARACTERISTIC CAL_8A1 "массив #8A1" VAL_BLK 0x080680A8 RL_FNC_SBYTE 0 CM_RAW -128 127 MATRIX_DIM 4 1 1 /end CHARACTERISTIC
/begin CHARACTERISTIC CAL_8A2 "карта #8A2 3x9: ? × ?" MAP 0x080680F4 RL_FNC_SBYTE 0 CM_RAW -128 127 /begin AXIS_DESCR COM_AXIS AXIN_070 CM_RAW 9 -128 127 AXIS_PTS_REF AX_070 /end AXIS_DESCR /begin AXIS_DESCR COM_AXIS AXIN_0F1 CM_RAW 3 -128 127 AXIS_PTS_REF AX_0F1 /end AXIS_DESCR /end CHARACTERISTIC
/begin CHARACTERISTIC CAL_8A3_0 "карта #8A3 3x6: ? × ? [1/4]" MAP 0x080680AC RL_FNC_SBYTE 0 CM_RAW -128 127 /begin AXIS_DESCR COM_AXIS AXIN_071 CM_RAW 6 -128 127 AXIS_PTS_REF AX_071 /end AXIS_DESCR /begin AXIS_DESCR COM_AXIS AXIN_0F1 CM_RAW 3 -128 127 AXIS_PTS_REF AX_0F1 /end AXIS_DESCR /end CHARACTERISTIC
/begin CHARACTERISTIC CAL_8A3_1 "карта #8A3 3x6: ? × ? [2/4]" MAP 0x080680BE RL_FNC_SBYTE 0 CM_RAW -128 127 /begin AXIS_DESCR COM_AXIS AXIN_071 CM_RAW 6 -128 127 AXIS_PTS_REF AX_071 /end AXIS_DESCR /begin AXIS_DESCR COM_AXIS AXIN_0F1 CM_RAW 3 -128 127 AXIS_PTS_REF AX_0F1 /end AXIS_DESCR /end CHARACTERISTIC
/begin CHARACTERISTIC CAL_8A3_2 "карта #8A3 3x6: ? × ? [3/4]" MAP 0x080680D0 RL_FNC_SBYTE 0 CM_RAW -128 127 /begin AXIS_DESCR COM_AXIS AXIN_071 CM_RAW 6 -128 127 AXIS_PTS_REF AX_071 /end AXIS_DESCR /begin AXIS_DESCR COM_AXIS AXIN_0F1 CM_RAW 3 -128 127 AXIS_PTS_REF AX_0F1 /end AXIS_DESCR /end CHARACTERISTIC
/begin CHARACTERISTIC CAL_8A3_3 "карта #8A3 3x6: ? × ? [4/4]" MAP 0x080680E2 RL_FNC_SBYTE 0 CM_RAW -128 127 /begin AXIS_DESCR COM_AXIS AXIN_071 CM_RAW 6 -128 127 AXIS_PTS_REF AX_071 /end AXIS_DESCR /begin AXIS_DESCR COM_AXIS AXIN_0F1 CM_RAW 3 -128 127 AXIS_PTS_REF AX_0F1 /end AXIS_DESCR /end CHARACTERISTIC
/begin CHARACTERISTIC CAL_8A4 "значение #8A4" VALUE 0x08069D64 RL_FNC_UWORD 0 CM_RAW 0 65535 /end CHARACTERISTIC
/begin CHARACTERISTIC CAL_8A5 "значение #8A5" VALUE 0x08069946 RL_FNC_UBYTE 0 CM_RAW 0 255 /end CHARACTERISTIC
/begin CHARACTERISTIC CAL_8A6 "значение #8A6" VALUE 0x08065C5C RL_FNC_SBYTE 0 CM_RAW -128 127 /end CHARACTERISTIC
/begin CHARACTERISTIC CAL_8A7 "кривая #8A7 10: ?" CURVE 0x08062C70 RL_FNC_UWORD 0 CM_RAW 0 65535 /begin AXIS_DESCR COM_AXIS AXIN_0F2 CM_RAW 10 0 255 AXIS_PTS_REF AX_0F2 /end AXIS_DESCR /end CHARACTERISTIC
/begin CHARACTERISTIC CAL_8A8 "карта #8A8 5x2: ? × ?" MAP 0x08066224 RL_FNC_UWORD 0 CM_RAW 0 65535 /begin AXIS_DESCR COM_AXIS AXIN_0F3 CM_RAW 2 -128 127 AXIS_PTS_REF AX_0F3 /end AXIS_DESCR /begin AXIS_DESCR COM_AXIS AXIN_0F4 CM_RAW 5 -128 127 AXIS_PTS_REF AX_0F4 /end AXIS_DESCR /end CHARACTERISTIC
/begin CHARACTERISTIC CAL_8A9 "карта #8A9 5x2: ? × ?" MAP 0x08066238 RL_FNC_UWORD 0 CM_RAW 0 65535 /begin AXIS_DESCR COM_AXIS AXIN_0F3 CM_RAW 2 -128 127 AXIS_PTS_REF AX_0F3 /end AXIS_DESCR /begin AXIS_DESCR COM_AXIS AXIN_0F4 CM_RAW 5 -128 127 AXIS_PTS_REF AX_0F4 /end AXIS_DESCR /end CHARACTERISTIC
/begin CHARACTERISTIC CAL_8AA "массив #8AA" VAL_BLK 0x08066274 RL_FNC_UWORD 0 CM_RAW 0 65535 MATRIX_DIM 3 1 1 /end CHARACTERISTIC
/begin CHARACTERISTIC CAL_8AB "карта #8AB 5x2: ? × ?" MAP 0x0806627C RL_FNC_UWORD 0 CM_RAW 0 65535 /begin AXIS_DESCR COM_AXIS AXIN_0F3 CM_RAW 2 -128 127 AXIS_PTS_REF AX_0F3 /end AXIS_DESCR /begin AXIS_DESCR COM_AXIS AXIN_0F4 CM_RAW 5 -128 127 AXIS_PTS_REF AX_0F4 /end AXIS_DESCR /end CHARACTERISTIC
/begin CHARACTERISTIC CAL_8AC "карта #8AC 5x2: ? × ?" MAP 0x080662A0 RL_FNC_UWORD 0 CM_RAW 0 65535 /begin AXIS_DESCR COM_AXIS AXIN_0F3 CM_RAW 2 -128 127 AXIS_PTS_REF AX_0F3 /end AXIS_DESCR /begin AXIS_DESCR COM_AXIS AXIN_0F4 CM_RAW 5 -128 127 AXIS_PTS_REF AX_0F4 /end AXIS_DESCR /end CHARACTERISTIC
/begin CHARACTERISTIC CAL_8AD "массив #8AD" VAL_BLK 0x080662C4 RL_FNC_UWORD 0 CM_RAW 0 65535 MATRIX_DIM 4 1 1 /end CHARACTERISTIC
/begin CHARACTERISTIC CAL_8AE "массив #8AE" VAL_BLK 0x080662CC RL_FNC_UWORD 0 CM_RAW 0 65535 MATRIX_DIM 4 1 1 /end CHARACTERISTIC
/begin CHARACTERISTIC CAL_8AF "значение #8AF" VALUE 0x080647C4 RL_FNC_UWORD 0 CM_RAW 0 65535 /end CHARACTERISTIC
/begin CHARACTERISTIC CAL_8B0 "значение #8B0" VALUE 0x08062E6C RL_FNC_UWORD 0 CM_RAW 0 65535 /end CHARACTERISTIC
/begin CHARACTERISTIC CAL_8B1 "значение #8B1" VALUE 0x08062ECC RL_FNC_SWORD 0 CM_RAW -32768 32767 /end CHARACTERISTIC
/begin CHARACTERISTIC CAL_8B5 "значение #8B5" VALUE 0x0807499B RL_FNC_SBYTE 0 CM_RAW -128 127 /end CHARACTERISTIC
/begin CHARACTERISTIC CAL_8B6 "значение #8B6" VALUE 0x08068248 RL_FNC_SBYTE 0 CM_RAW -128 127 /end CHARACTERISTIC
/begin CHARACTERISTIC CAL_8B7 "значение #8B7" VALUE 0x0806824C RL_FNC_SLONG 0 CM_RAW -2.14748e+09 2.14748e+09 /end CHARACTERISTIC
/begin CHARACTERISTIC CAL_8B8 "значение #8B8" VALUE 0x08068F6C RL_FNC_SBYTE 0 CM_RAW -128 127 /end CHARACTERISTIC
/begin CHARACTERISTIC CAL_8B9 "значение #8B9" VALUE 0x08068F6A RL_FNC_UWORD 0 CM_RAW 0 65535 /end CHARACTERISTIC
/begin CHARACTERISTIC CAL_8BA "значение #8BA" VALUE 0x08074956 RL_FNC_UWORD 0 CM_RAW 0 65535 /end CHARACTERISTIC
/begin CHARACTERISTIC CAL_8BB "значение #8BB" VALUE 0x08074954 RL_FNC_UWORD 0 CM_RAW 0 65535 /end CHARACTERISTIC
/begin CHARACTERISTIC CAL_8BC "массив #8BC" VAL_BLK 0x0806D2D4 RL_FNC_UWORD 0 CM_RAW 0 65535 MATRIX_DIM 2 1 1 /end CHARACTERISTIC
/begin CHARACTERISTIC CAL_8BD "значение #8BD" VALUE 0x0806BB3E RL_FNC_SWORD 0 CM_RAW -32768 32767 /end CHARACTERISTIC
/begin CHARACTERISTIC CAL_8BE "кривая #8BE 8: TAIR" CURVE 0x08073BA8 RL_FNC_UWORD 0 CM_RAW 0 65535
 /begin AXIS_DESCR COM_AXIS AXIN_049_TAIR CM_C128 8 -256 255.992 AXIS_PTS_REF AX_049_TAIR /end AXIS_DESCR
/end CHARACTERISTIC
/begin CHARACTERISTIC CAL_8C0 "массив #8C0" VAL_BLK 0x0806B780 RL_FNC_UWORD 0 CM_RAW 0 65535 MATRIX_DIM 2 1 1 /end CHARACTERISTIC
/begin CHARACTERISTIC CAL_8C1 "массив #8C1" VAL_BLK 0x0806B8B0 RL_FNC_UWORD 0 CM_RAW 0 65535 MATRIX_DIM 2 1 1 /end CHARACTERISTIC
/begin CHARACTERISTIC CAL_8C2 "массив #8C2" VAL_BLK 0x0806B8B4 RL_FNC_UWORD 0 CM_RAW 0 65535 MATRIX_DIM 2 1 1 /end CHARACTERISTIC
/begin CHARACTERISTIC CAL_8C3 "массив #8C3" VAL_BLK 0x0806B75C RL_FNC_UWORD 0 CM_RAW 0 65535 MATRIX_DIM 2 1 1 /end CHARACTERISTIC
/begin CHARACTERISTIC CAL_8C4 "массив #8C4" VAL_BLK 0x0806B8AC RL_FNC_UWORD 0 CM_RAW 0 65535 MATRIX_DIM 2 1 1 /end CHARACTERISTIC
/begin CHARACTERISTIC CAL_8C5 "массив #8C5" VAL_BLK 0x0806B89C RL_FNC_UWORD 0 CM_RAW 0 65535 MATRIX_DIM 2 1 1 /end CHARACTERISTIC
/begin CHARACTERISTIC CAL_8C6 "массив #8C6" VAL_BLK 0x0806B8A0 RL_FNC_UWORD 0 CM_RAW 0 65535 MATRIX_DIM 2 1 1 /end CHARACTERISTIC
/begin CHARACTERISTIC CAL_8C7 "карта #8C7 2x2: ? × ?" MAP 0x0806B8A4 RL_FNC_UWORD 0 CM_RAW 0 65535 /begin AXIS_DESCR COM_AXIS AXIN_0D4 CM_RAW 2 -128 127 AXIS_PTS_REF AX_0D4 /end AXIS_DESCR /begin AXIS_DESCR COM_AXIS AXIN_046 CM_RAW 2 -128 127 AXIS_PTS_REF AX_046 /end AXIS_DESCR /end CHARACTERISTIC
/begin CHARACTERISTIC CAL_8C9 "массив #8C9" VAL_BLK 0x0806B784 RL_FNC_UWORD 0 CM_RAW 0 65535 MATRIX_DIM 2 1 1 /end CHARACTERISTIC
/begin CHARACTERISTIC CAL_8CA "массив #8CA" VAL_BLK 0x0806B898 RL_FNC_UWORD 0 CM_RAW 0 65535 MATRIX_DIM 2 1 1 /end CHARACTERISTIC
/begin CHARACTERISTIC CAL_8CB "массив #8CB" VAL_BLK 0x0806B788 RL_FNC_SBYTE 0 CM_RAW -128 127 MATRIX_DIM 2 1 1 /end CHARACTERISTIC
/begin CHARACTERISTIC CAL_8CC "массив #8CC" VAL_BLK 0x0806B78C RL_FNC_SBYTE 0 CM_RAW -128 127 MATRIX_DIM 2 1 1 /end CHARACTERISTIC
/begin CHARACTERISTIC CAL_8CD "массив #8CD" VAL_BLK 0x0806B790 RL_FNC_UWORD 0 CM_RAW 0 65535 MATRIX_DIM 2 1 1 /end CHARACTERISTIC
/begin CHARACTERISTIC CAL_8CE "массив #8CE" VAL_BLK 0x0806B794 RL_FNC_UWORD 0 CM_RAW 0 65535 MATRIX_DIM 2 1 1 /end CHARACTERISTIC
/begin CHARACTERISTIC CAL_8CF "массив #8CF" VAL_BLK 0x0806B798 RL_FNC_UWORD 0 CM_RAW 0 65535 MATRIX_DIM 2 1 1 /end CHARACTERISTIC
/begin CHARACTERISTIC CAL_8D0 "массив #8D0" VAL_BLK 0x0806B79C RL_FNC_UWORD 0 CM_RAW 0 65535 MATRIX_DIM 2 1 1 /end CHARACTERISTIC
/begin CHARACTERISTIC CAL_8D1 "карта #8D1 8x9: ? × ?" MAP 0x0806B800 RL_FNC_SBYTE 0 CM_RAW -128 127 /begin AXIS_DESCR COM_AXIS AXIN_070 CM_RAW 9 -128 127 AXIS_PTS_REF AX_070 /end AXIS_DESCR /begin AXIS_DESCR COM_AXIS AXIN_0F8 CM_RAW 8 -128 127 AXIS_PTS_REF AX_0F8 /end AXIS_DESCR /end CHARACTERISTIC
/begin CHARACTERISTIC CAL_8D2 "карта #8D2 8x9: ? × ?" MAP 0x0806B848 RL_FNC_SBYTE 0 CM_RAW -128 127 /begin AXIS_DESCR COM_AXIS AXIN_070 CM_RAW 9 -128 127 AXIS_PTS_REF AX_070 /end AXIS_DESCR /begin AXIS_DESCR COM_AXIS AXIN_0F8 CM_RAW 8 -128 127 AXIS_PTS_REF AX_0F8 /end AXIS_DESCR /end CHARACTERISTIC
/begin CHARACTERISTIC CAL_8D3 "карта #8D3 8x6: ? × ?" MAP 0x0806B7A0 RL_FNC_SBYTE 0 CM_RAW -128 127 /begin AXIS_DESCR COM_AXIS AXIN_071 CM_RAW 6 -128 127 AXIS_PTS_REF AX_071 /end AXIS_DESCR /begin AXIS_DESCR COM_AXIS AXIN_0F8 CM_RAW 8 -128 127 AXIS_PTS_REF AX_0F8 /end AXIS_DESCR /end CHARACTERISTIC
/begin CHARACTERISTIC CAL_8D4 "карта #8D4 8x6: ? × ?" MAP 0x0806B7D0 RL_FNC_SBYTE 0 CM_RAW -128 127 /begin AXIS_DESCR COM_AXIS AXIN_071 CM_RAW 6 -128 127 AXIS_PTS_REF AX_071 /end AXIS_DESCR /begin AXIS_DESCR COM_AXIS AXIN_0F8 CM_RAW 8 -128 127 AXIS_PTS_REF AX_0F8 /end AXIS_DESCR /end CHARACTERISTIC
/begin CHARACTERISTIC CAL_8D7 "массив #8D7" VAL_BLK 0x0806D320 RL_FNC_SBYTE 0 CM_RAW -128 127 MATRIX_DIM 4 1 1 /end CHARACTERISTIC
/begin CHARACTERISTIC CAL_8D8 "карта #8D8 2x9: ? × ?" MAP 0x0806D308 RL_FNC_SBYTE 0 CM_RAW -128 127 /begin AXIS_DESCR COM_AXIS AXIN_070 CM_RAW 9 -128 127 AXIS_PTS_REF AX_070 /end AXIS_DESCR /begin AXIS_DESCR COM_AXIS AXIN_0E4 CM_RAW 2 -128 127 AXIS_PTS_REF AX_0E4 /end AXIS_DESCR /end CHARACTERISTIC
/begin CHARACTERISTIC CAL_8D9 "карта #8D9 2x6: ? × ?" MAP 0x0806D2FC RL_FNC_SBYTE 0 CM_RAW -128 127 /begin AXIS_DESCR COM_AXIS AXIN_071 CM_RAW 6 -128 127 AXIS_PTS_REF AX_071 /end AXIS_DESCR /begin AXIS_DESCR COM_AXIS AXIN_0E4 CM_RAW 2 -128 127 AXIS_PTS_REF AX_0E4 /end AXIS_DESCR /end CHARACTERISTIC
/begin CHARACTERISTIC CAL_8DB "значение #8DB" VALUE 0x0806D2F8 RL_FNC_SBYTE 0 CM_RAW -128 127 /end CHARACTERISTIC
/begin CHARACTERISTIC CAL_8DF "массив #8DF" VAL_BLK 0x080681D4 RL_FNC_SWORD 0 CM_RAW -32768 32767 MATRIX_DIM 8 1 1 /end CHARACTERISTIC
/begin CHARACTERISTIC CAL_8E0 "значение #8E0" VALUE 0x08070382 RL_FNC_SBYTE 0 CM_RAW -128 127 /end CHARACTERISTIC
/begin CHARACTERISTIC CAL_8E1 "массив #8E1" VAL_BLK 0x0806903C RL_FNC_SWORD 0 CM_RAW -32768 32767 MATRIX_DIM 11 1 1 /end CHARACTERISTIC
/begin CHARACTERISTIC CAL_8E4 "значение #8E4" VALUE 0x080749EE RL_FNC_SBYTE 0 CM_RAW -128 127 /end CHARACTERISTIC
/begin CHARACTERISTIC CAL_8E5 "значение #8E5" VALUE 0x08063E0A RL_FNC_UWORD 0 CM_RAW 0 65535 /end CHARACTERISTIC
/begin CHARACTERISTIC CAL_8E6 "кривая #8E6 9: TCOOL" CURVE 0x08071F60 RL_FNC_UWORD 0 CM_RAW 0 65535
 /begin AXIS_DESCR COM_AXIS AXIN_00A_TCOOL CM_C128 9 -256 255.992 AXIS_PTS_REF AX_00A_TCOOL /end AXIS_DESCR
/end CHARACTERISTIC
/begin CHARACTERISTIC CAL_8E7 "кривая #8E7 9: TCOOL" CURVE 0x08071F28 RL_FNC_UWORD 0 CM_RAW 0 65535
 /begin AXIS_DESCR COM_AXIS AXIN_00A_TCOOL CM_C128 9 -256 255.992 AXIS_PTS_REF AX_00A_TCOOL /end AXIS_DESCR
/end CHARACTERISTIC
/begin CHARACTERISTIC CAL_8E8 "кривая #8E8 9: TCOOL" CURVE 0x08071F4C RL_FNC_UWORD 0 CM_RAW 0 65535
 /begin AXIS_DESCR COM_AXIS AXIN_00A_TCOOL CM_C128 9 -256 255.992 AXIS_PTS_REF AX_00A_TCOOL /end AXIS_DESCR
/end CHARACTERISTIC
/begin CHARACTERISTIC CAL_8E9 "массив #8E9" VAL_BLK 0x0806CD18 RL_FNC_UWORD 0 CM_RAW 0 65535 MATRIX_DIM 2 1 1 /end CHARACTERISTIC
/begin CHARACTERISTIC CAL_8EA "значение #8EA" VALUE 0x0806D2D8 RL_FNC_UWORD 0 CM_RAW 0 65535 /end CHARACTERISTIC
/begin CHARACTERISTIC CAL_8EB "значение #8EB" VALUE 0x08070372 RL_FNC_UWORD 0 CM_RAW 0 65535 /end CHARACTERISTIC
/begin CHARACTERISTIC CAL_8EC "значение #8EC" VALUE 0x08070734 RL_FNC_UWORD 0 CM_RAW 0 65535 /end CHARACTERISTIC
/begin CHARACTERISTIC CAL_8F1 "значение #8F1" VALUE 0x08074A09 RL_FNC_SBYTE 0 CM_RAW -128 127 /end CHARACTERISTIC
/begin CHARACTERISTIC CAL_8F2 "значение #8F2" VALUE 0x08066D99 RL_FNC_SBYTE 0 CM_RAW -128 127 /end CHARACTERISTIC
/begin CHARACTERISTIC CAL_8F3 "значение #8F3" VALUE 0x08066D9A RL_FNC_UWORD 0 CM_RAW 0 65535 /end CHARACTERISTIC
/begin CHARACTERISTIC CAL_8F4 "массив #8F4" VAL_BLK 0x08066D9C RL_FNC_SBYTE 0 CM_RAW -128 127 MATRIX_DIM 2 1 1 /end CHARACTERISTIC
/begin CHARACTERISTIC CAL_8F5 "значение #8F5" VALUE 0x08066D9E RL_FNC_UWORD 0 CM_RAW 0 65535 /end CHARACTERISTIC
/begin CHARACTERISTIC CAL_8FB "значение #8FB" VALUE 0x0807036C RL_FNC_SWORD 0 CM_RAW -32768 32767 /end CHARACTERISTIC
/begin CHARACTERISTIC CAL_8FC "массив #8FC" VAL_BLK 0x0806B4F8 RL_FNC_UWORD 0 CM_RAW 0 65535 MATRIX_DIM 2 1 1 /end CHARACTERISTIC
/begin CHARACTERISTIC CAL_8FD "значение #8FD" VALUE 0x08074A06 RL_FNC_SBYTE 0 CM_RAW -128 127 /end CHARACTERISTIC
/begin CHARACTERISTIC CAL_8FE "значение #8FE" VALUE 0x08074A07 RL_FNC_SBYTE 0 CM_RAW -128 127 /end CHARACTERISTIC
/begin CHARACTERISTIC CAL_8FF "массив #8FF" VAL_BLK 0x08068284 RL_FNC_SBYTE 0 CM_RAW -128 127 MATRIX_DIM 4 1 1 /end CHARACTERISTIC
/begin CHARACTERISTIC CAL_900 "массив #900" VAL_BLK 0x08068F88 RL_FNC_SBYTE 0 CM_RAW -128 127 MATRIX_DIM 4 1 1 /end CHARACTERISTIC
/begin CHARACTERISTIC CAL_901 "значение #901" VALUE 0x0806EAE0 RL_FNC_UWORD 0 CM_RAW 0 65535 /end CHARACTERISTIC
/begin CHARACTERISTIC CAL_902 "значение #902" VALUE 0x0806EADC RL_FNC_SLONG 0 CM_RAW -2.14748e+09 2.14748e+09 /end CHARACTERISTIC
/begin CHARACTERISTIC CAL_903 "кривая #903 9: N" CURVE 0x0807105C RL_FNC_UWORD 0 CM_RAW 0 65535
 /begin AXIS_DESCR COM_AXIS AXIN_0AD_N CM_RPM2 9 0 32767.5 AXIS_PTS_REF AX_0AD_N /end AXIS_DESCR
/end CHARACTERISTIC
/begin CHARACTERISTIC CAL_904_0 "кривая #904 17: N [1/2]" CURVE 0x08071EAC RL_FNC_UWORD 0 CM_RAW 0 65535
 /begin AXIS_DESCR COM_AXIS AXIN_001_N CM_RPM2 17 0 32767.5 AXIS_PTS_REF AX_001_N /end AXIS_DESCR
/end CHARACTERISTIC
/begin CHARACTERISTIC CAL_904_1 "кривая #904 17: N [2/2]" CURVE 0x08071ECE RL_FNC_UWORD 0 CM_RAW 0 65535
 /begin AXIS_DESCR COM_AXIS AXIN_001_N CM_RPM2 17 0 32767.5 AXIS_PTS_REF AX_001_N /end AXIS_DESCR
/end CHARACTERISTIC
/begin CHARACTERISTIC CAL_905 "кривая #905 9: N" CURVE 0x08071048 RL_FNC_UWORD 0 CM_RAW 0 65535
 /begin AXIS_DESCR COM_AXIS AXIN_0AD_N CM_RPM2 9 0 32767.5 AXIS_PTS_REF AX_0AD_N /end AXIS_DESCR
/end CHARACTERISTIC
/begin CHARACTERISTIC CAL_906_0 "кривая #906 17: N [1/2]" CURVE 0x08071E68 RL_FNC_UWORD 0 CM_RAW 0 65535
 /begin AXIS_DESCR COM_AXIS AXIN_001_N CM_RPM2 17 0 32767.5 AXIS_PTS_REF AX_001_N /end AXIS_DESCR
/end CHARACTERISTIC
/begin CHARACTERISTIC CAL_906_1 "кривая #906 17: N [2/2]" CURVE 0x08071E8A RL_FNC_UWORD 0 CM_RAW 0 65535
 /begin AXIS_DESCR COM_AXIS AXIN_001_N CM_RPM2 17 0 32767.5 AXIS_PTS_REF AX_001_N /end AXIS_DESCR
/end CHARACTERISTIC
/begin CHARACTERISTIC CAL_907 "массив #907" VAL_BLK 0x08065BC4 RL_FNC_UWORD 0 CM_RAW 0 65535 MATRIX_DIM 2 1 1 /end CHARACTERISTIC
/begin CHARACTERISTIC CAL_908 "массив #908" VAL_BLK 0x08065BC0 RL_FNC_UWORD 0 CM_RAW 0 65535 MATRIX_DIM 2 1 1 /end CHARACTERISTIC
/begin CHARACTERISTIC CAL_909 "массив #909" VAL_BLK 0x08073948 RL_FNC_UWORD 0 CM_RAW 0 65535 MATRIX_DIM 2 1 1 /end CHARACTERISTIC
/begin CHARACTERISTIC CAL_90A "массив #90A" VAL_BLK 0x0806BC58 RL_FNC_UWORD 0 CM_RAW 0 65535 MATRIX_DIM 2 1 1 /end CHARACTERISTIC
/begin CHARACTERISTIC CAL_90B "массив #90B" VAL_BLK 0x0806BC50 RL_FNC_UWORD 0 CM_RAW 0 65535 MATRIX_DIM 2 1 1 /end CHARACTERISTIC
/begin CHARACTERISTIC CAL_90C "массив #90C" VAL_BLK 0x0806BC54 RL_FNC_UWORD 0 CM_RAW 0 65535 MATRIX_DIM 2 1 1 /end CHARACTERISTIC
/begin CHARACTERISTIC CAL_90D "значение #90D" VALUE 0x08073940 RL_FNC_SWORD 0 CM_RAW -32768 32767 /end CHARACTERISTIC
/begin CHARACTERISTIC CAL_90E "значение #90E" VALUE 0x08064434 RL_FNC_UWORD 0 CM_RAW 0 65535 /end CHARACTERISTIC
/begin CHARACTERISTIC CAL_90F "значение #90F" VALUE 0x08066DA0 RL_FNC_UWORD 0 CM_RAW 0 65535 /end CHARACTERISTIC
/begin CHARACTERISTIC CAL_911 "значение #911" VALUE 0x0806621C RL_FNC_SBYTE 0 CM_RAW -128 127 /end CHARACTERISTIC
/begin CHARACTERISTIC CAL_912 "значение #912" VALUE 0x08068F74 RL_FNC_SBYTE 0 CM_RAW -128 127 /end CHARACTERISTIC
/begin CHARACTERISTIC CAL_913 "значение #913" VALUE 0x08068F8C RL_FNC_UWORD 0 CM_RAW 0 65535 /end CHARACTERISTIC
/begin CHARACTERISTIC CAL_914 "кривая #914 14: UBAT" CURVE 0x08068054 RL_FNC_SWORD 0 CM_RAW -32768 32767
 /begin AXIS_DESCR COM_AXIS AXIN_003_UBAT CM_RAW 14 0 65535 AXIS_PTS_REF AX_003_UBAT /end AXIS_DESCR
/end CHARACTERISTIC
/begin CHARACTERISTIC CAL_915 "кривая #915 14: UBAT" CURVE 0x08068070 RL_FNC_SWORD 0 CM_RAW -32768 32767
 /begin AXIS_DESCR COM_AXIS AXIN_003_UBAT CM_RAW 14 0 65535 AXIS_PTS_REF AX_003_UBAT /end AXIS_DESCR
/end CHARACTERISTIC
/begin CHARACTERISTIC CAL_916 "кривая #916 14: UBAT" CURVE 0x08068110 RL_FNC_SWORD 0 CM_RAW -32768 32767
 /begin AXIS_DESCR COM_AXIS AXIN_003_UBAT CM_RAW 14 0 65535 AXIS_PTS_REF AX_003_UBAT /end AXIS_DESCR
/end CHARACTERISTIC
/begin CHARACTERISTIC CAL_917 "кривая #917 14: UBAT" CURVE 0x0806812C RL_FNC_SWORD 0 CM_RAW -32768 32767
 /begin AXIS_DESCR COM_AXIS AXIN_003_UBAT CM_RAW 14 0 65535 AXIS_PTS_REF AX_003_UBAT /end AXIS_DESCR
/end CHARACTERISTIC
/begin CHARACTERISTIC CAL_918 "кривая #918 14: UBAT" CURVE 0x08068148 RL_FNC_SWORD 0 CM_RAW -32768 32767
 /begin AXIS_DESCR COM_AXIS AXIN_003_UBAT CM_RAW 14 0 65535 AXIS_PTS_REF AX_003_UBAT /end AXIS_DESCR
/end CHARACTERISTIC
/begin CHARACTERISTIC CAL_919 "кривая #919 14: UBAT" CURVE 0x0806808C RL_FNC_SWORD 0 CM_RAW -32768 32767
 /begin AXIS_DESCR COM_AXIS AXIN_003_UBAT CM_RAW 14 0 65535 AXIS_PTS_REF AX_003_UBAT /end AXIS_DESCR
/end CHARACTERISTIC
/begin CHARACTERISTIC CAL_91A "кривая #91A 14: UBAT" CURVE 0x08068164 RL_FNC_SWORD 0 CM_RAW -32768 32767
 /begin AXIS_DESCR COM_AXIS AXIN_003_UBAT CM_RAW 14 0 65535 AXIS_PTS_REF AX_003_UBAT /end AXIS_DESCR
/end CHARACTERISTIC
/begin CHARACTERISTIC CAL_91B "кривая #91B 14: UBAT" CURVE 0x08068180 RL_FNC_SWORD 0 CM_RAW -32768 32767
 /begin AXIS_DESCR COM_AXIS AXIN_003_UBAT CM_RAW 14 0 65535 AXIS_PTS_REF AX_003_UBAT /end AXIS_DESCR
/end CHARACTERISTIC
/begin CHARACTERISTIC CAL_91C "кривая #91C 14: UBAT" CURVE 0x0806819C RL_FNC_SWORD 0 CM_RAW -32768 32767
 /begin AXIS_DESCR COM_AXIS AXIN_003_UBAT CM_RAW 14 0 65535 AXIS_PTS_REF AX_003_UBAT /end AXIS_DESCR
/end CHARACTERISTIC
/begin CHARACTERISTIC CAL_91D "кривая #91D 14: UBAT" CURVE 0x080681B8 RL_FNC_SWORD 0 CM_RAW -32768 32767
 /begin AXIS_DESCR COM_AXIS AXIN_003_UBAT CM_RAW 14 0 65535 AXIS_PTS_REF AX_003_UBAT /end AXIS_DESCR
/end CHARACTERISTIC
/begin CHARACTERISTIC CAL_91E "значение #91E" VALUE 0x080624EE RL_FNC_UWORD 0 CM_RAW 0 65535 /end CHARACTERISTIC
/begin CHARACTERISTIC CAL_91F "значение #91F" VALUE 0x08064430 RL_FNC_SWORD 0 CM_RAW -32768 32767 /end CHARACTERISTIC
/begin CHARACTERISTIC CAL_920 "значение #920" VALUE 0x0806E7CA RL_FNC_SBYTE 0 CM_RAW -128 127 /end CHARACTERISTIC
/begin CHARACTERISTIC CAL_921 "значение #921" VALUE 0x08064438 RL_FNC_UWORD 0 CM_RAW 0 65535 /end CHARACTERISTIC
/begin CHARACTERISTIC CAL_922 "значение #922" VALUE 0x0806443A RL_FNC_UWORD 0 CM_RAW 0 65535 /end CHARACTERISTIC
/begin CHARACTERISTIC CAL_923 "значение #923" VALUE 0x08064436 RL_FNC_UWORD 0 CM_RAW 0 65535 /end CHARACTERISTIC
/begin CHARACTERISTIC CAL_924 "значение #924" VALUE 0x0806443C RL_FNC_SWORD 0 CM_RAW -32768 32767 /end CHARACTERISTIC
/begin CHARACTERISTIC CAL_925 "значение #925" VALUE 0x08066DA8 RL_FNC_SWORD 0 CM_RAW -32768 32767 /end CHARACTERISTIC
/begin CHARACTERISTIC CAL_926 "значение #926" VALUE 0x08066DA4 RL_FNC_UWORD 0 CM_RAW 0 65535 /end CHARACTERISTIC
/begin CHARACTERISTIC CAL_927 "значение #927" VALUE 0x08066DA6 RL_FNC_UWORD 0 CM_RAW 0 65535 /end CHARACTERISTIC
/begin CHARACTERISTIC CAL_928 "значение #928" VALUE 0x08066DA2 RL_FNC_UWORD 0 CM_RAW 0 65535 /end CHARACTERISTIC
/begin CHARACTERISTIC CAL_929 "массив #929" VAL_BLK 0x0806AA30 RL_FNC_UWORD 0 CM_RAW 0 65535 MATRIX_DIM 2 1 1 /end CHARACTERISTIC
/begin CHARACTERISTIC CAL_92A "значение #92A" VALUE 0x0806AA2E RL_FNC_UWORD 0 CM_RAW 0 65535 /end CHARACTERISTIC
/begin CHARACTERISTIC CAL_92B "значение #92B" VALUE 0x0806A866 RL_FNC_UWORD 0 CM_RAW 0 65535 /end CHARACTERISTIC
/begin CHARACTERISTIC CAL_92C "значение #92C" VALUE 0x0806A86A RL_FNC_SWORD 0 CM_RAW -32768 32767 /end CHARACTERISTIC
/begin CHARACTERISTIC CAL_92D_0 "кривая #92D 17: N [1/2]" CURVE 0x0806A874 RL_FNC_UWORD 0 CM_RAW 0 65535
 /begin AXIS_DESCR COM_AXIS AXIN_001_N CM_RPM2 17 0 32767.5 AXIS_PTS_REF AX_001_N /end AXIS_DESCR
/end CHARACTERISTIC
/begin CHARACTERISTIC CAL_92D_1 "кривая #92D 17: N [2/2]" CURVE 0x0806A896 RL_FNC_UWORD 0 CM_RAW 0 65535
 /begin AXIS_DESCR COM_AXIS AXIN_001_N CM_RPM2 17 0 32767.5 AXIS_PTS_REF AX_001_N /end AXIS_DESCR
/end CHARACTERISTIC
/begin CHARACTERISTIC CAL_92E "массив #92E" VAL_BLK 0x0806A984 RL_FNC_UWORD 0 CM_RAW 0 65535 MATRIX_DIM 2 1 1 /end CHARACTERISTIC
/begin CHARACTERISTIC CAL_92F "значение #92F" VALUE 0x0806A98A RL_FNC_UWORD 0 CM_RAW 0 65535 /end CHARACTERISTIC
/begin CHARACTERISTIC CAL_930 "значение #930" VALUE 0x0806AA36 RL_FNC_UWORD 0 CM_RAW 0 65535 /end CHARACTERISTIC
/begin CHARACTERISTIC CAL_931 "значение #931" VALUE 0x0806AA34 RL_FNC_UWORD 0 CM_RAW 0 65535 /end CHARACTERISTIC
/begin CHARACTERISTIC CAL_932 "значение #932" VALUE 0x0806A988 RL_FNC_UWORD 0 CM_RAW 0 65535 /end CHARACTERISTIC
/begin CHARACTERISTIC CAL_935 "массив #935" VAL_BLK 0x0806A870 RL_FNC_UWORD 0 CM_RAW 0 65535 MATRIX_DIM 2 1 1 /end CHARACTERISTIC
/begin CHARACTERISTIC CAL_936 "массив #936" VAL_BLK 0x0806A8B8 RL_FNC_SBYTE 0 CM_RAW -128 127 MATRIX_DIM 2 1 1 /end CHARACTERISTIC
/begin CHARACTERISTIC CAL_937 "карта #937 10x10: N × LOAD" MAP 0x0806A8BC RL_FNC_UWORD 0 CM_RAW 0 65535
 /begin AXIS_DESCR COM_AXIS AXIN_00C_N CM_RPM2 10 0 32767.5 AXIS_PTS_REF AX_00C_N /end AXIS_DESCR
 /begin AXIS_DESCR COM_AXIS AXIN_01E_LOAD CM_RAW 10 0 65535 AXIS_PTS_REF AX_01E_LOAD /end AXIS_DESCR
/end CHARACTERISTIC
/begin CHARACTERISTIC CAL_938 "карта #938 5x9: ? × ?" MAP 0x0806A9D0 RL_FNC_SBYTE 0 CM_RAW -128 127 /begin AXIS_DESCR COM_AXIS AXIN_070 CM_RAW 9 -128 127 AXIS_PTS_REF AX_070 /end AXIS_DESCR /begin AXIS_DESCR COM_AXIS AXIN_0F9 CM_RAW 5 -128 127 AXIS_PTS_REF AX_0F9 /end AXIS_DESCR /end CHARACTERISTIC
/begin CHARACTERISTIC CAL_939 "карта #939 5x9: ? × ?" MAP 0x0806AA00 RL_FNC_SBYTE 0 CM_RAW -128 127 /begin AXIS_DESCR COM_AXIS AXIN_070 CM_RAW 9 -128 127 AXIS_PTS_REF AX_070 /end AXIS_DESCR /begin AXIS_DESCR COM_AXIS AXIN_0F9 CM_RAW 5 -128 127 AXIS_PTS_REF AX_0F9 /end AXIS_DESCR /end CHARACTERISTIC
/begin CHARACTERISTIC CAL_93A "карта #93A 5x6: ? × ?" MAP 0x0806A990 RL_FNC_SBYTE 0 CM_RAW -128 127 /begin AXIS_DESCR COM_AXIS AXIN_071 CM_RAW 6 -128 127 AXIS_PTS_REF AX_071 /end AXIS_DESCR /begin AXIS_DESCR COM_AXIS AXIN_0F9 CM_RAW 5 -128 127 AXIS_PTS_REF AX_0F9 /end AXIS_DESCR /end CHARACTERISTIC
/begin CHARACTERISTIC CAL_93B "карта #93B 5x6: ? × ?" MAP 0x0806A9B0 RL_FNC_SBYTE 0 CM_RAW -128 127 /begin AXIS_DESCR COM_AXIS AXIN_071 CM_RAW 6 -128 127 AXIS_PTS_REF AX_071 /end AXIS_DESCR /begin AXIS_DESCR COM_AXIS AXIN_0F9 CM_RAW 5 -128 127 AXIS_PTS_REF AX_0F9 /end AXIS_DESCR /end CHARACTERISTIC
/begin CHARACTERISTIC CAL_93C "значение #93C" VALUE 0x0806A98C RL_FNC_UWORD 0 CM_RAW 0 65535 /end CHARACTERISTIC
/begin CHARACTERISTIC CAL_93D "значение #93D" VALUE 0x0806A98E RL_FNC_UWORD 0 CM_RAW 0 65535 /end CHARACTERISTIC
/begin CHARACTERISTIC CAL_940 "значение #940" VALUE 0x0806556E RL_FNC_SWORD 0 CM_RAW -32768 32767 /end CHARACTERISTIC
/begin CHARACTERISTIC CAL_941 "значение #941" VALUE 0x08065570 RL_FNC_SWORD 0 CM_RAW -32768 32767 /end CHARACTERISTIC
/begin CHARACTERISTIC CAL_942 "значение #942" VALUE 0x08065572 RL_FNC_SWORD 0 CM_RAW -32768 32767 /end CHARACTERISTIC
/begin CHARACTERISTIC CAL_943 "массив #943" VAL_BLK 0x080691F0 RL_FNC_UWORD 0 CM_RAW 0 65535 MATRIX_DIM 2 1 1 /end CHARACTERISTIC
/begin CHARACTERISTIC CAL_944 "массив #944" VAL_BLK 0x080691F4 RL_FNC_UWORD 0 CM_RAW 0 65535 MATRIX_DIM 2 1 1 /end CHARACTERISTIC
/begin CHARACTERISTIC CAL_945 "значение #945" VALUE 0x08065416 RL_FNC_SWORD 0 CM_RAW -32768 32767 /end CHARACTERISTIC
/begin CHARACTERISTIC CAL_948 "значение #948" VALUE 0x0806E7C8 RL_FNC_SWORD 0 CM_RAW -32768 32767 /end CHARACTERISTIC
/begin CHARACTERISTIC CAL_949 "значение #949" VALUE 0x0806A868 RL_FNC_SWORD 0 CM_RAW -32768 32767 /end CHARACTERISTIC
/begin CHARACTERISTIC CAL_94B "значение #94B" VALUE 0x0807031C RL_FNC_SWORD 0 CM_RAW -32768 32767 /end CHARACTERISTIC
/begin CHARACTERISTIC CAL_94C "значение #94C" VALUE 0x080690CC RL_FNC_UWORD 0 CM_RAW 0 65535 /end CHARACTERISTIC
/begin CHARACTERISTIC CAL_94D "карта #94D 6x15: ? × ?" MAP 0x08074788 RL_FNC_SWORD 0 CM_RAW -32768 32767
 /begin AXIS_DESCR COM_AXIS AXIN_0FD CM_RAW 15 -32768 32767 AXIS_PTS_REF AX_0FD /end AXIS_DESCR
 /begin AXIS_DESCR COM_AXIS AXIN_0FB CM_RAW 6 0 65535 AXIS_PTS_REF AX_0FB /end AXIS_DESCR
/end CHARACTERISTIC
/begin CHARACTERISTIC CAL_94E_0 "кривая #94E 16: ? [1/2]" CURVE 0x0807483C RL_FNC_SWORD 0 CM_RAW -32768 32767 /begin AXIS_DESCR COM_AXIS AXIN_0FC CM_RAW 16 0 65535 AXIS_PTS_REF AX_0FC /end AXIS_DESCR /end CHARACTERISTIC
/begin CHARACTERISTIC CAL_94E_1 "кривая #94E 16: ? [2/2]" CURVE 0x0807485C RL_FNC_SWORD 0 CM_RAW -32768 32767 /begin AXIS_DESCR COM_AXIS AXIN_0FC CM_RAW 16 0 65535 AXIS_PTS_REF AX_0FC /end AXIS_DESCR /end CHARACTERISTIC
/begin CHARACTERISTIC CAL_94F "карта #94F 16x6: ? × ?" MAP 0x08074274 RL_FNC_UWORD 0 CM_RAW 0 65535 /begin AXIS_DESCR COM_AXIS AXIN_0FB CM_RAW 6 0 65535 AXIS_PTS_REF AX_0FB /end AXIS_DESCR /begin AXIS_DESCR COM_AXIS AXIN_0FC CM_RAW 16 0 65535 AXIS_PTS_REF AX_0FC /end AXIS_DESCR /end CHARACTERISTIC
/begin CHARACTERISTIC CAL_950 "кривая #950 16: ?" CURVE 0x08074748 RL_FNC_UWORD 0 CM_RAW 0 65535 /begin AXIS_DESCR COM_AXIS AXIN_0FC CM_RAW 16 0 65535 AXIS_PTS_REF AX_0FC /end AXIS_DESCR /end CHARACTERISTIC
/begin CHARACTERISTIC CAL_951 "кривая #951 16: ?" CURVE 0x08074768 RL_FNC_UWORD 0 CM_RAW 0 65535 /begin AXIS_DESCR COM_AXIS AXIN_0FC CM_RAW 16 0 65535 AXIS_PTS_REF AX_0FC /end AXIS_DESCR /end CHARACTERISTIC
/begin CHARACTERISTIC CAL_952 "кривая #952 16: ?" CURVE 0x08074234 RL_FNC_UWORD 0 CM_RAW 0 65535 /begin AXIS_DESCR COM_AXIS AXIN_0FC CM_RAW 16 0 65535 AXIS_PTS_REF AX_0FC /end AXIS_DESCR /end CHARACTERISTIC
/begin CHARACTERISTIC CAL_953 "кривая #953 16: ?" CURVE 0x08074254 RL_FNC_UWORD 0 CM_RAW 0 65535 /begin AXIS_DESCR COM_AXIS AXIN_0FC CM_RAW 16 0 65535 AXIS_PTS_REF AX_0FC /end AXIS_DESCR /end CHARACTERISTIC
/begin CHARACTERISTIC CAL_954 "кривая #954 16: ?" CURVE 0x080741F4 RL_FNC_UWORD 0 CM_RAW 0 65535 /begin AXIS_DESCR COM_AXIS AXIN_0FC CM_RAW 16 0 65535 AXIS_PTS_REF AX_0FC /end AXIS_DESCR /end CHARACTERISTIC
/begin CHARACTERISTIC CAL_955 "кривая #955 16: ?" CURVE 0x08074214 RL_FNC_UWORD 0 CM_RAW 0 65535 /begin AXIS_DESCR COM_AXIS AXIN_0FC CM_RAW 16 0 65535 AXIS_PTS_REF AX_0FC /end AXIS_DESCR /end CHARACTERISTIC
/begin CHARACTERISTIC CAL_956 "значение #956" VALUE 0x080741F0 RL_FNC_SBYTE 0 CM_RAW -128 127 /end CHARACTERISTIC
/begin CHARACTERISTIC CAL_957 "значение #957" VALUE 0x08074A08 RL_FNC_SBYTE 0 CM_RAW -128 127 /end CHARACTERISTIC
/begin CHARACTERISTIC CAL_958 "значение #958" VALUE 0x080632DD RL_FNC_SBYTE 0 CM_RAW -128 127 /end CHARACTERISTIC
/begin CHARACTERISTIC CAL_959 "кривая #959 8: N" CURVE 0x080706C4 RL_FNC_UWORD 0 CM_RAW 0 65535
 /begin AXIS_DESCR COM_AXIS AXIN_050_N CM_RPM2 8 0 32767.5 AXIS_PTS_REF AX_050_N /end AXIS_DESCR
/end CHARACTERISTIC
/begin CHARACTERISTIC CAL_95A "кривая #95A 8: TAIR" CURVE 0x08068498 RL_FNC_UWORD 0 CM_RAW 0 65535
 /begin AXIS_DESCR COM_AXIS AXIN_049_TAIR CM_C128 8 -256 255.992 AXIS_PTS_REF AX_049_TAIR /end AXIS_DESCR
/end CHARACTERISTIC
/begin CHARACTERISTIC CAL_95B "значение #95B" VALUE 0x08066DEA RL_FNC_SWORD 0 CM_RAW -32768 32767 /end CHARACTERISTIC
/begin CHARACTERISTIC CAL_95C "значение #95C" VALUE 0x08066DEC RL_FNC_UWORD 0 CM_RAW 0 65535 /end CHARACTERISTIC
/begin CHARACTERISTIC CAL_95D "значение #95D" VALUE 0x08066DEE RL_FNC_UWORD 0 CM_RAW 0 65535 /end CHARACTERISTIC
/begin CHARACTERISTIC CAL_95E "значение #95E" VALUE 0x08066DF0 RL_FNC_UWORD 0 CM_RAW 0 65535 /end CHARACTERISTIC
/begin CHARACTERISTIC CAL_95F "значение #95F" VALUE 0x08066DF2 RL_FNC_UWORD 0 CM_RAW 0 65535 /end CHARACTERISTIC
/begin CHARACTERISTIC CAL_960 "значение #960" VALUE 0x08066DE6 RL_FNC_UWORD 0 CM_RAW 0 65535 /end CHARACTERISTIC
/begin CHARACTERISTIC CAL_961 "значение #961" VALUE 0x08066DE8 RL_FNC_UWORD 0 CM_RAW 0 65535 /end CHARACTERISTIC
/begin CHARACTERISTIC CAL_962 "кривая #962 9: TCOOL" CURVE 0x0807495C RL_FNC_UWORD 0 CM_RAW 0 65535
 /begin AXIS_DESCR COM_AXIS AXIN_00A_TCOOL CM_C128 9 -256 255.992 AXIS_PTS_REF AX_00A_TCOOL /end AXIS_DESCR
/end CHARACTERISTIC
/begin CHARACTERISTIC CAL_963 "кривая #963 17: N" CURVE 0x08066314 RL_FNC_UWORD 0 CM_RAW 0 65535
 /begin AXIS_DESCR COM_AXIS AXIN_001_N CM_RPM2 17 0 32767.5 AXIS_PTS_REF AX_001_N /end AXIS_DESCR
/end CHARACTERISTIC
/begin CHARACTERISTIC CAL_964 "значение #964" VALUE 0x080703B8 RL_FNC_UWORD 0 CM_RAW 0 65535 /end CHARACTERISTIC
/begin CHARACTERISTIC CAL_965 "значение #965" VALUE 0x080653F0 RL_FNC_UWORD 0 CM_RAW 0 65535 /end CHARACTERISTIC
/begin CHARACTERISTIC CAL_966 "значение #966" VALUE 0x08070370 RL_FNC_UWORD 0 CM_RAW 0 65535 /end CHARACTERISTIC
/begin CHARACTERISTIC CAL_967 "значение #967" VALUE 0x080749F0 RL_FNC_SBYTE 0 CM_RAW -128 127 /end CHARACTERISTIC
/begin CHARACTERISTIC CAL_968 "значение #968" VALUE 0x08065395 RL_FNC_SBYTE 0 CM_RAW -128 127 /end CHARACTERISTIC
/begin CHARACTERISTIC CAL_969 "значение #969" VALUE 0x08065396 RL_FNC_SBYTE 0 CM_RAW -128 127 /end CHARACTERISTIC
/begin CHARACTERISTIC CAL_96A "значение #96A" VALUE 0x08063DEC RL_FNC_UWORD 0 CM_RAW 0 65535 /end CHARACTERISTIC
/begin CHARACTERISTIC CAL_96B "массив #96B" VAL_BLK 0x08063DF0 RL_FNC_UWORD 0 CM_RAW 0 65535 MATRIX_DIM 2 1 1 /end CHARACTERISTIC
/begin CHARACTERISTIC CAL_96C "значение #96C" VALUE 0x08063DF8 RL_FNC_UWORD 0 CM_RAW 0 65535 /end CHARACTERISTIC
/begin CHARACTERISTIC CAL_96D "значение #96D" VALUE 0x08063378 RL_FNC_UWORD 0 CM_RAW 0 65535 /end CHARACTERISTIC
/begin CHARACTERISTIC CAL_96E "значение #96E" VALUE 0x08063C22 RL_FNC_UWORD 0 CM_RAW 0 65535 /end CHARACTERISTIC
/begin CHARACTERISTIC CAL_96F "значение #96F" VALUE 0x08063DEA RL_FNC_UWORD 0 CM_RAW 0 65535 /end CHARACTERISTIC
/begin CHARACTERISTIC CAL_970 "значение #970" VALUE 0x08063E06 RL_FNC_UWORD 0 CM_RAW 0 65535 /end CHARACTERISTIC
/begin CHARACTERISTIC CAL_971 "значение #971" VALUE 0x08063E08 RL_FNC_UWORD 0 CM_RAW 0 65535 /end CHARACTERISTIC
/begin CHARACTERISTIC CAL_972 "значение #972" VALUE 0x080633BC RL_FNC_SBYTE 0 CM_RAW -128 127 /end CHARACTERISTIC
/begin CHARACTERISTIC CRUISE_SUPPORT "признак поддержки круиза [?, флаг]" VAL_BLK 0x08063BE8 RL_FNC_SBYTE 0 CM_RAW -128 127 MATRIX_DIM 2 1 1 /end CHARACTERISTIC
/begin CHARACTERISTIC CRUISE_BTN_WIN_4A "кнопки круиза: окно [мин, макс] АЦП x4" VAL_BLK 0x08063D04 RL_FNC_UWORD 0 CM_RAW 0 65535 MATRIX_DIM 2 1 1 /end CHARACTERISTIC
/begin CHARACTERISTIC CRUISE_BTN_WIN_4B "кнопки круиза: окно [мин, макс] АЦП x4" VAL_BLK 0x08063D08 RL_FNC_UWORD 0 CM_RAW 0 65535 MATRIX_DIM 2 1 1 /end CHARACTERISTIC
/begin CHARACTERISTIC CAL_976 "значение #976" VALUE 0x08074972 RL_FNC_UWORD 0 CM_RAW 0 65535 /end CHARACTERISTIC
/begin CHARACTERISTIC CAL_977 "значение #977" VALUE 0x08065393 RL_FNC_SBYTE 0 CM_RAW -128 127 /end CHARACTERISTIC
/begin CHARACTERISTIC CAL_978 "значение #978" VALUE 0x0806538C RL_FNC_SBYTE 0 CM_RAW -128 127 /end CHARACTERISTIC
/begin CHARACTERISTIC CAL_979 "значение #979" VALUE 0x08065394 RL_FNC_SBYTE 0 CM_RAW -128 127 /end CHARACTERISTIC
/begin CHARACTERISTIC CAL_97A "значение #97A" VALUE 0x08063BE4 RL_FNC_UWORD 0 CM_RAW 0 65535 /end CHARACTERISTIC
/begin CHARACTERISTIC CAL_97C "кривая #97C 17: N" CURVE 0x080682A4 RL_FNC_UWORD 0 CM_RAW 0 65535
 /begin AXIS_DESCR COM_AXIS AXIN_001_N CM_RPM2 17 0 32767.5 AXIS_PTS_REF AX_001_N /end AXIS_DESCR
/end CHARACTERISTIC
/begin CHARACTERISTIC CAL_97D "кривая #97D 8: N" CURVE 0x080702F4 RL_FNC_SBYTE 0 CM_RAW -128 127
 /begin AXIS_DESCR COM_AXIS AXIN_050_N CM_RPM2 8 0 32767.5 AXIS_PTS_REF AX_050_N /end AXIS_DESCR
/end CHARACTERISTIC
/begin CHARACTERISTIC CAL_97E "значение #97E" VALUE 0x080690CE RL_FNC_SBYTE 0 CM_RAW -128 127 /end CHARACTERISTIC
/begin CHARACTERISTIC CAL_97F "значение #97F" VALUE 0x08074970 RL_FNC_SBYTE 0 CM_RAW -128 127 /end CHARACTERISTIC
/begin CHARACTERISTIC CAL_980 "массив #980" VAL_BLK 0x08063304 RL_FNC_UWORD 0 CM_RAW 0 65535 MATRIX_DIM 2 1 1 /end CHARACTERISTIC
/begin CHARACTERISTIC CAL_981 "значение #981" VALUE 0x08063D7A RL_FNC_UWORD 0 CM_RAW 0 65535 /end CHARACTERISTIC
/begin CHARACTERISTIC CAL_982 "значение #982" VALUE 0x08063C20 RL_FNC_UWORD 0 CM_RAW 0 65535 /end CHARACTERISTIC
/begin CHARACTERISTIC CAL_983 "значение #983" VALUE 0x08063DE8 RL_FNC_UWORD 0 CM_RAW 0 65535 /end CHARACTERISTIC
/begin CHARACTERISTIC CAL_984 "значение #984" VALUE 0x08063DF6 RL_FNC_UWORD 0 CM_RAW 0 65535 /end CHARACTERISTIC
/begin CHARACTERISTIC CAL_985 "значение #985" VALUE 0x0806A86C RL_FNC_UWORD 0 CM_RAW 0 65535 /end CHARACTERISTIC
/begin CHARACTERISTIC CAL_987 "значение #987" VALUE 0x08073942 RL_FNC_UWORD 0 CM_RAW 0 65535 /end CHARACTERISTIC
/begin CHARACTERISTIC CAL_988 "значение #988" VALUE 0x08070732 RL_FNC_UWORD 0 CM_RAW 0 65535 /end CHARACTERISTIC
/begin CHARACTERISTIC CAL_989 "значение #989" VALUE 0x0806D138 RL_FNC_UWORD 0 CM_RAW 0 65535 /end CHARACTERISTIC
/begin CHARACTERISTIC CAL_98A "значение #98A" VALUE 0x0806D27A RL_FNC_UWORD 0 CM_RAW 0 65535 /end CHARACTERISTIC
/begin CHARACTERISTIC CAL_98B "значение #98B" VALUE 0x0806D27E RL_FNC_UWORD 0 CM_RAW 0 65535 /end CHARACTERISTIC
/begin CHARACTERISTIC CAL_98C "значение #98C" VALUE 0x0806D109 RL_FNC_SBYTE 0 CM_RAW -128 127 /end CHARACTERISTIC
/begin CHARACTERISTIC CAL_98D "массив #98D" VAL_BLK 0x0806D280 RL_FNC_UWORD 0 CM_RAW 0 65535 MATRIX_DIM 2 1 1 /end CHARACTERISTIC
/begin CHARACTERISTIC CAL_98E "значение #98E" VALUE 0x0806D27C RL_FNC_UWORD 0 CM_RAW 0 65535 /end CHARACTERISTIC
/begin CHARACTERISTIC CAL_990_0 "кривая #990 10: N [1/2]" CURVE 0x08070278 RL_FNC_UWORD 0 CM_RAW 0 65535
 /begin AXIS_DESCR COM_AXIS AXIN_00C_N CM_RPM2 10 0 32767.5 AXIS_PTS_REF AX_00C_N /end AXIS_DESCR
/end CHARACTERISTIC
/begin CHARACTERISTIC CAL_990_1 "кривая #990 10: N [2/2]" CURVE 0x0807028C RL_FNC_UWORD 0 CM_RAW 0 65535
 /begin AXIS_DESCR COM_AXIS AXIN_00C_N CM_RPM2 10 0 32767.5 AXIS_PTS_REF AX_00C_N /end AXIS_DESCR
/end CHARACTERISTIC
/begin CHARACTERISTIC CAL_991_0 "кривая #991 11: ? [1/2]" CURVE 0x080657F8 RL_FNC_UWORD 0 CM_RAW 0 65535 /begin AXIS_DESCR COM_AXIS AXIN_08E CM_RAW 11 0 65535 AXIS_PTS_REF AX_08E /end AXIS_DESCR /end CHARACTERISTIC
/begin CHARACTERISTIC CAL_991_1 "кривая #991 11: ? [2/2]" CURVE 0x0806580E RL_FNC_UWORD 0 CM_RAW 0 65535 /begin AXIS_DESCR COM_AXIS AXIN_08E CM_RAW 11 0 65535 AXIS_PTS_REF AX_08E /end AXIS_DESCR /end CHARACTERISTIC
/begin CHARACTERISTIC CAL_992 "кривая #992 8: GEAR" CURVE 0x08062CD8 RL_FNC_UBYTE 0 CM_RAW 0 255
 /begin AXIS_DESCR COM_AXIS AXIN_05E_GEAR CM_RAW 8 -128 127 AXIS_PTS_REF AX_05E_GEAR /end AXIS_DESCR
/end CHARACTERISTIC
/begin CHARACTERISTIC CAL_994 "значение #994" VALUE 0x08074978 RL_FNC_SBYTE 0 CM_RAW -128 127 /end CHARACTERISTIC
/begin CHARACTERISTIC CAL_995 "значение #995" VALUE 0x08074976 RL_FNC_UWORD 0 CM_RAW 0 65535 /end CHARACTERISTIC
/begin CHARACTERISTIC CAL_996 "значение #996" VALUE 0x0806447E RL_FNC_UWORD 0 CM_RAW 0 65535 /end CHARACTERISTIC
/begin CHARACTERISTIC CAL_997 "значение #997" VALUE 0x0806447C RL_FNC_UWORD 0 CM_RAW 0 65535 /end CHARACTERISTIC
/begin CHARACTERISTIC CAL_998 "значение #998" VALUE 0x080633BA RL_FNC_SBYTE 0 CM_RAW -128 127 /end CHARACTERISTIC
/begin CHARACTERISTIC CAL_99A "значение #99A" VALUE 0x08066DD4 RL_FNC_UWORD 0 CM_RAW 0 65535 /end CHARACTERISTIC
/begin CHARACTERISTIC CAL_99B "массив #99B" VAL_BLK 0x0806A760 RL_FNC_UWORD 0 CM_RAW 0 65535 MATRIX_DIM 4 1 1 /end CHARACTERISTIC
/begin CHARACTERISTIC CAL_99C_0 "карта #99C 16x16: N × LOAD [1/4]" MAP 0x0806EDD8 RL_FNC_UWORD 0 CM_RAW 0 65535
 /begin AXIS_DESCR COM_AXIS AXIN_026_N CM_RPM2 16 0 32767.5 AXIS_PTS_REF AX_026_N /end AXIS_DESCR
 /begin AXIS_DESCR COM_AXIS AXIN_024_LOAD CM_RAW 16 0 65535 AXIS_PTS_REF AX_024_LOAD /end AXIS_DESCR
/end CHARACTERISTIC
/begin CHARACTERISTIC CAL_99C_1 "карта #99C 16x16: N × LOAD [2/4]" MAP 0x0806EFD8 RL_FNC_UWORD 0 CM_RAW 0 65535
 /begin AXIS_DESCR COM_AXIS AXIN_026_N CM_RPM2 16 0 32767.5 AXIS_PTS_REF AX_026_N /end AXIS_DESCR
 /begin AXIS_DESCR COM_AXIS AXIN_024_LOAD CM_RAW 16 0 65535 AXIS_PTS_REF AX_024_LOAD /end AXIS_DESCR
/end CHARACTERISTIC
/begin CHARACTERISTIC CAL_99C_2 "карта #99C 16x16: N × LOAD [3/4]" MAP 0x0806F1D8 RL_FNC_UWORD 0 CM_RAW 0 65535
 /begin AXIS_DESCR COM_AXIS AXIN_026_N CM_RPM2 16 0 32767.5 AXIS_PTS_REF AX_026_N /end AXIS_DESCR
 /begin AXIS_DESCR COM_AXIS AXIN_024_LOAD CM_RAW 16 0 65535 AXIS_PTS_REF AX_024_LOAD /end AXIS_DESCR
/end CHARACTERISTIC
/begin CHARACTERISTIC CAL_99C_3 "карта #99C 16x16: N × LOAD [4/4]" MAP 0x0806F3D8 RL_FNC_UWORD 0 CM_RAW 0 65535
 /begin AXIS_DESCR COM_AXIS AXIN_026_N CM_RPM2 16 0 32767.5 AXIS_PTS_REF AX_026_N /end AXIS_DESCR
 /begin AXIS_DESCR COM_AXIS AXIN_024_LOAD CM_RAW 16 0 65535 AXIS_PTS_REF AX_024_LOAD /end AXIS_DESCR
/end CHARACTERISTIC
/begin CHARACTERISTIC CAL_99D "значение #99D" VALUE 0x08074900 RL_FNC_SBYTE 0 CM_RAW -128 127 /end CHARACTERISTIC
/begin CHARACTERISTIC CAL_99E "кривая #99E 10: N" CURVE 0x0806C2D8 RL_FNC_UWORD 0 CM_RAW 0 65535
 /begin AXIS_DESCR COM_AXIS AXIN_00C_N CM_RPM2 10 0 32767.5 AXIS_PTS_REF AX_00C_N /end AXIS_DESCR
/end CHARACTERISTIC
/begin CHARACTERISTIC CAL_99F "значение #99F" VALUE 0x08063D78 RL_FNC_UWORD 0 CM_RAW 0 65535 /end CHARACTERISTIC
/begin CHARACTERISTIC CAL_9A0 "значение #9A0" VALUE 0x08062504 RL_FNC_UWORD 0 CM_RAW 0 65535 /end CHARACTERISTIC
/begin CHARACTERISTIC CAL_9A1 "массив #9A1" VAL_BLK 0x08062500 RL_FNC_UWORD 0 CM_RAW 0 65535 MATRIX_DIM 2 1 1 /end CHARACTERISTIC
/begin CHARACTERISTIC CAL_9A2 "значение #9A2" VALUE 0x080626A0 RL_FNC_UWORD 0 CM_RAW 0 65535 /end CHARACTERISTIC
/begin CHARACTERISTIC CAL_9A3 "значение #9A3" VALUE 0x080729AC RL_FNC_UWORD 0 CM_RAW 0 65535 /end CHARACTERISTIC
/begin CHARACTERISTIC CAL_9A4 "значение #9A4" VALUE 0x080748C5 RL_FNC_UBYTE 0 CM_RAW 0 255 /end CHARACTERISTIC
/begin CHARACTERISTIC CAL_9A5 "значение #9A5" VALUE 0x080748C4 RL_FNC_UBYTE 0 CM_RAW 0 255 /end CHARACTERISTIC
/begin CHARACTERISTIC CAL_9A6 "массив #9A6" VAL_BLK 0x08069068 RL_FNC_SWORD 0 CM_RAW -32768 32767 MATRIX_DIM 34 1 1 /end CHARACTERISTIC
/begin CHARACTERISTIC CAL_9A7 "массив #9A7" VAL_BLK 0x080690AC RL_FNC_SWORD 0 CM_RAW -32768 32767 MATRIX_DIM 2 1 1 /end CHARACTERISTIC
/begin CHARACTERISTIC CAL_9A9 "массив #9A9" VAL_BLK 0x0806E7D8 RL_FNC_SBYTE 0 CM_RAW -128 127 MATRIX_DIM 2 1 1 /end CHARACTERISTIC
/begin CHARACTERISTIC CAL_9AA "значение #9AA" VALUE 0x0806E7DA RL_FNC_SBYTE 0 CM_RAW -128 127 /end CHARACTERISTIC
/begin CHARACTERISTIC CAL_9AB "значение #9AB" VALUE 0x0807499C RL_FNC_SBYTE 0 CM_RAW -128 127 /end CHARACTERISTIC
/begin CHARACTERISTIC CAL_9AF "значение #9AF" VALUE 0x0806337A RL_FNC_SBYTE 0 CM_RAW -128 127 /end CHARACTERISTIC
/begin CHARACTERISTIC CAL_9B0 "карта #9B0 4x9: ? × ?" MAP 0x08063394 RL_FNC_SBYTE 0 CM_RAW -128 127 /begin AXIS_DESCR COM_AXIS AXIN_070 CM_RAW 9 -128 127 AXIS_PTS_REF AX_070 /end AXIS_DESCR /begin AXIS_DESCR COM_AXIS AXIN_100 CM_RAW 4 -128 127 AXIS_PTS_REF AX_100 /end AXIS_DESCR /end CHARACTERISTIC
/begin CHARACTERISTIC CAL_9B1 "карта #9B1 4x6: ? × ?" MAP 0x0806337C RL_FNC_SBYTE 0 CM_RAW -128 127 /begin AXIS_DESCR COM_AXIS AXIN_071 CM_RAW 6 -128 127 AXIS_PTS_REF AX_071 /end AXIS_DESCR /begin AXIS_DESCR COM_AXIS AXIN_100 CM_RAW 4 -128 127 AXIS_PTS_REF AX_100 /end AXIS_DESCR /end CHARACTERISTIC
/begin CHARACTERISTIC CAL_9B2 "массив #9B2" VAL_BLK 0x0806B894 RL_FNC_UWORD 0 CM_RAW 0 65535 MATRIX_DIM 2 1 1 /end CHARACTERISTIC
/begin CHARACTERISTIC CAL_9B3 "массив #9B3" VAL_BLK 0x0806B890 RL_FNC_UWORD 0 CM_RAW 0 65535 MATRIX_DIM 2 1 1 /end CHARACTERISTIC
/begin CHARACTERISTIC CAL_9B4 "кривая #9B4 8: ?" CURVE 0x08070738 RL_FNC_UWORD 0 CM_RAW 0 65535 /begin AXIS_DESCR COM_AXIS AXIN_101 CM_RAW 8 0 65535 AXIS_PTS_REF AX_101 /end AXIS_DESCR /end CHARACTERISTIC
/begin CHARACTERISTIC CAL_9B7 "кривая #9B7 8: N" CURVE 0x08062BAC RL_FNC_UWORD 0 CM_RAW 0 65535
 /begin AXIS_DESCR COM_AXIS AXIN_050_N CM_RPM2 8 0 32767.5 AXIS_PTS_REF AX_050_N /end AXIS_DESCR
/end CHARACTERISTIC
/begin CHARACTERISTIC CAL_9BA "значение #9BA" VALUE 0x0806E8CE RL_FNC_UWORD 0 CM_RAW 0 65535 /end CHARACTERISTIC
/begin CHARACTERISTIC CAL_9BB "значение #9BB" VALUE 0x0806E8D0 RL_FNC_UWORD 0 CM_RAW 0 65535 /end CHARACTERISTIC
/begin CHARACTERISTIC CAL_9BC "значение #9BC" VALUE 0x0806E8D2 RL_FNC_SBYTE 0 CM_RAW -128 127 /end CHARACTERISTIC
/begin CHARACTERISTIC CAL_9BD "карта #9BD 1x9: ? × ?" MAP 0x0806E8D4 RL_FNC_SBYTE 0 CM_RAW -128 127 /begin AXIS_DESCR COM_AXIS AXIN_0F6 CM_RAW 9 -128 127 AXIS_PTS_REF AX_0F6 /end AXIS_DESCR /begin AXIS_DESCR COM_AXIS AXIN_102 CM_RAW 1 -128 127 AXIS_PTS_REF AX_102 /end AXIS_DESCR /end CHARACTERISTIC
/begin CHARACTERISTIC CAL_9BE "карта #9BE 1x6: ? × ?" MAP 0x0806E8E0 RL_FNC_SBYTE 0 CM_RAW -128 127 /begin AXIS_DESCR COM_AXIS AXIN_0F7 CM_RAW 6 -128 127 AXIS_PTS_REF AX_0F7 /end AXIS_DESCR /begin AXIS_DESCR COM_AXIS AXIN_102 CM_RAW 1 -128 127 AXIS_PTS_REF AX_102 /end AXIS_DESCR /end CHARACTERISTIC
/begin CHARACTERISTIC CAL_9C1 "значение #9C1" VALUE 0x080749EF RL_FNC_SBYTE 0 CM_RAW -128 127 /end CHARACTERISTIC
/begin CHARACTERISTIC CAL_9C2 "значение #9C2" VALUE 0x08063E26 RL_FNC_UWORD 0 CM_RAW 0 65535 /end CHARACTERISTIC
/begin CHARACTERISTIC CAL_9C3 "значение #9C3" VALUE 0x08062FA4 RL_FNC_SBYTE 0 CM_RAW -128 127 /end CHARACTERISTIC
/begin CHARACTERISTIC CAL_9C4 "значение #9C4" VALUE 0x08062FA5 RL_FNC_SBYTE 0 CM_RAW -128 127 /end CHARACTERISTIC
/begin CHARACTERISTIC CAL_9C5 "значение #9C5" VALUE 0x08062F8E RL_FNC_SBYTE 0 CM_RAW -128 127 /end CHARACTERISTIC
/begin CHARACTERISTIC CAL_9C6 "значение #9C6" VALUE 0x08062F92 RL_FNC_UWORD 0 CM_RAW 0 65535 /end CHARACTERISTIC
/begin CHARACTERISTIC CAL_9C7 "значение #9C7" VALUE 0x08062FA6 RL_FNC_UWORD 0 CM_RAW 0 65535 /end CHARACTERISTIC
/begin CHARACTERISTIC CAL_9C8 "карта #9C8 4x9: ? × ?" MAP 0x08062F68 RL_FNC_SBYTE 0 CM_RAW -128 127 /begin AXIS_DESCR COM_AXIS AXIN_070 CM_RAW 9 -128 127 AXIS_PTS_REF AX_070 /end AXIS_DESCR /begin AXIS_DESCR COM_AXIS AXIN_0EC CM_RAW 4 -128 127 AXIS_PTS_REF AX_0EC /end AXIS_DESCR /end CHARACTERISTIC
/begin CHARACTERISTIC CAL_9C9 "карта #9C9 4x6: ? × ?" MAP 0x08062F50 RL_FNC_SBYTE 0 CM_RAW -128 127 /begin AXIS_DESCR COM_AXIS AXIN_071 CM_RAW 6 -128 127 AXIS_PTS_REF AX_071 /end AXIS_DESCR /begin AXIS_DESCR COM_AXIS AXIN_0EC CM_RAW 4 -128 127 AXIS_PTS_REF AX_0EC /end AXIS_DESCR /end CHARACTERISTIC
/begin CHARACTERISTIC CAL_9CA "карта #9CA 8x8: N × ?" MAP 0x080737B0 RL_FNC_UWORD 0 CM_RAW 0 65535
 /begin AXIS_DESCR COM_AXIS AXIN_0AC_N CM_RPM2 8 0 32767.5 AXIS_PTS_REF AX_0AC_N /end AXIS_DESCR
 /begin AXIS_DESCR COM_AXIS AXIN_0AF CM_RAW 8 0 65535 AXIS_PTS_REF AX_0AF /end AXIS_DESCR
/end CHARACTERISTIC
/begin CHARACTERISTIC CAL_9CB "значение #9CB" VALUE 0x08061998 RL_FNC_UWORD 0 CM_RAW 0 65535 /end CHARACTERISTIC
/begin CHARACTERISTIC CAL_9CC "значение #9CC" VALUE 0x0806199A RL_FNC_UWORD 0 CM_RAW 0 65535 /end CHARACTERISTIC
/begin CHARACTERISTIC CAL_9CD "кривая #9CD 3: ?" CURVE 0x0807457C RL_FNC_SWORD 0 CM_RAW -32768 32767 /begin AXIS_DESCR COM_AXIS AXIN_009 CM_RAW 3 0 65535 AXIS_PTS_REF AX_009 /end AXIS_DESCR /end CHARACTERISTIC
/end MODULE
/end PROJECT
