ASAP2_VERSION 1 60
/begin PROJECT M74_9 "ИТЭЛМА M74.9, сгенерировано tools/mka2l.py"
/begin HEADER "из таблицы дескрипторов @0x412E4, 2540 записей" VERSION "BB03_w2341v6" /end HEADER
/begin MODULE BB03_w2341v6 "BB03_w2341v6"
/begin MOD_COMMON "" BYTE_ORDER MSB_LAST ALIGNMENT_BYTE 1 ALIGNMENT_WORD 1 ALIGNMENT_LONG 1 /end MOD_COMMON
/begin COMPU_METHOD CM_RAW "сырое значение" RAT_FUNC "%.3" "" COEFFS 0 1 0 0 0 1 /end COMPU_METHOD
/begin COMPU_METHOD CM_C128 "температура, °C (сырое / 128)" RAT_FUNC "%.3" "degC" COEFFS 0 1 0 0 0 128 /end COMPU_METHOD
/begin COMPU_METHOD CM_P128 "педаль / запрос, % (сырое / 128)" RAT_FUNC "%.3" "%" COEFFS 0 1 0 0 0 128 /end COMPU_METHOD
/begin COMPU_METHOD CM_RPM2 "обороты, об/мин (сырое / 2)" RAT_FUNC "%.3" "rpm" COEFFS 0 1 0 0 0 2 /end COMPU_METHOD
/begin RECORD_LAYOUT RL_AX_UWORD_17 AXIS_PTS_X 1 UWORD INDEX_INCR DIRECT FIX_NO_AXIS_PTS_X 17 /end RECORD_LAYOUT
/begin RECORD_LAYOUT RL_AX_SWORD_16 AXIS_PTS_X 1 SWORD INDEX_INCR DIRECT FIX_NO_AXIS_PTS_X 16 /end RECORD_LAYOUT
/begin RECORD_LAYOUT RL_AX_UWORD_14 AXIS_PTS_X 1 UWORD INDEX_INCR DIRECT FIX_NO_AXIS_PTS_X 14 /end RECORD_LAYOUT
/begin RECORD_LAYOUT RL_AX_UWORD_24 AXIS_PTS_X 1 UWORD INDEX_INCR DIRECT FIX_NO_AXIS_PTS_X 24 /end RECORD_LAYOUT
/begin RECORD_LAYOUT RL_AX_UWORD_15 AXIS_PTS_X 1 UWORD INDEX_INCR DIRECT FIX_NO_AXIS_PTS_X 15 /end RECORD_LAYOUT
/begin RECORD_LAYOUT RL_AX_SBYTE_4 AXIS_PTS_X 1 SBYTE INDEX_INCR DIRECT FIX_NO_AXIS_PTS_X 4 /end RECORD_LAYOUT
/begin RECORD_LAYOUT RL_AX_SBYTE_3 AXIS_PTS_X 1 SBYTE INDEX_INCR DIRECT FIX_NO_AXIS_PTS_X 3 /end RECORD_LAYOUT
/begin RECORD_LAYOUT RL_AX_SWORD_9 AXIS_PTS_X 1 SWORD INDEX_INCR DIRECT FIX_NO_AXIS_PTS_X 9 /end RECORD_LAYOUT
/begin RECORD_LAYOUT RL_AX_UWORD_9 AXIS_PTS_X 1 UWORD INDEX_INCR DIRECT FIX_NO_AXIS_PTS_X 9 /end RECORD_LAYOUT
/begin RECORD_LAYOUT RL_AX_UWORD_10 AXIS_PTS_X 1 UWORD INDEX_INCR DIRECT FIX_NO_AXIS_PTS_X 10 /end RECORD_LAYOUT
/begin RECORD_LAYOUT RL_AX_UWORD_16 AXIS_PTS_X 1 UWORD INDEX_INCR DIRECT FIX_NO_AXIS_PTS_X 16 /end RECORD_LAYOUT
/begin RECORD_LAYOUT RL_AX_UWORD_18 AXIS_PTS_X 1 UWORD INDEX_INCR DIRECT FIX_NO_AXIS_PTS_X 18 /end RECORD_LAYOUT
/begin RECORD_LAYOUT RL_AX_UWORD_6 AXIS_PTS_X 1 UWORD INDEX_INCR DIRECT FIX_NO_AXIS_PTS_X 6 /end RECORD_LAYOUT
/begin RECORD_LAYOUT RL_AX_UBYTE_2 AXIS_PTS_X 1 UBYTE INDEX_INCR DIRECT FIX_NO_AXIS_PTS_X 2 /end RECORD_LAYOUT
/begin RECORD_LAYOUT RL_AX_UWORD_12 AXIS_PTS_X 1 UWORD INDEX_INCR DIRECT FIX_NO_AXIS_PTS_X 12 /end RECORD_LAYOUT
/begin RECORD_LAYOUT RL_AX_UWORD_4 AXIS_PTS_X 1 UWORD INDEX_INCR DIRECT FIX_NO_AXIS_PTS_X 4 /end RECORD_LAYOUT
/begin RECORD_LAYOUT RL_AX_UWORD_5 AXIS_PTS_X 1 UWORD INDEX_INCR DIRECT FIX_NO_AXIS_PTS_X 5 /end RECORD_LAYOUT
/begin RECORD_LAYOUT RL_AX_UWORD_7 AXIS_PTS_X 1 UWORD INDEX_INCR DIRECT FIX_NO_AXIS_PTS_X 7 /end RECORD_LAYOUT
/begin RECORD_LAYOUT RL_AX_UWORD_8 AXIS_PTS_X 1 UWORD INDEX_INCR DIRECT FIX_NO_AXIS_PTS_X 8 /end RECORD_LAYOUT
/begin RECORD_LAYOUT RL_AX_SBYTE_2 AXIS_PTS_X 1 SBYTE INDEX_INCR DIRECT FIX_NO_AXIS_PTS_X 2 /end RECORD_LAYOUT
/begin RECORD_LAYOUT RL_AX_SWORD_8 AXIS_PTS_X 1 SWORD INDEX_INCR DIRECT FIX_NO_AXIS_PTS_X 8 /end RECORD_LAYOUT
/begin RECORD_LAYOUT RL_AX_UWORD_1 AXIS_PTS_X 1 UWORD INDEX_INCR DIRECT FIX_NO_AXIS_PTS_X 1 /end RECORD_LAYOUT
/begin RECORD_LAYOUT RL_AX_UWORD_11 AXIS_PTS_X 1 UWORD INDEX_INCR DIRECT FIX_NO_AXIS_PTS_X 11 /end RECORD_LAYOUT
/begin RECORD_LAYOUT RL_AX_SBYTE_8 AXIS_PTS_X 1 SBYTE INDEX_INCR DIRECT FIX_NO_AXIS_PTS_X 8 /end RECORD_LAYOUT
/begin RECORD_LAYOUT RL_AX_SBYTE_6 AXIS_PTS_X 1 SBYTE INDEX_INCR DIRECT FIX_NO_AXIS_PTS_X 6 /end RECORD_LAYOUT
/begin RECORD_LAYOUT RL_AX_SBYTE_9 AXIS_PTS_X 1 SBYTE INDEX_INCR DIRECT FIX_NO_AXIS_PTS_X 9 /end RECORD_LAYOUT
/begin RECORD_LAYOUT RL_AX_UBYTE_3 AXIS_PTS_X 1 UBYTE INDEX_INCR DIRECT FIX_NO_AXIS_PTS_X 3 /end RECORD_LAYOUT
/begin RECORD_LAYOUT RL_AX_UBYTE_10 AXIS_PTS_X 1 UBYTE INDEX_INCR DIRECT FIX_NO_AXIS_PTS_X 10 /end RECORD_LAYOUT
/begin RECORD_LAYOUT RL_AX_SWORD_11 AXIS_PTS_X 1 SWORD INDEX_INCR DIRECT FIX_NO_AXIS_PTS_X 11 /end RECORD_LAYOUT
/begin RECORD_LAYOUT RL_AX_SBYTE_1 AXIS_PTS_X 1 SBYTE INDEX_INCR DIRECT FIX_NO_AXIS_PTS_X 1 /end RECORD_LAYOUT
/begin RECORD_LAYOUT RL_AX_SBYTE_5 AXIS_PTS_X 1 SBYTE INDEX_INCR DIRECT FIX_NO_AXIS_PTS_X 5 /end RECORD_LAYOUT
/begin RECORD_LAYOUT RL_AX_UWORD_28 AXIS_PTS_X 1 UWORD INDEX_INCR DIRECT FIX_NO_AXIS_PTS_X 28 /end RECORD_LAYOUT
/begin RECORD_LAYOUT RL_AX_UWORD_195 AXIS_PTS_X 1 UWORD INDEX_INCR DIRECT FIX_NO_AXIS_PTS_X 195 /end RECORD_LAYOUT
/begin RECORD_LAYOUT RL_AX_SBYTE_13 AXIS_PTS_X 1 SBYTE INDEX_INCR DIRECT FIX_NO_AXIS_PTS_X 13 /end RECORD_LAYOUT
/begin RECORD_LAYOUT RL_AX_SBYTE_10 AXIS_PTS_X 1 SBYTE INDEX_INCR DIRECT FIX_NO_AXIS_PTS_X 10 /end RECORD_LAYOUT
/begin RECORD_LAYOUT RL_AX_UWORD_25 AXIS_PTS_X 1 UWORD INDEX_INCR DIRECT FIX_NO_AXIS_PTS_X 25 /end RECORD_LAYOUT
/begin RECORD_LAYOUT RL_AX_SWORD_10 AXIS_PTS_X 1 SWORD INDEX_INCR DIRECT FIX_NO_AXIS_PTS_X 10 /end RECORD_LAYOUT
/begin RECORD_LAYOUT RL_AX_UWORD_19 AXIS_PTS_X 1 UWORD INDEX_INCR DIRECT FIX_NO_AXIS_PTS_X 19 /end RECORD_LAYOUT
/begin RECORD_LAYOUT RL_AX_UWORD_42 AXIS_PTS_X 1 UWORD INDEX_INCR DIRECT FIX_NO_AXIS_PTS_X 42 /end RECORD_LAYOUT
/begin RECORD_LAYOUT RL_AX_UWORD_20 AXIS_PTS_X 1 UWORD INDEX_INCR DIRECT FIX_NO_AXIS_PTS_X 20 /end RECORD_LAYOUT
/begin RECORD_LAYOUT RL_AX_SWORD_15 AXIS_PTS_X 1 SWORD INDEX_INCR DIRECT FIX_NO_AXIS_PTS_X 15 /end RECORD_LAYOUT
/begin RECORD_LAYOUT RL_FNC_SWORD FNC_VALUES 1 SWORD ROW_DIR DIRECT /end RECORD_LAYOUT
/begin RECORD_LAYOUT RL_FNC_UWORD FNC_VALUES 1 UWORD ROW_DIR DIRECT /end RECORD_LAYOUT
/begin RECORD_LAYOUT RL_FNC_UBYTE FNC_VALUES 1 UBYTE ROW_DIR DIRECT /end RECORD_LAYOUT
/begin RECORD_LAYOUT RL_FNC_SBYTE FNC_VALUES 1 SBYTE ROW_DIR DIRECT /end RECORD_LAYOUT
/begin RECORD_LAYOUT RL_FNC_ULONG FNC_VALUES 1 ULONG ROW_DIR DIRECT /end RECORD_LAYOUT
/begin RECORD_LAYOUT RL_FNC_SLONG FNC_VALUES 1 SLONG ROW_DIR DIRECT /end RECORD_LAYOUT
/begin AXIS_PTS AX_001_N "ось #001, обороты двигателя [да (60e6/период в 0x1FD40; единица 0,5 об/мин — вероятно)]" 0x080614B4 AXIN_001_N RL_AX_UWORD_17 0 CM_RPM2 17 0 32767.5 /end AXIS_PTS
/begin AXIS_PTS AX_002_TAIR "ось #002, температура воздуха на впуске, АЦП канал 8 [вероятно]" 0x08061580 AXIN_002_TAIR RL_AX_SWORD_16 0 CM_C128 16 -256 255.992 /end AXIS_PTS
/begin AXIS_PTS AX_003_UBAT "ось #003, напряжение бортсети? (масштаб не установлен) [вероятно]" 0x08061108 AXIN_003_UBAT RL_AX_UWORD_14 0 CM_RAW 14 0 65535 /end AXIS_PTS
/begin AXIS_PTS AX_00A_TCOOL "ось #00A, температура двигателя (ОЖ), АЦП канал 9 [вероятно]" 0x0806120C AXIN_00A_TCOOL RL_AX_SWORD_9 0 CM_C128 9 -256 255.992 /end AXIS_PTS
/begin AXIS_PTS AX_00C_N "ось #00C, обороты двигателя [да (60e6/период в 0x1FD40; единица 0,5 об/мин — вероятно)]" 0x08061454 AXIN_00C_N RL_AX_UWORD_10 0 CM_RPM2 10 0 32767.5 /end AXIS_PTS
/begin AXIS_PTS AX_010 "ось #010" 0x08060290 AXIN_010 RL_AX_UWORD_18 0 CM_RAW 18 0 65535 /end AXIS_PTS
/begin AXIS_PTS AX_01B_PEDAL "ось #01B, положение педали газа [да]" 0x080610D4 AXIN_01B_PEDAL RL_AX_UWORD_16 0 CM_P128 16 0 511.992 /end AXIS_PTS
/begin AXIS_PTS AX_01E_LOAD "ось #01E, нагрузка / наполнение (0x3C28 / 0x3C30 / 0x3C34), масштаб не установлен [вероятно]" 0x08061264 AXIN_01E_LOAD RL_AX_UWORD_10 0 CM_RAW 10 0 65535 /end AXIS_PTS
/begin AXIS_PTS AX_024_LOAD "ось #024, нагрузка / наполнение (0x3C28 / 0x3C30 / 0x3C34), масштаб не установлен [вероятно]" 0x08060AAC AXIN_024_LOAD RL_AX_UWORD_16 0 CM_RAW 16 0 65535 /end AXIS_PTS
/begin AXIS_PTS AX_026_N "ось #026, обороты двигателя [да (60e6/период в 0x1FD40; единица 0,5 об/мин — вероятно)]" 0x08060B20 AXIN_026_N RL_AX_UWORD_16 0 CM_RPM2 16 0 32767.5 /end AXIS_PTS
/begin AXIS_PTS AX_027_N "ось #027, обороты двигателя [да (60e6/период в 0x1FD40; единица 0,5 об/мин — вероятно)]" 0x080606EC AXIN_027_N RL_AX_UWORD_14 0 CM_RPM2 14 0 32767.5 /end AXIS_PTS
/begin AXIS_PTS AX_028_LOAD "ось #028, нагрузка / наполнение (0x3C28 / 0x3C30 / 0x3C34), масштаб не установлен [вероятно]" 0x080606E0 AXIN_028_LOAD RL_AX_UWORD_5 0 CM_RAW 5 0 65535 /end AXIS_PTS
/begin AXIS_PTS AX_033 "ось #033" 0x08060570 AXIN_033 RL_AX_UWORD_16 0 CM_RAW 16 0 65535 /end AXIS_PTS
/begin AXIS_PTS AX_039_LOAD "ось #039, нагрузка / наполнение (0x3C28 / 0x3C30 / 0x3C34), масштаб не установлен [вероятно]" 0x08060714 AXIN_039_LOAD RL_AX_UWORD_9 0 CM_RAW 9 0 65535 /end AXIS_PTS
/begin AXIS_PTS AX_044 "ось #044" 0x080614D8 AXIN_044 RL_AX_UWORD_8 0 CM_RAW 8 0 65535 /end AXIS_PTS
/begin AXIS_PTS AX_046 "ось #046" 0x080615B4 AXIN_046 RL_AX_SBYTE_2 0 CM_RAW 2 -128 127 /end AXIS_PTS
/begin AXIS_PTS AX_047 "ось #047" 0x0806085C AXIN_047 RL_AX_SBYTE_3 0 CM_RAW 3 -128 127 /end AXIS_PTS
/begin AXIS_PTS AX_049_TAIR "ось #049, температура воздуха на впуске, АЦП канал 8 [вероятно]" 0x08061570 AXIN_049_TAIR RL_AX_SWORD_8 0 CM_C128 8 -256 255.992 /end AXIS_PTS
/begin AXIS_PTS AX_050_N "ось #050, обороты двигателя [да (60e6/период в 0x1FD40; единица 0,5 об/мин — вероятно)]" 0x0806141C AXIN_050_N RL_AX_UWORD_8 0 CM_RPM2 8 0 32767.5 /end AXIS_PTS
/begin AXIS_PTS AX_051 "ось #051" 0x080614F4 AXIN_051 RL_AX_UWORD_7 0 CM_RAW 7 0 65535 /end AXIS_PTS
/begin AXIS_PTS AX_052_N "ось #052, обороты двигателя [да (60e6/период в 0x1FD40; единица 0,5 об/мин — вероятно)]" 0x08061490 AXIN_052_N RL_AX_UWORD_17 0 CM_RPM2 17 0 32767.5 /end AXIS_PTS
/begin AXIS_PTS AX_053 "ось #053" 0x08061278 AXIN_053 RL_AX_UWORD_16 0 CM_RAW 16 0 65535 /end AXIS_PTS
/begin AXIS_PTS AX_055 "ось #055" 0x08061124 AXIN_055 RL_AX_UWORD_1 0 CM_RAW 1 0 65535 /end AXIS_PTS
/begin AXIS_PTS AX_05C "ось #05C" 0x08060008 AXIN_05C RL_AX_UWORD_8 0 CM_RAW 8 0 65535 /end AXIS_PTS
/begin AXIS_PTS AX_05D "ось #05D, индекс 0…7 (похоже, передача)" 0x08061540 AXIN_05D RL_AX_SBYTE_8 0 CM_RAW 8 -128 127 /end AXIS_PTS
/begin AXIS_PTS AX_05E_GEAR "ось #05E, номер передачи 0…7 [вероятно]" 0x08061548 AXIN_05E_GEAR RL_AX_SBYTE_8 0 CM_RAW 8 -128 127 /end AXIS_PTS
/begin AXIS_PTS AX_05F_N "ось #05F, обороты двигателя [да (60e6/период в 0x1FD40; единица 0,5 об/мин — вероятно)]" 0x08061374 AXIN_05F_N RL_AX_UWORD_17 0 CM_RPM2 17 0 32767.5 /end AXIS_PTS
/begin AXIS_PTS AX_06E "ось #06E" 0x080615C4 AXIN_06E RL_AX_UWORD_5 0 CM_RAW 5 0 65535 /end AXIS_PTS
/begin AXIS_PTS AX_070 "ось #070" 0x0806129C AXIN_070 RL_AX_SBYTE_9 0 CM_RAW 9 -128 127 /end AXIS_PTS
/begin AXIS_PTS AX_071 "ось #071" 0x080612A8 AXIN_071 RL_AX_SBYTE_6 0 CM_RAW 6 -128 127 /end AXIS_PTS
/begin AXIS_PTS AX_081 "ось #081" 0x08061338 AXIN_081 RL_AX_UWORD_14 0 CM_RAW 14 0 65535 /end AXIS_PTS
/begin AXIS_PTS AX_083 "ось #083" 0x0806018C AXIN_083 RL_AX_UBYTE_3 0 CM_RAW 3 0 255 /end AXIS_PTS
/begin AXIS_PTS AX_085 "ось #085" 0x08060180 AXIN_085 RL_AX_UBYTE_10 0 CM_RAW 10 0 255 /end AXIS_PTS
/begin AXIS_PTS AX_08B "ось #08B" 0x08060230 AXIN_08B RL_AX_SBYTE_3 0 CM_RAW 3 -128 127 /end AXIS_PTS
/begin AXIS_PTS AX_08D "ось #08D" 0x08061298 AXIN_08D RL_AX_SBYTE_1 0 CM_RAW 1 -128 127 /end AXIS_PTS
/begin AXIS_PTS AX_08E "ось #08E" 0x080612DC AXIN_08E RL_AX_UWORD_11 0 CM_RAW 11 0 65535 /end AXIS_PTS
/begin AXIS_PTS AX_091 "ось #091" 0x0806152C AXIN_091 RL_AX_UWORD_10 0 CM_RAW 10 0 65535 /end AXIS_PTS
/begin AXIS_PTS AX_092 "ось #092" 0x08061518 AXIN_092 RL_AX_UWORD_10 0 CM_RAW 10 0 65535 /end AXIS_PTS
/begin AXIS_PTS AX_093 "ось #093" 0x08060EC0 AXIN_093 RL_AX_UWORD_17 0 CM_RAW 17 0 65535 /end AXIS_PTS
/begin AXIS_PTS AX_09A "ось #09A" 0x080600A8 AXIN_09A RL_AX_UWORD_15 0 CM_RAW 15 0 65535 /end AXIS_PTS
/begin AXIS_PTS AX_0A1_N "ось #0A1, обороты двигателя [да (60e6/период в 0x1FD40; единица 0,5 об/мин — вероятно)]" 0x080604E8 AXIN_0A1_N RL_AX_UWORD_16 0 CM_RPM2 16 0 32767.5 /end AXIS_PTS
/begin AXIS_PTS AX_0A7 "ось #0A7" 0x08060860 AXIN_0A7 RL_AX_SBYTE_5 0 CM_RAW 5 -128 127 /end AXIS_PTS
/begin AXIS_PTS AX_0AC_N "ось #0AC, обороты двигателя [да (60e6/период в 0x1FD40; единица 0,5 об/мин — вероятно)]" 0x08060E50 AXIN_0AC_N RL_AX_UWORD_8 0 CM_RPM2 8 0 32767.5 /end AXIS_PTS
/begin AXIS_PTS AX_0AD_N "ось #0AD, обороты двигателя [да (60e6/период в 0x1FD40; единица 0,5 об/мин — вероятно)]" 0x08060E74 AXIN_0AD_N RL_AX_UWORD_9 0 CM_RPM2 9 0 32767.5 /end AXIS_PTS
/begin AXIS_PTS AX_0AE "ось #0AE" 0x08060E60 AXIN_0AE RL_AX_UWORD_9 0 CM_RAW 9 0 65535 /end AXIS_PTS
/begin AXIS_PTS AX_0AF "ось #0AF" 0x08060F60 AXIN_0AF RL_AX_UWORD_8 0 CM_RAW 8 0 65535 /end AXIS_PTS
/begin AXIS_PTS AX_0B0 "ось #0B0" 0x08060F50 AXIN_0B0 RL_AX_UWORD_8 0 CM_RAW 8 0 65535 /end AXIS_PTS
/begin AXIS_PTS AX_0B1_N "ось #0B1, обороты двигателя [да (60e6/период в 0x1FD40; единица 0,5 об/мин — вероятно)]" 0x08060E38 AXIN_0B1_N RL_AX_UWORD_11 0 CM_RPM2 11 0 32767.5 /end AXIS_PTS
/begin AXIS_PTS AX_0B2 "ось #0B2" 0x08060F20 AXIN_0B2 RL_AX_UWORD_12 0 CM_RAW 12 0 65535 /end AXIS_PTS
/begin AXIS_PTS AX_0B3 "ось #0B3, педаль 0…100 %" 0x08060F38 AXIN_0B3 RL_AX_UWORD_11 0 CM_P128 11 0 511.992 /end AXIS_PTS
/begin AXIS_PTS AX_0B4 "ось #0B4" 0x08060F08 AXIN_0B4 RL_AX_SWORD_11 0 CM_RAW 11 -32768 32767 /end AXIS_PTS
/begin AXIS_PTS AX_0B5 "ось #0B5" 0x08060EE4 AXIN_0B5 RL_AX_UWORD_17 0 CM_RAW 17 0 65535 /end AXIS_PTS
/begin AXIS_PTS AX_0B6 "ось #0B6" 0x08060E88 AXIN_0B6 RL_AX_UWORD_9 0 CM_RAW 9 0 65535 /end AXIS_PTS
/begin AXIS_PTS AX_0B7_LOAD "ось #0B7, нагрузка / наполнение (0x3C28 / 0x3C30 / 0x3C34), масштаб не установлен [вероятно]" 0x08060C54 AXIN_0B7_LOAD RL_AX_UWORD_17 0 CM_RAW 17 0 65535 /end AXIS_PTS
/begin AXIS_PTS AX_0B8 "ось #0B8" 0x08060C78 AXIN_0B8 RL_AX_UWORD_28 0 CM_RAW 28 0 65535 /end AXIS_PTS
/begin AXIS_PTS AX_0B9 "ось #0B9" 0x08060CB0 AXIN_0B9 RL_AX_UWORD_195 0 CM_RAW 195 0 65535 /end AXIS_PTS
/begin AXIS_PTS AX_0BA "ось #0BA" 0x08060F70 AXIN_0BA RL_AX_SBYTE_13 0 CM_RAW 13 -128 127 /end AXIS_PTS
/begin AXIS_PTS AX_0BB "ось #0BB" 0x08060F84 AXIN_0BB RL_AX_UWORD_8 0 CM_RAW 8 0 65535 /end AXIS_PTS
/begin AXIS_PTS AX_0BC "ось #0BC" 0x08060F80 AXIN_0BC RL_AX_SBYTE_2 0 CM_RAW 2 -128 127 /end AXIS_PTS
/begin AXIS_PTS AX_0BD "ось #0BD" 0x08060624 AXIN_0BD RL_AX_SBYTE_3 0 CM_RAW 3 -128 127 /end AXIS_PTS
/begin AXIS_PTS AX_0BE "ось #0BE" 0x08060684 AXIN_0BE RL_AX_SBYTE_10 0 CM_RAW 10 -128 127 /end AXIS_PTS
/begin AXIS_PTS AX_0BF "ось #0BF" 0x0806060C AXIN_0BF RL_AX_UWORD_9 0 CM_RAW 9 0 65535 /end AXIS_PTS
/begin AXIS_PTS AX_0C0 "ось #0C0" 0x08060620 AXIN_0C0 RL_AX_SBYTE_4 0 CM_RAW 4 -128 127 /end AXIS_PTS
/begin AXIS_PTS AX_0C1 "ось #0C1" 0x08060018 AXIN_0C1 RL_AX_UWORD_4 0 CM_RAW 4 0 65535 /end AXIS_PTS
/begin AXIS_PTS AX_0C2 "ось #0C2" 0x08060020 AXIN_0C2 RL_AX_UWORD_4 0 CM_RAW 4 0 65535 /end AXIS_PTS
/begin AXIS_PTS AX_0C3 "ось #0C3" 0x08060028 AXIN_0C3 RL_AX_UWORD_4 0 CM_RAW 4 0 65535 /end AXIS_PTS
/begin AXIS_PTS AX_0C4 "ось #0C4" 0x080608C8 AXIN_0C4 RL_AX_UWORD_8 0 CM_RAW 8 0 65535 /end AXIS_PTS
/begin AXIS_PTS AX_0C5_N "ось #0C5, обороты двигателя [да (60e6/период в 0x1FD40; единица 0,5 об/мин — вероятно)]" 0x08060928 AXIN_0C5_N RL_AX_UWORD_24 0 CM_RPM2 24 0 32767.5 /end AXIS_PTS
/begin AXIS_PTS AX_0C6_N "ось #0C6, обороты двигателя [да (60e6/период в 0x1FD40; единица 0,5 об/мин — вероятно)]" 0x080608F8 AXIN_0C6_N RL_AX_UWORD_24 0 CM_RPM2 24 0 32767.5 /end AXIS_PTS
/begin AXIS_PTS AX_0C7 "ось #0C7" 0x08060884 AXIN_0C7 RL_AX_UWORD_25 0 CM_RAW 25 0 65535 /end AXIS_PTS
/begin AXIS_PTS AX_0C8 "ось #0C8, педаль 0…100 %" 0x080608D8 AXIN_0C8 RL_AX_UWORD_16 0 CM_P128 16 0 511.992 /end AXIS_PTS
/begin AXIS_PTS AX_0C9 "ось #0C9" 0x080608B8 AXIN_0C9 RL_AX_UWORD_8 0 CM_RAW 8 0 65535 /end AXIS_PTS
/begin AXIS_PTS AX_0CA "ось #0CA" 0x08060384 AXIN_0CA RL_AX_UWORD_9 0 CM_RAW 9 0 65535 /end AXIS_PTS
/begin AXIS_PTS AX_0CB "ось #0CB" 0x08060374 AXIN_0CB RL_AX_UWORD_7 0 CM_RAW 7 0 65535 /end AXIS_PTS
/begin AXIS_PTS AX_0CC "ось #0CC" 0x08060448 AXIN_0CC RL_AX_UWORD_17 0 CM_RAW 17 0 65535 /end AXIS_PTS
/begin AXIS_PTS AX_0CE "ось #0CE" 0x08060190 AXIN_0CE RL_AX_SBYTE_1 0 CM_RAW 1 -128 127 /end AXIS_PTS
/begin AXIS_PTS AX_0CF "ось #0CF" 0x08060194 AXIN_0CF RL_AX_UWORD_9 0 CM_RAW 9 0 65535 /end AXIS_PTS
/begin AXIS_PTS AX_0D0 "ось #0D0" 0x080601A8 AXIN_0D0 RL_AX_SWORD_10 0 CM_RAW 10 -32768 32767 /end AXIS_PTS
/begin AXIS_PTS AX_0D1 "ось #0D1" 0x080601BC AXIN_0D1 RL_AX_UWORD_11 0 CM_RAW 11 0 65535 /end AXIS_PTS
/begin AXIS_PTS AX_0D2 "ось #0D2" 0x08060958 AXIN_0D2 RL_AX_UWORD_12 0 CM_RAW 12 0 65535 /end AXIS_PTS
/begin AXIS_PTS AX_0D3_TCOOL "ось #0D3, температура двигателя (ОЖ), АЦП канал 9 [вероятно]" 0x08061168 AXIN_0D3_TCOOL RL_AX_SWORD_16 0 CM_C128 16 -256 255.992 /end AXIS_PTS
/begin AXIS_PTS AX_0D4 "ось #0D4" 0x08060828 AXIN_0D4 RL_AX_SBYTE_2 0 CM_RAW 2 -128 127 /end AXIS_PTS
/begin AXIS_PTS AX_0D5 "ось #0D5, индекс 0…7 (похоже, передача)" 0x0806082C AXIN_0D5 RL_AX_SBYTE_8 0 CM_RAW 8 -128 127 /end AXIS_PTS
/begin AXIS_PTS AX_0D6 "ось #0D6" 0x08060B60 AXIN_0D6 RL_AX_SBYTE_3 0 CM_RAW 3 -128 127 /end AXIS_PTS
/begin AXIS_PTS AX_0D7 "ось #0D7" 0x08060420 AXIN_0D7 RL_AX_SBYTE_4 0 CM_RAW 4 -128 127 /end AXIS_PTS
/begin AXIS_PTS AX_0D8_N "ось #0D8, обороты двигателя [да (60e6/период в 0x1FD40; единица 0,5 об/мин — вероятно)]" 0x0806142C AXIN_0D8_N RL_AX_UWORD_19 0 CM_RPM2 19 0 32767.5 /end AXIS_PTS
/begin AXIS_PTS AX_0D9 "ось #0D9" 0x080612C4 AXIN_0D9 RL_AX_UWORD_11 0 CM_RAW 11 0 65535 /end AXIS_PTS
/begin AXIS_PTS AX_0DA "ось #0DA" 0x08060970 AXIN_0DA RL_AX_UWORD_42 0 CM_RAW 42 0 65535 /end AXIS_PTS
/begin AXIS_PTS AX_0DB "ось #0DB" 0x08061240 AXIN_0DB RL_AX_UWORD_17 0 CM_RAW 17 0 65535 /end AXIS_PTS
/begin AXIS_PTS AX_0DC_N "ось #0DC, обороты двигателя [да (60e6/период в 0x1FD40; единица 0,5 об/мин — вероятно)]" 0x08061398 AXIN_0DC_N RL_AX_UWORD_17 0 CM_RPM2 17 0 32767.5 /end AXIS_PTS
/begin AXIS_PTS AX_0DD "ось #0DD" 0x08061318 AXIN_0DD RL_AX_UWORD_16 0 CM_RAW 16 0 65535 /end AXIS_PTS
/begin AXIS_PTS AX_0DF "ось #0DF" 0x08060A48 AXIN_0DF RL_AX_SBYTE_2 0 CM_RAW 2 -128 127 /end AXIS_PTS
/begin AXIS_PTS AX_0E0 "ось #0E0" 0x0806087C AXIN_0E0 RL_AX_SBYTE_1 0 CM_RAW 1 -128 127 /end AXIS_PTS
/begin AXIS_PTS AX_0E1 "ось #0E1" 0x08060030 AXIN_0E1 RL_AX_SBYTE_3 0 CM_RAW 3 -128 127 /end AXIS_PTS
/begin AXIS_PTS AX_0E2 "ось #0E2" 0x08060B64 AXIN_0E2 RL_AX_SBYTE_2 0 CM_RAW 2 -128 127 /end AXIS_PTS
/begin AXIS_PTS AX_0E3 "ось #0E3" 0x08061504 AXIN_0E3 RL_AX_UWORD_9 0 CM_RAW 9 0 65535 /end AXIS_PTS
/begin AXIS_PTS AX_0E4 "ось #0E4" 0x080609C4 AXIN_0E4 RL_AX_SBYTE_2 0 CM_RAW 2 -128 127 /end AXIS_PTS
/begin AXIS_PTS AX_0E5 "ось #0E5, индекс 0…7 (похоже, передача)" 0x08060364 AXIN_0E5 RL_AX_SBYTE_8 0 CM_RAW 8 -128 127 /end AXIS_PTS
/begin AXIS_PTS AX_0E6 "ось #0E6" 0x08060E9C AXIN_0E6 RL_AX_UWORD_17 0 CM_RAW 17 0 65535 /end AXIS_PTS
/begin AXIS_PTS AX_0E7 "ось #0E7" 0x0806014C AXIN_0E7 RL_AX_SBYTE_5 0 CM_RAW 5 -128 127 /end AXIS_PTS
/begin AXIS_PTS AX_0E8 "ось #0E8" 0x0806025C AXIN_0E8 RL_AX_SBYTE_2 0 CM_RAW 2 -128 127 /end AXIS_PTS
/begin AXIS_PTS AX_0E9 "ось #0E9" 0x08060234 AXIN_0E9 RL_AX_SBYTE_2 0 CM_RAW 2 -128 127 /end AXIS_PTS
/begin AXIS_PTS AX_0EA "ось #0EA" 0x0806009C AXIN_0EA RL_AX_SBYTE_2 0 CM_RAW 2 -128 127 /end AXIS_PTS
/begin AXIS_PTS AX_0EB "ось #0EB" 0x080600A0 AXIN_0EB RL_AX_SBYTE_2 0 CM_RAW 2 -128 127 /end AXIS_PTS
/begin AXIS_PTS AX_0EC "ось #0EC" 0x08060098 AXIN_0EC RL_AX_SBYTE_3 0 CM_RAW 3 -128 127 /end AXIS_PTS
/begin AXIS_PTS AX_0ED "ось #0ED" 0x08060004 AXIN_0ED RL_AX_UBYTE_2 0 CM_RAW 2 0 255 /end AXIS_PTS
/begin AXIS_PTS AX_0EE "ось #0EE" 0x080606DC AXIN_0EE RL_AX_SBYTE_3 0 CM_RAW 3 -128 127 /end AXIS_PTS
/begin AXIS_PTS AX_0EF "ось #0EF" 0x08060418 AXIN_0EF RL_AX_SBYTE_2 0 CM_RAW 2 -128 127 /end AXIS_PTS
/begin AXIS_PTS AX_0F0 "ось #0F0" 0x0806041C AXIN_0F0 RL_AX_SBYTE_4 0 CM_RAW 4 -128 127 /end AXIS_PTS
/begin AXIS_PTS AX_0F1 "ось #0F1" 0x080605F4 AXIN_0F1 RL_AX_SBYTE_3 0 CM_RAW 3 -128 127 /end AXIS_PTS
/begin AXIS_PTS AX_0F2 "ось #0F2" 0x08060074 AXIN_0F2 RL_AX_UBYTE_10 0 CM_RAW 10 0 255 /end AXIS_PTS
/begin AXIS_PTS AX_0F3 "ось #0F3" 0x0806040C AXIN_0F3 RL_AX_SBYTE_2 0 CM_RAW 2 -128 127 /end AXIS_PTS
/begin AXIS_PTS AX_0F4 "ось #0F4" 0x08060410 AXIN_0F4 RL_AX_SBYTE_5 0 CM_RAW 5 -128 127 /end AXIS_PTS
/begin AXIS_PTS AX_0F5 "ось #0F5" 0x080602B4 AXIN_0F5 RL_AX_SBYTE_1 0 CM_RAW 1 -128 127 /end AXIS_PTS
/begin AXIS_PTS AX_0F6 "ось #0F6" 0x080602B8 AXIN_0F6 RL_AX_SBYTE_9 0 CM_RAW 9 -128 127 /end AXIS_PTS
/begin AXIS_PTS AX_0F7 "ось #0F7" 0x080602C4 AXIN_0F7 RL_AX_SBYTE_6 0 CM_RAW 6 -128 127 /end AXIS_PTS
/begin AXIS_PTS AX_0F8 "ось #0F8, индекс 0…7 (похоже, передача)" 0x08060820 AXIN_0F8 RL_AX_SBYTE_8 0 CM_RAW 8 -128 127 /end AXIS_PTS
/begin AXIS_PTS AX_0F9 "ось #0F9" 0x080607D0 AXIN_0F9 RL_AX_SBYTE_5 0 CM_RAW 5 -128 127 /end AXIS_PTS
/begin AXIS_PTS AX_0FA_N "ось #0FA, обороты двигателя [да (60e6/период в 0x1FD40; единица 0,5 об/мин — вероятно)]" 0x08061468 AXIN_0FA_N RL_AX_UWORD_20 0 CM_RPM2 20 0 32767.5 /end AXIS_PTS
/begin AXIS_PTS AX_0FB "ось #0FB" 0x08061028 AXIN_0FB RL_AX_UWORD_6 0 CM_RAW 6 0 65535 /end AXIS_PTS
/begin AXIS_PTS AX_0FC "ось #0FC" 0x08061034 AXIN_0FC RL_AX_UWORD_16 0 CM_RAW 16 0 65535 /end AXIS_PTS
/begin AXIS_PTS AX_0FD "ось #0FD" 0x0806109C AXIN_0FD RL_AX_SWORD_15 0 CM_RAW 15 -32768 32767 /end AXIS_PTS
/begin AXIS_PTS AX_0FF "ось #0FF" 0x0806017C AXIN_0FF RL_AX_UBYTE_3 0 CM_RAW 3 0 255 /end AXIS_PTS
/begin AXIS_PTS AX_100 "ось #100" 0x080600A4 AXIN_100 RL_AX_SBYTE_4 0 CM_RAW 4 -128 127 /end AXIS_PTS
/begin AXIS_PTS AX_101 "ось #101" 0x080615F0 AXIN_101 RL_AX_UWORD_8 0 CM_RAW 8 0 65535 /end AXIS_PTS
/begin AXIS_PTS AX_102 "ось #102" 0x08060A4C AXIN_102 RL_AX_SBYTE_1 0 CM_RAW 1 -128 127 /end AXIS_PTS
/begin CHARACTERISTIC CAL_683 "карта #683 17x17: N × LOAD" MAP 0x08072820 RL_FNC_UWORD 0 CM_RAW 0 65535
 /begin AXIS_DESCR COM_AXIS AXIN_05F_N CM_RPM2 17 0 32767.5 AXIS_PTS_REF AX_05F_N /end AXIS_DESCR
 /begin AXIS_DESCR COM_AXIS AXIN_0B7_LOAD CM_RAW 17 0 65535 AXIS_PTS_REF AX_0B7_LOAD /end AXIS_DESCR
/end CHARACTERISTIC
/begin CHARACTERISTIC CAL_684 "массив #684" VAL_BLK 0x0807360C RL_FNC_UWORD 0 CM_RAW 0 65535 MATRIX_DIM 2 1 1 /end CHARACTERISTIC
/begin CHARACTERISTIC CAL_685 "кривая #685 11: ?" CURVE 0x080706C4 RL_FNC_UWORD 0 CM_RAW 0 65535 /begin AXIS_DESCR COM_AXIS AXIN_08E CM_RAW 11 0 65535 AXIS_PTS_REF AX_08E /end AXIS_DESCR /end CHARACTERISTIC
/begin CHARACTERISTIC CAL_686 "кривая #686 11: ?" CURVE 0x080706DC RL_FNC_UWORD 0 CM_RAW 0 65535 /begin AXIS_DESCR COM_AXIS AXIN_0B3 CM_P128 11 0 511.992 AXIS_PTS_REF AX_0B3 /end AXIS_DESCR /end CHARACTERISTIC
/begin CHARACTERISTIC CAL_687 "кривая #687 11: ?" CURVE 0x0807070C RL_FNC_UWORD 0 CM_RAW 0 65535 /begin AXIS_DESCR COM_AXIS AXIN_0B3 CM_P128 11 0 511.992 AXIS_PTS_REF AX_0B3 /end AXIS_DESCR /end CHARACTERISTIC
/begin CHARACTERISTIC CAL_688 "кривая #688 11: ?" CURVE 0x080706F4 RL_FNC_UWORD 0 CM_RAW 0 65535 /begin AXIS_DESCR COM_AXIS AXIN_0B3 CM_P128 11 0 511.992 AXIS_PTS_REF AX_0B3 /end AXIS_DESCR /end CHARACTERISTIC
/begin CHARACTERISTIC CAL_689 "кривая #689 11: ?" CURVE 0x08070738 RL_FNC_UWORD 0 CM_RAW 0 65535 /begin AXIS_DESCR COM_AXIS AXIN_0B3 CM_P128 11 0 511.992 AXIS_PTS_REF AX_0B3 /end AXIS_DESCR /end CHARACTERISTIC
/begin CHARACTERISTIC CAL_68A "кривая #68A 11: ?" CURVE 0x08070750 RL_FNC_UWORD 0 CM_RAW 0 65535 /begin AXIS_DESCR COM_AXIS AXIN_0B3 CM_P128 11 0 511.992 AXIS_PTS_REF AX_0B3 /end AXIS_DESCR /end CHARACTERISTIC
/begin CHARACTERISTIC CAL_68B "кривая #68B 11: ?" CURVE 0x08070768 RL_FNC_UWORD 0 CM_RAW 0 65535 /begin AXIS_DESCR COM_AXIS AXIN_0B3 CM_P128 11 0 511.992 AXIS_PTS_REF AX_0B3 /end AXIS_DESCR /end CHARACTERISTIC
/begin CHARACTERISTIC CAL_68C "кривая #68C 11: ?" CURVE 0x08070780 RL_FNC_UWORD 0 CM_RAW 0 65535 /begin AXIS_DESCR COM_AXIS AXIN_0B3 CM_P128 11 0 511.992 AXIS_PTS_REF AX_0B3 /end AXIS_DESCR /end CHARACTERISTIC
/begin CHARACTERISTIC CAL_68D "карта #68D 11x8: GEAR × ?" MAP 0x080707BC RL_FNC_UWORD 0 CM_RAW 0 65535
 /begin AXIS_DESCR COM_AXIS AXIN_05E_GEAR CM_RAW 8 -128 127 AXIS_PTS_REF AX_05E_GEAR /end AXIS_DESCR
 /begin AXIS_DESCR COM_AXIS AXIN_0D9 CM_RAW 11 0 65535 AXIS_PTS_REF AX_0D9 /end AXIS_DESCR
/end CHARACTERISTIC
/begin CHARACTERISTIC CAL_68E "карта #68E 11x8: GEAR × ?" MAP 0x0807086C RL_FNC_UWORD 0 CM_RAW 0 65535
 /begin AXIS_DESCR COM_AXIS AXIN_05E_GEAR CM_RAW 8 -128 127 AXIS_PTS_REF AX_05E_GEAR /end AXIS_DESCR
 /begin AXIS_DESCR COM_AXIS AXIN_0D9 CM_RAW 11 0 65535 AXIS_PTS_REF AX_0D9 /end AXIS_DESCR
/end CHARACTERISTIC
/begin CHARACTERISTIC CAL_68F "карта #68F 11x8: GEAR × N [знак по значениям]" MAP 0x0807091C RL_FNC_SWORD 0 CM_RAW -32768 32767
 /begin AXIS_DESCR COM_AXIS AXIN_05E_GEAR CM_RAW 8 -128 127 AXIS_PTS_REF AX_05E_GEAR /end AXIS_DESCR
 /begin AXIS_DESCR COM_AXIS AXIN_0B1_N CM_RPM2 11 0 32767.5 AXIS_PTS_REF AX_0B1_N /end AXIS_DESCR
/end CHARACTERISTIC
/begin CHARACTERISTIC CAL_690 "карта #690 11x8: GEAR × N" MAP 0x080709CC RL_FNC_UWORD 0 CM_RAW 0 65535
 /begin AXIS_DESCR COM_AXIS AXIN_05E_GEAR CM_RAW 8 -128 127 AXIS_PTS_REF AX_05E_GEAR /end AXIS_DESCR
 /begin AXIS_DESCR COM_AXIS AXIN_0B1_N CM_RPM2 11 0 32767.5 AXIS_PTS_REF AX_0B1_N /end AXIS_DESCR
/end CHARACTERISTIC
/begin CHARACTERISTIC CAL_691 "кривая #691 8: GEAR" CURVE 0x08070A8C RL_FNC_UWORD 0 CM_RAW 0 65535
 /begin AXIS_DESCR COM_AXIS AXIN_05E_GEAR CM_RAW 8 -128 127 AXIS_PTS_REF AX_05E_GEAR /end AXIS_DESCR
/end CHARACTERISTIC
/begin CHARACTERISTIC CAL_692 "карта #692 11x8: GEAR × N" MAP 0x08070D78 RL_FNC_UWORD 0 CM_RAW 0 65535
 /begin AXIS_DESCR COM_AXIS AXIN_05E_GEAR CM_RAW 8 -128 127 AXIS_PTS_REF AX_05E_GEAR /end AXIS_DESCR
 /begin AXIS_DESCR COM_AXIS AXIN_0B1_N CM_RPM2 11 0 32767.5 AXIS_PTS_REF AX_0B1_N /end AXIS_DESCR
/end CHARACTERISTIC
/begin CHARACTERISTIC CAL_693 "карта #693 11x8: N × ?" MAP 0x08070CC8 RL_FNC_UWORD 0 CM_RAW 0 65535
 /begin AXIS_DESCR COM_AXIS AXIN_050_N CM_RPM2 8 0 32767.5 AXIS_PTS_REF AX_050_N /end AXIS_DESCR
 /begin AXIS_DESCR COM_AXIS AXIN_08E CM_RAW 11 0 65535 AXIS_PTS_REF AX_08E /end AXIS_DESCR
/end CHARACTERISTIC
/begin CHARACTERISTIC CAL_694 "карта #694 11x8: GEAR × N" MAP 0x08070F88 RL_FNC_UWORD 0 CM_RAW 0 65535
 /begin AXIS_DESCR COM_AXIS AXIN_05E_GEAR CM_RAW 8 -128 127 AXIS_PTS_REF AX_05E_GEAR /end AXIS_DESCR
 /begin AXIS_DESCR COM_AXIS AXIN_0B1_N CM_RPM2 11 0 32767.5 AXIS_PTS_REF AX_0B1_N /end AXIS_DESCR
/end CHARACTERISTIC
/begin CHARACTERISTIC CAL_695 "карта #695 11x16: PEDAL × ?" MAP 0x08070E28 RL_FNC_UWORD 0 CM_RAW 0 65535
 /begin AXIS_DESCR COM_AXIS AXIN_01B_PEDAL CM_P128 16 0 511.992 AXIS_PTS_REF AX_01B_PEDAL /end AXIS_DESCR
 /begin AXIS_DESCR COM_AXIS AXIN_08E CM_RAW 11 0 65535 AXIS_PTS_REF AX_08E /end AXIS_DESCR
/end CHARACTERISTIC
/begin CHARACTERISTIC CAL_696 "кривая #696 8: N" CURVE 0x08071A44 RL_FNC_UWORD 0 CM_RAW 0 65535
 /begin AXIS_DESCR COM_AXIS AXIN_050_N CM_RPM2 8 0 32767.5 AXIS_PTS_REF AX_050_N /end AXIS_DESCR
/end CHARACTERISTIC
/begin CHARACTERISTIC CAL_697 "карта #697 8x9: N × GEAR" MAP 0x08071B1C RL_FNC_UWORD 0 CM_RAW 0 65535
 /begin AXIS_DESCR COM_AXIS AXIN_0AD_N CM_RPM2 9 0 32767.5 AXIS_PTS_REF AX_0AD_N /end AXIS_DESCR
 /begin AXIS_DESCR COM_AXIS AXIN_05E_GEAR CM_RAW 8 -128 127 AXIS_PTS_REF AX_05E_GEAR /end AXIS_DESCR
/end CHARACTERISTIC
/begin CHARACTERISTIC CAL_698 "кривая #698 8: GEAR" CURVE 0x08071A54 RL_FNC_UWORD 0 CM_RAW 0 65535
 /begin AXIS_DESCR COM_AXIS AXIN_05E_GEAR CM_RAW 8 -128 127 AXIS_PTS_REF AX_05E_GEAR /end AXIS_DESCR
/end CHARACTERISTIC
/begin CHARACTERISTIC CAL_699 "карта #699 11x8: GEAR × N" MAP 0x0807363C RL_FNC_SBYTE 0 CM_RAW -128 127
 /begin AXIS_DESCR COM_AXIS AXIN_05E_GEAR CM_RAW 8 -128 127 AXIS_PTS_REF AX_05E_GEAR /end AXIS_DESCR
 /begin AXIS_DESCR COM_AXIS AXIN_0B1_N CM_RPM2 11 0 32767.5 AXIS_PTS_REF AX_0B1_N /end AXIS_DESCR
/end CHARACTERISTIC
/begin CHARACTERISTIC CAL_69A "карта #69A 11x8: GEAR × N" MAP 0x08073694 RL_FNC_SBYTE 0 CM_RAW -128 127
 /begin AXIS_DESCR COM_AXIS AXIN_05E_GEAR CM_RAW 8 -128 127 AXIS_PTS_REF AX_05E_GEAR /end AXIS_DESCR
 /begin AXIS_DESCR COM_AXIS AXIN_0B1_N CM_RPM2 11 0 32767.5 AXIS_PTS_REF AX_0B1_N /end AXIS_DESCR
/end CHARACTERISTIC
/begin CHARACTERISTIC CAL_69B "карта #69B 11x8: GEAR × N" MAP 0x080736F0 RL_FNC_SBYTE 0 CM_RAW -128 127
 /begin AXIS_DESCR COM_AXIS AXIN_05E_GEAR CM_RAW 8 -128 127 AXIS_PTS_REF AX_05E_GEAR /end AXIS_DESCR
 /begin AXIS_DESCR COM_AXIS AXIN_0B1_N CM_RPM2 11 0 32767.5 AXIS_PTS_REF AX_0B1_N /end AXIS_DESCR
/end CHARACTERISTIC
/begin CHARACTERISTIC CAL_69C "карта #69C 11x8: GEAR × N" MAP 0x08073748 RL_FNC_SBYTE 0 CM_RAW -128 127
 /begin AXIS_DESCR COM_AXIS AXIN_05E_GEAR CM_RAW 8 -128 127 AXIS_PTS_REF AX_05E_GEAR /end AXIS_DESCR
 /begin AXIS_DESCR COM_AXIS AXIN_0B1_N CM_RPM2 11 0 32767.5 AXIS_PTS_REF AX_0B1_N /end AXIS_DESCR
/end CHARACTERISTIC
/begin CHARACTERISTIC CAL_69D "значение #69D" VALUE 0x0807386C RL_FNC_SBYTE 0 CM_RAW -128 127 /end CHARACTERISTIC
/begin CHARACTERISTIC CAL_69E_0 "кривая #69E 9: TCOOL [1/2]" CURVE 0x08070798 RL_FNC_UWORD 0 CM_RAW 0 65535
 /begin AXIS_DESCR COM_AXIS AXIN_00A_TCOOL CM_C128 9 -256 255.992 AXIS_PTS_REF AX_00A_TCOOL /end AXIS_DESCR
/end CHARACTERISTIC
/begin CHARACTERISTIC CAL_69E_1 "кривая #69E 9: TCOOL [2/2]" CURVE 0x080707AA RL_FNC_UWORD 0 CM_RAW 0 65535
 /begin AXIS_DESCR COM_AXIS AXIN_00A_TCOOL CM_C128 9 -256 255.992 AXIS_PTS_REF AX_00A_TCOOL /end AXIS_DESCR
/end CHARACTERISTIC
/begin CHARACTERISTIC CAL_69F "кривая #69F 8: ?" CURVE 0x08070A7C RL_FNC_UWORD 0 CM_RAW 0 65535 /begin AXIS_DESCR COM_AXIS AXIN_05D CM_RAW 8 -128 127 AXIS_PTS_REF AX_05D /end AXIS_DESCR /end CHARACTERISTIC
/begin CHARACTERISTIC CAL_6A0 "кривая #6A0 8: GEAR" CURVE 0x080710F0 RL_FNC_UWORD 0 CM_RAW 0 65535
 /begin AXIS_DESCR COM_AXIS AXIN_05E_GEAR CM_RAW 8 -128 127 AXIS_PTS_REF AX_05E_GEAR /end AXIS_DESCR
/end CHARACTERISTIC
/begin CHARACTERISTIC CAL_6A1 "кривая #6A1 8: GEAR" CURVE 0x08071100 RL_FNC_UWORD 0 CM_RAW 0 65535
 /begin AXIS_DESCR COM_AXIS AXIN_05E_GEAR CM_RAW 8 -128 127 AXIS_PTS_REF AX_05E_GEAR /end AXIS_DESCR
/end CHARACTERISTIC
/begin CHARACTERISTIC CAL_6A2 "массив #6A2" VAL_BLK 0x0807111C RL_FNC_SBYTE 0 CM_RAW -128 127 MATRIX_DIM 10 1 1 /end CHARACTERISTIC
/begin CHARACTERISTIC CAL_6A3 "массив #6A3" VAL_BLK 0x08071128 RL_FNC_SBYTE 0 CM_RAW -128 127 MATRIX_DIM 10 1 1 /end CHARACTERISTIC
/begin CHARACTERISTIC CAL_6A4_0 "кривая #6A4 12: ? [1/2]" CURVE 0x080727B0 RL_FNC_UWORD 0 CM_RAW 0 65535 /begin AXIS_DESCR COM_AXIS AXIN_0B2 CM_RAW 12 0 65535 AXIS_PTS_REF AX_0B2 /end AXIS_DESCR /end CHARACTERISTIC
/begin CHARACTERISTIC CAL_6A4_1 "кривая #6A4 12: ? [2/2]" CURVE 0x080727C8 RL_FNC_UWORD 0 CM_RAW 0 65535 /begin AXIS_DESCR COM_AXIS AXIN_0B2 CM_RAW 12 0 65535 AXIS_PTS_REF AX_0B2 /end AXIS_DESCR /end CHARACTERISTIC
/begin CHARACTERISTIC CAL_6A5 "карта #6A5 10x8: GEAR × N [знак по значениям]" MAP 0x08072710 RL_FNC_SWORD 0 CM_RAW -32768 32767
 /begin AXIS_DESCR COM_AXIS AXIN_05E_GEAR CM_RAW 8 -128 127 AXIS_PTS_REF AX_05E_GEAR /end AXIS_DESCR
 /begin AXIS_DESCR COM_AXIS AXIN_00C_N CM_RPM2 10 0 32767.5 AXIS_PTS_REF AX_00C_N /end AXIS_DESCR
/end CHARACTERISTIC
/begin CHARACTERISTIC CAL_6A6 "кривая #6A6 12: ?" CURVE 0x080727E0 RL_FNC_UWORD 0 CM_RAW 0 65535 /begin AXIS_DESCR COM_AXIS AXIN_0B2 CM_RAW 12 0 65535 AXIS_PTS_REF AX_0B2 /end AXIS_DESCR /end CHARACTERISTIC
/begin CHARACTERISTIC CAL_6A7 "кривая #6A7 12: ?" CURVE 0x080727F8 RL_FNC_UWORD 0 CM_RAW 0 65535 /begin AXIS_DESCR COM_AXIS AXIN_0B2 CM_RAW 12 0 65535 AXIS_PTS_REF AX_0B2 /end AXIS_DESCR /end CHARACTERISTIC
/begin CHARACTERISTIC CAL_6A8_0 "карта #6A8 16x12: ? × PEDAL [1/3]" MAP 0x08072A64 RL_FNC_UWORD 0 CM_RAW 0 65535 /begin AXIS_DESCR COM_AXIS AXIN_0B2 CM_RAW 12 0 65535 AXIS_PTS_REF AX_0B2 /end AXIS_DESCR
 /begin AXIS_DESCR COM_AXIS AXIN_01B_PEDAL CM_P128 16 0 511.992 AXIS_PTS_REF AX_01B_PEDAL /end AXIS_DESCR
/end CHARACTERISTIC
/begin CHARACTERISTIC CAL_6A8_1 "карта #6A8 16x12: ? × PEDAL [2/3]" MAP 0x08072BE4 RL_FNC_UWORD 0 CM_RAW 0 65535 /begin AXIS_DESCR COM_AXIS AXIN_0B2 CM_RAW 12 0 65535 AXIS_PTS_REF AX_0B2 /end AXIS_DESCR
 /begin AXIS_DESCR COM_AXIS AXIN_01B_PEDAL CM_P128 16 0 511.992 AXIS_PTS_REF AX_01B_PEDAL /end AXIS_DESCR
/end CHARACTERISTIC
/begin CHARACTERISTIC CAL_6A8_2 "карта #6A8 16x12: ? × PEDAL [3/3]" MAP 0x08072D64 RL_FNC_UWORD 0 CM_RAW 0 65535 /begin AXIS_DESCR COM_AXIS AXIN_0B2 CM_RAW 12 0 65535 AXIS_PTS_REF AX_0B2 /end AXIS_DESCR
 /begin AXIS_DESCR COM_AXIS AXIN_01B_PEDAL CM_P128 16 0 511.992 AXIS_PTS_REF AX_01B_PEDAL /end AXIS_DESCR
/end CHARACTERISTIC
/begin CHARACTERISTIC CAL_6A9_0 "карта #6A9 16x12: ? × PEDAL [1/3]" MAP 0x08072EE4 RL_FNC_UWORD 0 CM_RAW 0 65535 /begin AXIS_DESCR COM_AXIS AXIN_0B2 CM_RAW 12 0 65535 AXIS_PTS_REF AX_0B2 /end AXIS_DESCR
 /begin AXIS_DESCR COM_AXIS AXIN_01B_PEDAL CM_P128 16 0 511.992 AXIS_PTS_REF AX_01B_PEDAL /end AXIS_DESCR
/end CHARACTERISTIC
/begin CHARACTERISTIC CAL_6A9_1 "карта #6A9 16x12: ? × PEDAL [2/3]" MAP 0x08073064 RL_FNC_UWORD 0 CM_RAW 0 65535 /begin AXIS_DESCR COM_AXIS AXIN_0B2 CM_RAW 12 0 65535 AXIS_PTS_REF AX_0B2 /end AXIS_DESCR
 /begin AXIS_DESCR COM_AXIS AXIN_01B_PEDAL CM_P128 16 0 511.992 AXIS_PTS_REF AX_01B_PEDAL /end AXIS_DESCR
/end CHARACTERISTIC
/begin CHARACTERISTIC CAL_6A9_2 "карта #6A9 16x12: ? × PEDAL [3/3]" MAP 0x080731E4 RL_FNC_UWORD 0 CM_RAW 0 65535 /begin AXIS_DESCR COM_AXIS AXIN_0B2 CM_RAW 12 0 65535 AXIS_PTS_REF AX_0B2 /end AXIS_DESCR
 /begin AXIS_DESCR COM_AXIS AXIN_01B_PEDAL CM_P128 16 0 511.992 AXIS_PTS_REF AX_01B_PEDAL /end AXIS_DESCR
/end CHARACTERISTIC
/begin CHARACTERISTIC CAL_6AA "кривая #6AA 9: TCOOL" CURVE 0x08073628 RL_FNC_UWORD 0 CM_RAW 0 65535
 /begin AXIS_DESCR COM_AXIS AXIN_00A_TCOOL CM_C128 9 -256 255.992 AXIS_PTS_REF AX_00A_TCOOL /end AXIS_DESCR
/end CHARACTERISTIC
/begin CHARACTERISTIC CAL_6AB "значение #6AB" VALUE 0x080736EE RL_FNC_SWORD 0 CM_RAW -32768 32767 /end CHARACTERISTIC
/begin CHARACTERISTIC CAL_6AC "значение #6AC" VALUE 0x080737A0 RL_FNC_SWORD 0 CM_RAW -32768 32767 /end CHARACTERISTIC
/begin CHARACTERISTIC CAL_6AD "значение #6AD" VALUE 0x08070C66 RL_FNC_UWORD 0 CM_RAW 0 65535 /end CHARACTERISTIC
/begin CHARACTERISTIC CAL_6AE_0 "кривая #6AE 17: ? [1/2]" CURVE 0x08071060 RL_FNC_UWORD 0 CM_RAW 0 65535 /begin AXIS_DESCR COM_AXIS AXIN_093 CM_RAW 17 0 65535 AXIS_PTS_REF AX_093 /end AXIS_DESCR /end CHARACTERISTIC
/begin CHARACTERISTIC CAL_6AE_1 "кривая #6AE 17: ? [2/2]" CURVE 0x08071082 RL_FNC_UWORD 0 CM_RAW 0 65535 /begin AXIS_DESCR COM_AXIS AXIN_093 CM_RAW 17 0 65535 AXIS_PTS_REF AX_093 /end AXIS_DESCR /end CHARACTERISTIC
/begin CHARACTERISTIC CAL_6AF_0 "кривая #6AF 17: ? [1/2]" CURVE 0x080710A4 RL_FNC_UWORD 0 CM_RAW 0 65535 /begin AXIS_DESCR COM_AXIS AXIN_093 CM_RAW 17 0 65535 AXIS_PTS_REF AX_093 /end AXIS_DESCR /end CHARACTERISTIC
/begin CHARACTERISTIC CAL_6AF_1 "кривая #6AF 17: ? [2/2]" CURVE 0x080710C6 RL_FNC_UWORD 0 CM_RAW 0 65535 /begin AXIS_DESCR COM_AXIS AXIN_093 CM_RAW 17 0 65535 AXIS_PTS_REF AX_093 /end AXIS_DESCR /end CHARACTERISTIC
/begin CHARACTERISTIC CAL_6B1 "значение #6B1" VALUE 0x08071116 RL_FNC_UWORD 0 CM_RAW 0 65535 /end CHARACTERISTIC
/begin CHARACTERISTIC CAL_6B2 "значение #6B2" VALUE 0x08071114 RL_FNC_UWORD 0 CM_RAW 0 65535 /end CHARACTERISTIC
/begin CHARACTERISTIC CAL_6B3 "массив #6B3 [знак по значениям]" VAL_BLK 0x08071C3C RL_FNC_SWORD 0 CM_RAW -32768 32767 MATRIX_DIM 2 1 1 /end CHARACTERISTIC
/begin CHARACTERISTIC CAL_6B4 "массив #6B4 [знак по значениям]" VAL_BLK 0x08071C38 RL_FNC_SWORD 0 CM_RAW -32768 32767 MATRIX_DIM 2 1 1 /end CHARACTERISTIC
/begin CHARACTERISTIC CAL_6B5 "массив #6B5" VAL_BLK 0x08073614 RL_FNC_UWORD 0 CM_RAW 0 65535 MATRIX_DIM 2 1 1 /end CHARACTERISTIC
/begin CHARACTERISTIC CAL_6B6 "значение #6B6" VALUE 0x08073618 RL_FNC_SLONG 0 CM_RAW -2.14748e+09 2.14748e+09 /end CHARACTERISTIC
/begin CHARACTERISTIC CAL_6B7 "значение #6B7" VALUE 0x0807361C RL_FNC_UWORD 0 CM_RAW 0 65535 /end CHARACTERISTIC
/begin CHARACTERISTIC CAL_6B8 "массив #6B8 [знак по значениям]" VAL_BLK 0x08073624 RL_FNC_SWORD 0 CM_RAW -32768 32767 MATRIX_DIM 2 1 1 /end CHARACTERISTIC
/begin CHARACTERISTIC CAL_6B9 "массив #6B9 [знак по значениям]" VAL_BLK 0x08073620 RL_FNC_SWORD 0 CM_RAW -32768 32767 MATRIX_DIM 2 1 1 /end CHARACTERISTIC
/begin CHARACTERISTIC CAL_6BA "кривая #6BA 11: ?" CURVE 0x08071C58 RL_FNC_UWORD 0 CM_RAW 0 65535
 /begin AXIS_DESCR COM_AXIS AXIN_0B4 CM_RAW 11 -32768 32767 AXIS_PTS_REF AX_0B4 /end AXIS_DESCR
/end CHARACTERISTIC
/begin CHARACTERISTIC CAL_6BB "кривая #6BB 8: GEAR" CURVE 0x08071CDC RL_FNC_UWORD 0 CM_RAW 0 65535
 /begin AXIS_DESCR COM_AXIS AXIN_05E_GEAR CM_RAW 8 -128 127 AXIS_PTS_REF AX_05E_GEAR /end AXIS_DESCR
/end CHARACTERISTIC
/begin CHARACTERISTIC CAL_6BC "кривая #6BC 8: GEAR" CURVE 0x08071CBC RL_FNC_UWORD 0 CM_RAW 0 65535
 /begin AXIS_DESCR COM_AXIS AXIN_05E_GEAR CM_RAW 8 -128 127 AXIS_PTS_REF AX_05E_GEAR /end AXIS_DESCR
/end CHARACTERISTIC
/begin CHARACTERISTIC CAL_6BD "кривая #6BD 8: GEAR" CURVE 0x08071CCC RL_FNC_UWORD 0 CM_RAW 0 65535
 /begin AXIS_DESCR COM_AXIS AXIN_05E_GEAR CM_RAW 8 -128 127 AXIS_PTS_REF AX_05E_GEAR /end AXIS_DESCR
/end CHARACTERISTIC
/begin CHARACTERISTIC CAL_6BE_0 "карта #6BE 9x17: ? × ? [1/2] [знак по значениям]" MAP 0x08071D0C RL_FNC_SWORD 0 CM_RAW -32768 32767 /begin AXIS_DESCR COM_AXIS AXIN_0E6 CM_RAW 17 0 65535 AXIS_PTS_REF AX_0E6 /end AXIS_DESCR /begin AXIS_DESCR COM_AXIS AXIN_0B6 CM_RAW 9 0 65535 AXIS_PTS_REF AX_0B6 /end AXIS_DESCR /end CHARACTERISTIC
/begin CHARACTERISTIC CAL_6BE_1 "карта #6BE 9x17: ? × ? [2/2] [знак по значениям]" MAP 0x08071E3E RL_FNC_SWORD 0 CM_RAW -32768 32767 /begin AXIS_DESCR COM_AXIS AXIN_0E6 CM_RAW 17 0 65535 AXIS_PTS_REF AX_0E6 /end AXIS_DESCR /begin AXIS_DESCR COM_AXIS AXIN_0B6 CM_RAW 9 0 65535 AXIS_PTS_REF AX_0B6 /end AXIS_DESCR /end CHARACTERISTIC
/begin CHARACTERISTIC CAL_6BF_0 "кривая #6BF 8: N [1/2]" CURVE 0x08071CEC RL_FNC_UWORD 0 CM_RAW 0 65535
 /begin AXIS_DESCR COM_AXIS AXIN_050_N CM_RPM2 8 0 32767.5 AXIS_PTS_REF AX_050_N /end AXIS_DESCR
/end CHARACTERISTIC
/begin CHARACTERISTIC CAL_6BF_1 "кривая #6BF 8: N [2/2]" CURVE 0x08071CFC RL_FNC_UWORD 0 CM_RAW 0 65535
 /begin AXIS_DESCR COM_AXIS AXIN_050_N CM_RPM2 8 0 32767.5 AXIS_PTS_REF AX_050_N /end AXIS_DESCR
/end CHARACTERISTIC
/begin CHARACTERISTIC CAL_6C0_0 "карта #6C0 9x17: ? × ? [1/2] [знак по значениям]" MAP 0x08071F70 RL_FNC_SWORD 0 CM_RAW -32768 32767 /begin AXIS_DESCR COM_AXIS AXIN_093 CM_RAW 17 0 65535 AXIS_PTS_REF AX_093 /end AXIS_DESCR /begin AXIS_DESCR COM_AXIS AXIN_0B6 CM_RAW 9 0 65535 AXIS_PTS_REF AX_0B6 /end AXIS_DESCR /end CHARACTERISTIC
/begin CHARACTERISTIC CAL_6C0_1 "карта #6C0 9x17: ? × ? [2/2] [знак по значениям]" MAP 0x080720A2 RL_FNC_SWORD 0 CM_RAW -32768 32767 /begin AXIS_DESCR COM_AXIS AXIN_093 CM_RAW 17 0 65535 AXIS_PTS_REF AX_093 /end AXIS_DESCR /begin AXIS_DESCR COM_AXIS AXIN_0B6 CM_RAW 9 0 65535 AXIS_PTS_REF AX_0B6 /end AXIS_DESCR /end CHARACTERISTIC
/begin CHARACTERISTIC CAL_6C1_0 "кривая #6C1 17: ? [1/2] [знак по значениям]" CURVE 0x080721D4 RL_FNC_SWORD 0 CM_RAW -32768 32767 /begin AXIS_DESCR COM_AXIS AXIN_0E6 CM_RAW 17 0 65535 AXIS_PTS_REF AX_0E6 /end AXIS_DESCR /end CHARACTERISTIC
/begin CHARACTERISTIC CAL_6C1_1 "кривая #6C1 17: ? [2/2] [знак по значениям]" CURVE 0x080721F6 RL_FNC_SWORD 0 CM_RAW -32768 32767 /begin AXIS_DESCR COM_AXIS AXIN_0E6 CM_RAW 17 0 65535 AXIS_PTS_REF AX_0E6 /end AXIS_DESCR /end CHARACTERISTIC
/begin CHARACTERISTIC CAL_6C2 "массив #6C2" VAL_BLK 0x08072218 RL_FNC_UWORD 0 CM_RAW 0 65535 MATRIX_DIM 2 1 1 /end CHARACTERISTIC
/begin CHARACTERISTIC CAL_6C3_0 "карта #6C3 9x17: ? × ? [1/2] [знак по значениям]" MAP 0x0807221C RL_FNC_SWORD 0 CM_RAW -32768 32767 /begin AXIS_DESCR COM_AXIS AXIN_0B5 CM_RAW 17 0 65535 AXIS_PTS_REF AX_0B5 /end AXIS_DESCR /begin AXIS_DESCR COM_AXIS AXIN_0B6 CM_RAW 9 0 65535 AXIS_PTS_REF AX_0B6 /end AXIS_DESCR /end CHARACTERISTIC
/begin CHARACTERISTIC CAL_6C3_1 "карта #6C3 9x17: ? × ? [2/2] [знак по значениям]" MAP 0x0807234E RL_FNC_SWORD 0 CM_RAW -32768 32767 /begin AXIS_DESCR COM_AXIS AXIN_0B5 CM_RAW 17 0 65535 AXIS_PTS_REF AX_0B5 /end AXIS_DESCR /begin AXIS_DESCR COM_AXIS AXIN_0B6 CM_RAW 9 0 65535 AXIS_PTS_REF AX_0B6 /end AXIS_DESCR /end CHARACTERISTIC
/begin CHARACTERISTIC CAL_6C4_0 "карта #6C4 9x17: ? × ? [1/2]" MAP 0x08072480 RL_FNC_UWORD 0 CM_RAW 0 65535 /begin AXIS_DESCR COM_AXIS AXIN_0E6 CM_RAW 17 0 65535 AXIS_PTS_REF AX_0E6 /end AXIS_DESCR /begin AXIS_DESCR COM_AXIS AXIN_0B6 CM_RAW 9 0 65535 AXIS_PTS_REF AX_0B6 /end AXIS_DESCR /end CHARACTERISTIC
/begin CHARACTERISTIC CAL_6C4_1 "карта #6C4 9x17: ? × ? [2/2]" MAP 0x080725B2 RL_FNC_UWORD 0 CM_RAW 0 65535 /begin AXIS_DESCR COM_AXIS AXIN_0E6 CM_RAW 17 0 65535 AXIS_PTS_REF AX_0E6 /end AXIS_DESCR /begin AXIS_DESCR COM_AXIS AXIN_0B6 CM_RAW 9 0 65535 AXIS_PTS_REF AX_0B6 /end AXIS_DESCR /end CHARACTERISTIC
/begin CHARACTERISTIC CAL_6C5 "значение #6C5" VALUE 0x080726E4 RL_FNC_UWORD 0 CM_RAW 0 65535 /end CHARACTERISTIC
/begin CHARACTERISTIC CAL_6C6 "массив #6C6" VAL_BLK 0x080726E8 RL_FNC_UWORD 0 CM_RAW 0 65535 MATRIX_DIM 2 1 1 /end CHARACTERISTIC
/begin CHARACTERISTIC CAL_6C7 "массив #6C7" VAL_BLK 0x080726EC RL_FNC_UWORD 0 CM_RAW 0 65535 MATRIX_DIM 2 1 1 /end CHARACTERISTIC
/begin CHARACTERISTIC CAL_6C8 "массив #6C8" VAL_BLK 0x080726F0 RL_FNC_UWORD 0 CM_RAW 0 65535 MATRIX_DIM 2 1 1 /end CHARACTERISTIC
/begin CHARACTERISTIC CAL_6C9 "кривая #6C9 9: TCOOL" CURVE 0x080726F8 RL_FNC_UWORD 0 CM_RAW 0 65535
 /begin AXIS_DESCR COM_AXIS AXIN_00A_TCOOL CM_C128 9 -256 255.992 AXIS_PTS_REF AX_00A_TCOOL /end AXIS_DESCR
/end CHARACTERISTIC
/begin CHARACTERISTIC CAL_6CA "массив #6CA" VAL_BLK 0x0807270C RL_FNC_UWORD 0 CM_RAW 0 65535 MATRIX_DIM 2 1 1 /end CHARACTERISTIC
/begin CHARACTERISTIC CAL_6CB "кривая #6CB 195: ?" CURVE 0x08070A9C RL_FNC_UWORD 0 CM_RAW 0 65535 /begin AXIS_DESCR COM_AXIS AXIN_0B9 CM_RAW 195 0 65535 AXIS_PTS_REF AX_0B9 /end AXIS_DESCR /end CHARACTERISTIC
/begin CHARACTERISTIC CAL_6CC "кривая #6CC 28: ?" CURVE 0x08070C8C RL_FNC_UWORD 0 CM_RAW 0 65535 /begin AXIS_DESCR COM_AXIS AXIN_0B8 CM_RAW 28 0 65535 AXIS_PTS_REF AX_0B8 /end AXIS_DESCR /end CHARACTERISTIC
/begin CHARACTERISTIC CAL_6CD "массив #6CD" VAL_BLK 0x08070CC4 RL_FNC_UWORD 0 CM_RAW 0 65535 MATRIX_DIM 2 1 1 /end CHARACTERISTIC
/begin CHARACTERISTIC CAL_6CE "массив #6CE" VAL_BLK 0x08071110 RL_FNC_UWORD 0 CM_RAW 0 65535 MATRIX_DIM 2 1 1 /end CHARACTERISTIC
/begin CHARACTERISTIC CAL_6CF "карта #6CF 17x17: N × LOAD [знак по значениям]" MAP 0x08071378 RL_FNC_SWORD 0 CM_RAW -32768 32767
 /begin AXIS_DESCR COM_AXIS AXIN_05F_N CM_RPM2 17 0 32767.5 AXIS_PTS_REF AX_05F_N /end AXIS_DESCR
 /begin AXIS_DESCR COM_AXIS AXIN_0B7_LOAD CM_RAW 17 0 65535 AXIS_PTS_REF AX_0B7_LOAD /end AXIS_DESCR
/end CHARACTERISTIC
/begin CHARACTERISTIC CAL_6D0 "карта #6D0 17x17: N × LOAD [знак по значениям]" MAP 0x08071134 RL_FNC_SWORD 0 CM_RAW -32768 32767
 /begin AXIS_DESCR COM_AXIS AXIN_05F_N CM_RPM2 17 0 32767.5 AXIS_PTS_REF AX_05F_N /end AXIS_DESCR
 /begin AXIS_DESCR COM_AXIS AXIN_0B7_LOAD CM_RAW 17 0 65535 AXIS_PTS_REF AX_0B7_LOAD /end AXIS_DESCR
/end CHARACTERISTIC
/begin CHARACTERISTIC CAL_6D1 "карта #6D1 17x17: N × LOAD [знак по значениям]" MAP 0x080715BC RL_FNC_SWORD 0 CM_RAW -32768 32767
 /begin AXIS_DESCR COM_AXIS AXIN_05F_N CM_RPM2 17 0 32767.5 AXIS_PTS_REF AX_05F_N /end AXIS_DESCR
 /begin AXIS_DESCR COM_AXIS AXIN_0B7_LOAD CM_RAW 17 0 65535 AXIS_PTS_REF AX_0B7_LOAD /end AXIS_DESCR
/end CHARACTERISTIC
/begin CHARACTERISTIC CAL_6D2 "карта #6D2 17x17: N × LOAD [знак по значениям]" MAP 0x08071800 RL_FNC_SWORD 0 CM_RAW -32768 32767
 /begin AXIS_DESCR COM_AXIS AXIN_05F_N CM_RPM2 17 0 32767.5 AXIS_PTS_REF AX_05F_N /end AXIS_DESCR
 /begin AXIS_DESCR COM_AXIS AXIN_0B7_LOAD CM_RAW 17 0 65535 AXIS_PTS_REF AX_0B7_LOAD /end AXIS_DESCR
/end CHARACTERISTIC
/begin CHARACTERISTIC CAL_6D3 "массив #6D3 [знак по значениям]" VAL_BLK 0x08071BAC RL_FNC_SWORD 0 CM_RAW -32768 32767 MATRIX_DIM 2 1 1 /end CHARACTERISTIC
/begin CHARACTERISTIC CAL_6D4 "кривая #6D4 9: TCOOL" CURVE 0x08070C40 RL_FNC_UWORD 0 CM_RAW 0 65535
 /begin AXIS_DESCR COM_AXIS AXIN_00A_TCOOL CM_C128 9 -256 255.992 AXIS_PTS_REF AX_00A_TCOOL /end AXIS_DESCR
/end CHARACTERISTIC
/begin CHARACTERISTIC CAL_6D5 "кривая #6D5 17: N" CURVE 0x08070C68 RL_FNC_UWORD 0 CM_RAW 0 65535
 /begin AXIS_DESCR COM_AXIS AXIN_05F_N CM_RPM2 17 0 32767.5 AXIS_PTS_REF AX_05F_N /end AXIS_DESCR
/end CHARACTERISTIC
/begin CHARACTERISTIC CAL_6D6 "карта #6D6 9x9: N × TCOOL" MAP 0x08071A78 RL_FNC_UWORD 0 CM_RAW 0 65535
 /begin AXIS_DESCR COM_AXIS AXIN_0AD_N CM_RPM2 9 0 32767.5 AXIS_PTS_REF AX_0AD_N /end AXIS_DESCR
 /begin AXIS_DESCR COM_AXIS AXIN_00A_TCOOL CM_C128 9 -256 255.992 AXIS_PTS_REF AX_00A_TCOOL /end AXIS_DESCR
/end CHARACTERISTIC
/begin CHARACTERISTIC CAL_6D7 "кривая #6D7 9: TCOOL" CURVE 0x08071A64 RL_FNC_UWORD 0 CM_RAW 0 65535
 /begin AXIS_DESCR COM_AXIS AXIN_00A_TCOOL CM_C128 9 -256 255.992 AXIS_PTS_REF AX_00A_TCOOL /end AXIS_DESCR
/end CHARACTERISTIC
/begin CHARACTERISTIC CAL_6D8 "значение #6D8" VALUE 0x080733F4 RL_FNC_UWORD 0 CM_RAW 0 65535 /end CHARACTERISTIC
/begin CHARACTERISTIC CAL_6D9 "карта #6D9 9x9: N × TCOOL" MAP 0x080737B8 RL_FNC_UWORD 0 CM_RAW 0 65535
 /begin AXIS_DESCR COM_AXIS AXIN_0AD_N CM_RPM2 9 0 32767.5 AXIS_PTS_REF AX_0AD_N /end AXIS_DESCR
 /begin AXIS_DESCR COM_AXIS AXIN_00A_TCOOL CM_C128 9 -256 255.992 AXIS_PTS_REF AX_00A_TCOOL /end AXIS_DESCR
/end CHARACTERISTIC
/begin CHARACTERISTIC CAL_6DA "кривая #6DA 9: N" CURVE 0x080737A4 RL_FNC_UWORD 0 CM_RAW 0 65535
 /begin AXIS_DESCR COM_AXIS AXIN_0AD_N CM_RPM2 9 0 32767.5 AXIS_PTS_REF AX_0AD_N /end AXIS_DESCR
/end CHARACTERISTIC
/begin CHARACTERISTIC CAL_6DB "кривая #6DB 14: ?" CURVE 0x08070C24 RL_FNC_UWORD 0 CM_RAW 0 65535 /begin AXIS_DESCR COM_AXIS AXIN_081 CM_RAW 14 0 65535 AXIS_PTS_REF AX_081 /end AXIS_DESCR /end CHARACTERISTIC
/begin CHARACTERISTIC CAL_6DC "массив #6DC" VAL_BLK 0x080710E8 RL_FNC_UWORD 0 CM_RAW 0 65535 MATRIX_DIM 2 1 1 /end CHARACTERISTIC
/begin CHARACTERISTIC CAL_6DD "массив #6DD" VAL_BLK 0x080710EC RL_FNC_UWORD 0 CM_RAW 0 65535 MATRIX_DIM 2 1 1 /end CHARACTERISTIC
/begin CHARACTERISTIC CAL_6DE "карта #6DE 8x9: ? × ?" MAP 0x08073364 RL_FNC_UWORD 0 CM_RAW 0 65535 /begin AXIS_DESCR COM_AXIS AXIN_0AE CM_RAW 9 0 65535 AXIS_PTS_REF AX_0AE /end AXIS_DESCR /begin AXIS_DESCR COM_AXIS AXIN_0B0 CM_RAW 8 0 65535 AXIS_PTS_REF AX_0B0 /end AXIS_DESCR /end CHARACTERISTIC
/begin CHARACTERISTIC CAL_6DF "значение #6DF" VALUE 0x080733F6 RL_FNC_UWORD 0 CM_RAW 0 65535 /end CHARACTERISTIC
/begin CHARACTERISTIC CAL_6E0 "карта #6E0 8x8: N × ?" MAP 0x08073478 RL_FNC_UWORD 0 CM_RAW 0 65535
 /begin AXIS_DESCR COM_AXIS AXIN_0AC_N CM_RPM2 8 0 32767.5 AXIS_PTS_REF AX_0AC_N /end AXIS_DESCR
 /begin AXIS_DESCR COM_AXIS AXIN_0AF CM_RAW 8 0 65535 AXIS_PTS_REF AX_0AF /end AXIS_DESCR
/end CHARACTERISTIC
/begin CHARACTERISTIC CAL_6E1 "карта #6E1 8x8: N × ?" MAP 0x080733F8 RL_FNC_UWORD 0 CM_RAW 0 65535
 /begin AXIS_DESCR COM_AXIS AXIN_0AC_N CM_RPM2 8 0 32767.5 AXIS_PTS_REF AX_0AC_N /end AXIS_DESCR
 /begin AXIS_DESCR COM_AXIS AXIN_0AF CM_RAW 8 0 65535 AXIS_PTS_REF AX_0AF /end AXIS_DESCR
/end CHARACTERISTIC
/begin CHARACTERISTIC CAL_6E2 "карта #6E2 8x8: N × ?" MAP 0x080734F8 RL_FNC_UWORD 0 CM_RAW 0 65535
 /begin AXIS_DESCR COM_AXIS AXIN_0AC_N CM_RPM2 8 0 32767.5 AXIS_PTS_REF AX_0AC_N /end AXIS_DESCR
 /begin AXIS_DESCR COM_AXIS AXIN_0AF CM_RAW 8 0 65535 AXIS_PTS_REF AX_0AF /end AXIS_DESCR
/end CHARACTERISTIC
/begin CHARACTERISTIC CAL_6E3 "карта #6E3 8x9: N × GEAR" MAP 0x08073578 RL_FNC_UWORD 0 CM_RAW 0 65535
 /begin AXIS_DESCR COM_AXIS AXIN_0AD_N CM_RPM2 9 0 32767.5 AXIS_PTS_REF AX_0AD_N /end AXIS_DESCR
 /begin AXIS_DESCR COM_AXIS AXIN_05E_GEAR CM_RAW 8 -128 127 AXIS_PTS_REF AX_05E_GEAR /end AXIS_DESCR
/end CHARACTERISTIC
/begin CHARACTERISTIC CAL_6E4 "кривая #6E4 8: ?" CURVE 0x0807385C RL_FNC_SWORD 0 CM_RAW -32768 32767 /begin AXIS_DESCR COM_AXIS AXIN_0AF CM_RAW 8 0 65535 AXIS_PTS_REF AX_0AF /end AXIS_DESCR /end CHARACTERISTIC
/begin CHARACTERISTIC CAL_6E5 "кривая #6E5 17: N" CURVE 0x080691BC RL_FNC_UWORD 0 CM_RAW 0 65535
 /begin AXIS_DESCR COM_AXIS AXIN_001_N CM_RPM2 17 0 32767.5 AXIS_PTS_REF AX_001_N /end AXIS_DESCR
/end CHARACTERISTIC
/begin CHARACTERISTIC CAL_6E6 "значение #6E6" VALUE 0x080691E8 RL_FNC_UWORD 0 CM_RAW 0 65535 /end CHARACTERISTIC
/begin CHARACTERISTIC CAL_6E7 "значение #6E7" VALUE 0x08069278 RL_FNC_SBYTE 0 CM_RAW -128 127 /end CHARACTERISTIC
/begin CHARACTERISTIC CAL_6E8 "значение #6E8" VALUE 0x08069279 RL_FNC_SBYTE 0 CM_RAW -128 127 /end CHARACTERISTIC
/begin CHARACTERISTIC CAL_6E9_0 "кривая #6E9 17: N [1/2]" CURVE 0x08069388 RL_FNC_UWORD 0 CM_RAW 0 65535
 /begin AXIS_DESCR COM_AXIS AXIN_001_N CM_RPM2 17 0 32767.5 AXIS_PTS_REF AX_001_N /end AXIS_DESCR
/end CHARACTERISTIC
/begin CHARACTERISTIC CAL_6E9_1 "кривая #6E9 17: N [2/2]" CURVE 0x080693AA RL_FNC_UWORD 0 CM_RAW 0 65535
 /begin AXIS_DESCR COM_AXIS AXIN_001_N CM_RPM2 17 0 32767.5 AXIS_PTS_REF AX_001_N /end AXIS_DESCR
/end CHARACTERISTIC
/begin CHARACTERISTIC CAL_6EA "значение #6EA" VALUE 0x0807386E RL_FNC_UWORD 0 CM_RAW 0 65535 /end CHARACTERISTIC
/begin CHARACTERISTIC CAL_6EB "значение #6EB" VALUE 0x08073A8A RL_FNC_UWORD 0 CM_RAW 0 65535 /end CHARACTERISTIC
/begin CHARACTERISTIC CAL_6EC_0 "кривая #6EC 8: N [1/13]" CURVE 0x08073880 RL_FNC_UWORD 0 CM_RAW 0 65535
 /begin AXIS_DESCR COM_AXIS AXIN_050_N CM_RPM2 8 0 32767.5 AXIS_PTS_REF AX_050_N /end AXIS_DESCR
/end CHARACTERISTIC
/begin CHARACTERISTIC CAL_6EC_1 "кривая #6EC 8: N [2/13]" CURVE 0x08073890 RL_FNC_UWORD 0 CM_RAW 0 65535
 /begin AXIS_DESCR COM_AXIS AXIN_050_N CM_RPM2 8 0 32767.5 AXIS_PTS_REF AX_050_N /end AXIS_DESCR
/end CHARACTERISTIC
/begin CHARACTERISTIC CAL_6EC_2 "кривая #6EC 8: N [3/13]" CURVE 0x080738A0 RL_FNC_UWORD 0 CM_RAW 0 65535
 /begin AXIS_DESCR COM_AXIS AXIN_050_N CM_RPM2 8 0 32767.5 AXIS_PTS_REF AX_050_N /end AXIS_DESCR
/end CHARACTERISTIC
/begin CHARACTERISTIC CAL_6EC_3 "кривая #6EC 8: N [4/13]" CURVE 0x080738B0 RL_FNC_UWORD 0 CM_RAW 0 65535
 /begin AXIS_DESCR COM_AXIS AXIN_050_N CM_RPM2 8 0 32767.5 AXIS_PTS_REF AX_050_N /end AXIS_DESCR
/end CHARACTERISTIC
/begin CHARACTERISTIC CAL_6EC_4 "кривая #6EC 8: N [5/13]" CURVE 0x080738C0 RL_FNC_UWORD 0 CM_RAW 0 65535
 /begin AXIS_DESCR COM_AXIS AXIN_050_N CM_RPM2 8 0 32767.5 AXIS_PTS_REF AX_050_N /end AXIS_DESCR
/end CHARACTERISTIC
/begin CHARACTERISTIC CAL_6EC_5 "кривая #6EC 8: N [6/13]" CURVE 0x080738D0 RL_FNC_UWORD 0 CM_RAW 0 65535
 /begin AXIS_DESCR COM_AXIS AXIN_050_N CM_RPM2 8 0 32767.5 AXIS_PTS_REF AX_050_N /end AXIS_DESCR
/end CHARACTERISTIC
/begin CHARACTERISTIC CAL_6EC_6 "кривая #6EC 8: N [7/13]" CURVE 0x080738E0 RL_FNC_UWORD 0 CM_RAW 0 65535
 /begin AXIS_DESCR COM_AXIS AXIN_050_N CM_RPM2 8 0 32767.5 AXIS_PTS_REF AX_050_N /end AXIS_DESCR
/end CHARACTERISTIC
/begin CHARACTERISTIC CAL_6EC_7 "кривая #6EC 8: N [8/13]" CURVE 0x080738F0 RL_FNC_UWORD 0 CM_RAW 0 65535
 /begin AXIS_DESCR COM_AXIS AXIN_050_N CM_RPM2 8 0 32767.5 AXIS_PTS_REF AX_050_N /end AXIS_DESCR
/end CHARACTERISTIC
/begin CHARACTERISTIC CAL_6EC_8 "кривая #6EC 8: N [9/13]" CURVE 0x08073900 RL_FNC_UWORD 0 CM_RAW 0 65535
 /begin AXIS_DESCR COM_AXIS AXIN_050_N CM_RPM2 8 0 32767.5 AXIS_PTS_REF AX_050_N /end AXIS_DESCR
/end CHARACTERISTIC
/begin CHARACTERISTIC CAL_6EC_9 "кривая #6EC 8: N [10/13]" CURVE 0x08073910 RL_FNC_UWORD 0 CM_RAW 0 65535
 /begin AXIS_DESCR COM_AXIS AXIN_050_N CM_RPM2 8 0 32767.5 AXIS_PTS_REF AX_050_N /end AXIS_DESCR
/end CHARACTERISTIC
/begin CHARACTERISTIC CAL_6EC_10 "кривая #6EC 8: N [11/13]" CURVE 0x08073920 RL_FNC_UWORD 0 CM_RAW 0 65535
 /begin AXIS_DESCR COM_AXIS AXIN_050_N CM_RPM2 8 0 32767.5 AXIS_PTS_REF AX_050_N /end AXIS_DESCR
/end CHARACTERISTIC
/begin CHARACTERISTIC CAL_6EC_11 "кривая #6EC 8: N [12/13]" CURVE 0x08073930 RL_FNC_UWORD 0 CM_RAW 0 65535
 /begin AXIS_DESCR COM_AXIS AXIN_050_N CM_RPM2 8 0 32767.5 AXIS_PTS_REF AX_050_N /end AXIS_DESCR
/end CHARACTERISTIC
/begin CHARACTERISTIC CAL_6EC_12 "кривая #6EC 8: N [13/13]" CURVE 0x08073940 RL_FNC_UWORD 0 CM_RAW 0 65535
 /begin AXIS_DESCR COM_AXIS AXIN_050_N CM_RPM2 8 0 32767.5 AXIS_PTS_REF AX_050_N /end AXIS_DESCR
/end CHARACTERISTIC
/begin CHARACTERISTIC CAL_6ED "карта #6ED 13x2: ? × ?" MAP 0x08073A70 RL_FNC_SBYTE 0 CM_RAW -128 127 /begin AXIS_DESCR COM_AXIS AXIN_0BC CM_RAW 2 -128 127 AXIS_PTS_REF AX_0BC /end AXIS_DESCR /begin AXIS_DESCR COM_AXIS AXIN_0BA CM_RAW 13 -128 127 AXIS_PTS_REF AX_0BA /end AXIS_DESCR /end CHARACTERISTIC
/begin CHARACTERISTIC CAL_6EE "карта #6EE 13x2: ? × ?" MAP 0x08073A54 RL_FNC_SBYTE 0 CM_RAW -128 127 /begin AXIS_DESCR COM_AXIS AXIN_0BC CM_RAW 2 -128 127 AXIS_PTS_REF AX_0BC /end AXIS_DESCR /begin AXIS_DESCR COM_AXIS AXIN_0BA CM_RAW 13 -128 127 AXIS_PTS_REF AX_0BA /end AXIS_DESCR /end CHARACTERISTIC
/begin CHARACTERISTIC CAL_6EF_0 "кривая #6EF 10: N [1/13]" CURVE 0x08073950 RL_FNC_UWORD 0 CM_RAW 0 65535
 /begin AXIS_DESCR COM_AXIS AXIN_00C_N CM_RPM2 10 0 32767.5 AXIS_PTS_REF AX_00C_N /end AXIS_DESCR
/end CHARACTERISTIC
/begin CHARACTERISTIC CAL_6EF_1 "кривая #6EF 10: N [2/13]" CURVE 0x08073964 RL_FNC_UWORD 0 CM_RAW 0 65535
 /begin AXIS_DESCR COM_AXIS AXIN_00C_N CM_RPM2 10 0 32767.5 AXIS_PTS_REF AX_00C_N /end AXIS_DESCR
/end CHARACTERISTIC
/begin CHARACTERISTIC CAL_6EF_2 "кривая #6EF 10: N [3/13]" CURVE 0x08073978 RL_FNC_UWORD 0 CM_RAW 0 65535
 /begin AXIS_DESCR COM_AXIS AXIN_00C_N CM_RPM2 10 0 32767.5 AXIS_PTS_REF AX_00C_N /end AXIS_DESCR
/end CHARACTERISTIC
/begin CHARACTERISTIC CAL_6EF_3 "кривая #6EF 10: N [4/13]" CURVE 0x0807398C RL_FNC_UWORD 0 CM_RAW 0 65535
 /begin AXIS_DESCR COM_AXIS AXIN_00C_N CM_RPM2 10 0 32767.5 AXIS_PTS_REF AX_00C_N /end AXIS_DESCR
/end CHARACTERISTIC
/begin CHARACTERISTIC CAL_6EF_4 "кривая #6EF 10: N [5/13]" CURVE 0x080739A0 RL_FNC_UWORD 0 CM_RAW 0 65535
 /begin AXIS_DESCR COM_AXIS AXIN_00C_N CM_RPM2 10 0 32767.5 AXIS_PTS_REF AX_00C_N /end AXIS_DESCR
/end CHARACTERISTIC
/begin CHARACTERISTIC CAL_6EF_5 "кривая #6EF 10: N [6/13]" CURVE 0x080739B4 RL_FNC_UWORD 0 CM_RAW 0 65535
 /begin AXIS_DESCR COM_AXIS AXIN_00C_N CM_RPM2 10 0 32767.5 AXIS_PTS_REF AX_00C_N /end AXIS_DESCR
/end CHARACTERISTIC
/begin CHARACTERISTIC CAL_6EF_6 "кривая #6EF 10: N [7/13]" CURVE 0x080739C8 RL_FNC_UWORD 0 CM_RAW 0 65535
 /begin AXIS_DESCR COM_AXIS AXIN_00C_N CM_RPM2 10 0 32767.5 AXIS_PTS_REF AX_00C_N /end AXIS_DESCR
/end CHARACTERISTIC
/begin CHARACTERISTIC CAL_6EF_7 "кривая #6EF 10: N [8/13]" CURVE 0x080739DC RL_FNC_UWORD 0 CM_RAW 0 65535
 /begin AXIS_DESCR COM_AXIS AXIN_00C_N CM_RPM2 10 0 32767.5 AXIS_PTS_REF AX_00C_N /end AXIS_DESCR
/end CHARACTERISTIC
/begin CHARACTERISTIC CAL_6EF_8 "кривая #6EF 10: N [9/13]" CURVE 0x080739F0 RL_FNC_UWORD 0 CM_RAW 0 65535
 /begin AXIS_DESCR COM_AXIS AXIN_00C_N CM_RPM2 10 0 32767.5 AXIS_PTS_REF AX_00C_N /end AXIS_DESCR
/end CHARACTERISTIC
/begin CHARACTERISTIC CAL_6EF_9 "кривая #6EF 10: N [10/13]" CURVE 0x08073A04 RL_FNC_UWORD 0 CM_RAW 0 65535
 /begin AXIS_DESCR COM_AXIS AXIN_00C_N CM_RPM2 10 0 32767.5 AXIS_PTS_REF AX_00C_N /end AXIS_DESCR
/end CHARACTERISTIC
/begin CHARACTERISTIC CAL_6EF_10 "кривая #6EF 10: N [11/13]" CURVE 0x08073A18 RL_FNC_UWORD 0 CM_RAW 0 65535
 /begin AXIS_DESCR COM_AXIS AXIN_00C_N CM_RPM2 10 0 32767.5 AXIS_PTS_REF AX_00C_N /end AXIS_DESCR
/end CHARACTERISTIC
/begin CHARACTERISTIC CAL_6EF_11 "кривая #6EF 10: N [12/13]" CURVE 0x08073A2C RL_FNC_UWORD 0 CM_RAW 0 65535
 /begin AXIS_DESCR COM_AXIS AXIN_00C_N CM_RPM2 10 0 32767.5 AXIS_PTS_REF AX_00C_N /end AXIS_DESCR
/end CHARACTERISTIC
/begin CHARACTERISTIC CAL_6EF_12 "кривая #6EF 10: N [13/13]" CURVE 0x08073A40 RL_FNC_UWORD 0 CM_RAW 0 65535
 /begin AXIS_DESCR COM_AXIS AXIN_00C_N CM_RPM2 10 0 32767.5 AXIS_PTS_REF AX_00C_N /end AXIS_DESCR
/end CHARACTERISTIC
/begin CHARACTERISTIC CAL_6F0 "значение #6F0" VALUE 0x08073A8E RL_FNC_UWORD 0 CM_RAW 0 65535 /end CHARACTERISTIC
/begin CHARACTERISTIC CAL_6F1_0 "кривая #6F1 8: ? [1/2]" CURVE 0x08073A90 RL_FNC_UWORD 0 CM_RAW 0 65535 /begin AXIS_DESCR COM_AXIS AXIN_0BB CM_RAW 8 0 65535 AXIS_PTS_REF AX_0BB /end AXIS_DESCR /end CHARACTERISTIC
/begin CHARACTERISTIC CAL_6F1_1 "кривая #6F1 8: ? [2/2]" CURVE 0x08073AA0 RL_FNC_UWORD 0 CM_RAW 0 65535 /begin AXIS_DESCR COM_AXIS AXIN_0BB CM_RAW 8 0 65535 AXIS_PTS_REF AX_0BB /end AXIS_DESCR /end CHARACTERISTIC
/begin CHARACTERISTIC CAL_6F2_0 "кривая #6F2 8: ? [1/2]" CURVE 0x08073AB0 RL_FNC_UWORD 0 CM_RAW 0 65535 /begin AXIS_DESCR COM_AXIS AXIN_0BB CM_RAW 8 0 65535 AXIS_PTS_REF AX_0BB /end AXIS_DESCR /end CHARACTERISTIC
/begin CHARACTERISTIC CAL_6F2_1 "кривая #6F2 8: ? [2/2]" CURVE 0x08073AC0 RL_FNC_UWORD 0 CM_RAW 0 65535 /begin AXIS_DESCR COM_AXIS AXIN_0BB CM_RAW 8 0 65535 AXIS_PTS_REF AX_0BB /end AXIS_DESCR /end CHARACTERISTIC
/begin CHARACTERISTIC CAL_6F3 "карта #6F3 13x2: ? × ?" MAP 0x08073AD0 RL_FNC_UWORD 0 CM_RAW 0 65535 /begin AXIS_DESCR COM_AXIS AXIN_0BC CM_RAW 2 -128 127 AXIS_PTS_REF AX_0BC /end AXIS_DESCR /begin AXIS_DESCR COM_AXIS AXIN_0BA CM_RAW 13 -128 127 AXIS_PTS_REF AX_0BA /end AXIS_DESCR /end CHARACTERISTIC
/begin CHARACTERISTIC CAL_6F4 "значение #6F4" VALUE 0x08073C24 RL_FNC_SWORD 0 CM_RAW -32768 32767 /end CHARACTERISTIC
/begin CHARACTERISTIC CAL_6F5 "значение #6F5" VALUE 0x08073B04 RL_FNC_SWORD 0 CM_RAW -32768 32767 /end CHARACTERISTIC
/begin CHARACTERISTIC CAL_6F6 "карта #6F6 2x2: ? × ?" MAP 0x08073B08 RL_FNC_UWORD 0 CM_RAW 0 65535 /begin AXIS_DESCR COM_AXIS AXIN_0BC CM_RAW 2 -128 127 AXIS_PTS_REF AX_0BC /end AXIS_DESCR /begin AXIS_DESCR COM_AXIS AXIN_0BC CM_RAW 2 -128 127 AXIS_PTS_REF AX_0BC /end AXIS_DESCR /end CHARACTERISTIC
/begin CHARACTERISTIC CAL_6F7_0 "кривая #6F7 8: ? [1/2]" CURVE 0x08073BB0 RL_FNC_UWORD 0 CM_RAW 0 65535 /begin AXIS_DESCR COM_AXIS AXIN_0BB CM_RAW 8 0 65535 AXIS_PTS_REF AX_0BB /end AXIS_DESCR /end CHARACTERISTIC
/begin CHARACTERISTIC CAL_6F7_1 "кривая #6F7 8: ? [2/2]" CURVE 0x08073BC0 RL_FNC_UWORD 0 CM_RAW 0 65535 /begin AXIS_DESCR COM_AXIS AXIN_0BB CM_RAW 8 0 65535 AXIS_PTS_REF AX_0BB /end AXIS_DESCR /end CHARACTERISTIC
/begin CHARACTERISTIC CAL_6F8_0 "кривая #6F8 8: ? [1/2]" CURVE 0x08073BD0 RL_FNC_UWORD 0 CM_RAW 0 65535 /begin AXIS_DESCR COM_AXIS AXIN_0BB CM_RAW 8 0 65535 AXIS_PTS_REF AX_0BB /end AXIS_DESCR /end CHARACTERISTIC
/begin CHARACTERISTIC CAL_6F8_1 "кривая #6F8 8: ? [2/2]" CURVE 0x08073BE0 RL_FNC_UWORD 0 CM_RAW 0 65535 /begin AXIS_DESCR COM_AXIS AXIN_0BB CM_RAW 8 0 65535 AXIS_PTS_REF AX_0BB /end AXIS_DESCR /end CHARACTERISTIC
/begin CHARACTERISTIC CAL_6F9 "карта #6F9 13x2: ? × ?" MAP 0x08073BF0 RL_FNC_UWORD 0 CM_RAW 0 65535 /begin AXIS_DESCR COM_AXIS AXIN_0BC CM_RAW 2 -128 127 AXIS_PTS_REF AX_0BC /end AXIS_DESCR /begin AXIS_DESCR COM_AXIS AXIN_0BA CM_RAW 13 -128 127 AXIS_PTS_REF AX_0BA /end AXIS_DESCR /end CHARACTERISTIC
/begin CHARACTERISTIC CAL_6FA "карта #6FA 8x10: N × ?" MAP 0x08073B10 RL_FNC_UWORD 0 CM_RAW 0 65535
 /begin AXIS_DESCR COM_AXIS AXIN_00C_N CM_RPM2 10 0 32767.5 AXIS_PTS_REF AX_00C_N /end AXIS_DESCR
 /begin AXIS_DESCR COM_AXIS AXIN_0BB CM_RAW 8 0 65535 AXIS_PTS_REF AX_0BB /end AXIS_DESCR
/end CHARACTERISTIC
/begin CHARACTERISTIC CAL_6FC "массив #6FC" VAL_BLK 0x0806841C RL_FNC_SBYTE 0 CM_RAW -128 127 MATRIX_DIM 4 1 1 /end CHARACTERISTIC
/begin CHARACTERISTIC CAL_6FD "значение #6FD" VALUE 0x08068484 RL_FNC_SLONG 0 CM_RAW -2.14748e+09 2.14748e+09 /end CHARACTERISTIC
/begin CHARACTERISTIC CAL_6FE "карта #6FE 3x9: ? × ?" MAP 0x08068468 RL_FNC_SBYTE 0 CM_RAW -128 127 /begin AXIS_DESCR COM_AXIS AXIN_070 CM_RAW 9 -128 127 AXIS_PTS_REF AX_070 /end AXIS_DESCR /begin AXIS_DESCR COM_AXIS AXIN_0BD CM_RAW 3 -128 127 AXIS_PTS_REF AX_0BD /end AXIS_DESCR /end CHARACTERISTIC
/begin CHARACTERISTIC CAL_6FF_0 "карта #6FF 3x6: ? × ? [1/4]" MAP 0x08068420 RL_FNC_SBYTE 0 CM_RAW -128 127 /begin AXIS_DESCR COM_AXIS AXIN_071 CM_RAW 6 -128 127 AXIS_PTS_REF AX_071 /end AXIS_DESCR /begin AXIS_DESCR COM_AXIS AXIN_0BD CM_RAW 3 -128 127 AXIS_PTS_REF AX_0BD /end AXIS_DESCR /end CHARACTERISTIC
/begin CHARACTERISTIC CAL_6FF_1 "карта #6FF 3x6: ? × ? [2/4]" MAP 0x08068432 RL_FNC_SBYTE 0 CM_RAW -128 127 /begin AXIS_DESCR COM_AXIS AXIN_071 CM_RAW 6 -128 127 AXIS_PTS_REF AX_071 /end AXIS_DESCR /begin AXIS_DESCR COM_AXIS AXIN_0BD CM_RAW 3 -128 127 AXIS_PTS_REF AX_0BD /end AXIS_DESCR /end CHARACTERISTIC
/begin CHARACTERISTIC CAL_6FF_2 "карта #6FF 3x6: ? × ? [3/4]" MAP 0x08068444 RL_FNC_SBYTE 0 CM_RAW -128 127 /begin AXIS_DESCR COM_AXIS AXIN_071 CM_RAW 6 -128 127 AXIS_PTS_REF AX_071 /end AXIS_DESCR /begin AXIS_DESCR COM_AXIS AXIN_0BD CM_RAW 3 -128 127 AXIS_PTS_REF AX_0BD /end AXIS_DESCR /end CHARACTERISTIC
/begin CHARACTERISTIC CAL_6FF_3 "карта #6FF 3x6: ? × ? [4/4]" MAP 0x08068456 RL_FNC_SBYTE 0 CM_RAW -128 127 /begin AXIS_DESCR COM_AXIS AXIN_071 CM_RAW 6 -128 127 AXIS_PTS_REF AX_071 /end AXIS_DESCR /begin AXIS_DESCR COM_AXIS AXIN_0BD CM_RAW 3 -128 127 AXIS_PTS_REF AX_0BD /end AXIS_DESCR /end CHARACTERISTIC
/begin CHARACTERISTIC CAL_700 "массив #700" VAL_BLK 0x08068F60 RL_FNC_SBYTE 0 CM_RAW -128 127 MATRIX_DIM 4 1 1 /end CHARACTERISTIC
/begin CHARACTERISTIC CAL_701 "значение #701" VALUE 0x08068F74 RL_FNC_SBYTE 0 CM_RAW -128 127 /end CHARACTERISTIC
/begin CHARACTERISTIC CAL_702 "массив #702" VAL_BLK 0x08068F80 RL_FNC_SLONG 0 CM_RAW -2.14748e+09 2.14748e+09 MATRIX_DIM 7 1 1 /end CHARACTERISTIC
/begin CHARACTERISTIC CAL_704 "значение #704" VALUE 0x08068244 RL_FNC_UWORD 0 CM_RAW 0 65535 /end CHARACTERISTIC
/begin CHARACTERISTIC CAL_705 "кривая #705 9: ?" CURVE 0x08068248 RL_FNC_UWORD 0 CM_RAW 0 65535 /begin AXIS_DESCR COM_AXIS AXIN_0BF CM_RAW 9 0 65535 AXIS_PTS_REF AX_0BF /end AXIS_DESCR /end CHARACTERISTIC
/begin CHARACTERISTIC CAL_706 "значение #706" VALUE 0x08068278 RL_FNC_UWORD 0 CM_RAW 0 65535 /end CHARACTERISTIC
/begin CHARACTERISTIC CAL_707 "карта #707 9x14: UBAT × TCOOL" MAP 0x080682DC RL_FNC_UWORD 0 CM_RAW 0 65535
 /begin AXIS_DESCR COM_AXIS AXIN_003_UBAT CM_RAW 14 0 65535 AXIS_PTS_REF AX_003_UBAT /end AXIS_DESCR
 /begin AXIS_DESCR COM_AXIS AXIN_00A_TCOOL CM_C128 9 -256 255.992 AXIS_PTS_REF AX_00A_TCOOL /end AXIS_DESCR
/end CHARACTERISTIC
/begin CHARACTERISTIC CAL_708 "значение #708" VALUE 0x080683D8 RL_FNC_UWORD 0 CM_RAW 0 65535 /end CHARACTERISTIC
/begin CHARACTERISTIC CAL_709 "кривая #709 17: N" CURVE 0x080682B8 RL_FNC_UWORD 0 CM_RAW 0 65535
 /begin AXIS_DESCR COM_AXIS AXIN_001_N CM_RPM2 17 0 32767.5 AXIS_PTS_REF AX_001_N /end AXIS_DESCR
/end CHARACTERISTIC
/begin CHARACTERISTIC CAL_70A "значение #70A" VALUE 0x080683DC RL_FNC_SLONG 0 CM_RAW -2.14748e+09 2.14748e+09 /end CHARACTERISTIC
/begin CHARACTERISTIC CAL_70B "кривая #70B 14: UBAT" CURVE 0x080683E0 RL_FNC_SLONG 0 CM_RAW -2.14748e+09 2.14748e+09
 /begin AXIS_DESCR COM_AXIS AXIN_003_UBAT CM_RAW 14 0 65535 AXIS_PTS_REF AX_003_UBAT /end AXIS_DESCR
/end CHARACTERISTIC
/begin CHARACTERISTIC CAL_70C "массив #70C [знак по значениям]" VAL_BLK 0x0806827C RL_FNC_SWORD 0 CM_RAW -32768 32767 MATRIX_DIM 2 1 1 /end CHARACTERISTIC
/begin CHARACTERISTIC CAL_70D "массив #70D" VAL_BLK 0x08068284 RL_FNC_SWORD 0 CM_RAW -32768 32767 MATRIX_DIM 2 1 1 /end CHARACTERISTIC
/begin CHARACTERISTIC CAL_70E "значение #70E" VALUE 0x08068290 RL_FNC_UWORD 0 CM_RAW 0 65535 /end CHARACTERISTIC
/begin CHARACTERISTIC CAL_70F "массив #70F" VAL_BLK 0x080681D4 RL_FNC_SWORD 0 CM_RAW -32768 32767 MATRIX_DIM 16 1 1 /end CHARACTERISTIC
/begin CHARACTERISTIC CAL_714 "массив #714" VAL_BLK 0x08068240 RL_FNC_SBYTE 0 CM_RAW -128 127 MATRIX_DIM 4 1 1 /end CHARACTERISTIC
/begin CHARACTERISTIC CAL_715 "значение #715" VALUE 0x08068270 RL_FNC_SBYTE 0 CM_RAW -128 127 /end CHARACTERISTIC
/begin CHARACTERISTIC CAL_716 "кривая #716 4: ?" CURVE 0x08061A4C RL_FNC_UWORD 0 CM_RAW 0 65535 /begin AXIS_DESCR COM_AXIS AXIN_0C2 CM_RAW 4 0 65535 AXIS_PTS_REF AX_0C2 /end AXIS_DESCR /end CHARACTERISTIC
/begin CHARACTERISTIC CAL_717 "значение #717" VALUE 0x08061A54 RL_FNC_UWORD 0 CM_RAW 0 65535 /end CHARACTERISTIC
/begin CHARACTERISTIC CAL_718 "кривая #718 4: ?" CURVE 0x08061A58 RL_FNC_UWORD 0 CM_RAW 0 65535 /begin AXIS_DESCR COM_AXIS AXIN_0C3 CM_RAW 4 0 65535 AXIS_PTS_REF AX_0C3 /end AXIS_DESCR /end CHARACTERISTIC
/begin CHARACTERISTIC CAL_719 "кривая #719 4: ?" CURVE 0x08061A64 RL_FNC_UWORD 0 CM_RAW 0 65535 /begin AXIS_DESCR COM_AXIS AXIN_0C1 CM_RAW 4 0 65535 AXIS_PTS_REF AX_0C1 /end AXIS_DESCR /end CHARACTERISTIC
/begin CHARACTERISTIC CAL_71A "значение #71A" VALUE 0x08061A60 RL_FNC_UWORD 0 CM_RAW 0 65535 /end CHARACTERISTIC
/begin CHARACTERISTIC CAL_71B "массив #71B" VAL_BLK 0x08061A70 RL_FNC_SWORD 0 CM_RAW -32768 32767 MATRIX_DIM 2 1 1 /end CHARACTERISTIC
/begin CHARACTERISTIC CAL_71C "значение #71C" VALUE 0x08061A6C RL_FNC_UWORD 0 CM_RAW 0 65535 /end CHARACTERISTIC
/begin CHARACTERISTIC CAL_71D "значение #71D" VALUE 0x08061A6E RL_FNC_UWORD 0 CM_RAW 0 65535 /end CHARACTERISTIC
/begin CHARACTERISTIC CAL_71E "значение #71E" VALUE 0x0807461A RL_FNC_UWORD 0 CM_RAW 0 65535 /end CHARACTERISTIC
/begin CHARACTERISTIC CAL_71F "массив #71F" VAL_BLK 0x0806BDC8 RL_FNC_UWORD 0 CM_RAW 0 65535 MATRIX_DIM 2 1 1 /end CHARACTERISTIC
/begin CHARACTERISTIC CAL_720_0 "кривая #720 10: N [1/2]" CURVE 0x0806BDE4 RL_FNC_UWORD 0 CM_RAW 0 65535
 /begin AXIS_DESCR COM_AXIS AXIN_00C_N CM_RPM2 10 0 32767.5 AXIS_PTS_REF AX_00C_N /end AXIS_DESCR
/end CHARACTERISTIC
/begin CHARACTERISTIC CAL_720_1 "кривая #720 10: N [2/2]" CURVE 0x0806BDF8 RL_FNC_UWORD 0 CM_RAW 0 65535
 /begin AXIS_DESCR COM_AXIS AXIN_00C_N CM_RPM2 10 0 32767.5 AXIS_PTS_REF AX_00C_N /end AXIS_DESCR
/end CHARACTERISTIC
/begin CHARACTERISTIC CAL_721 "значение #721" VALUE 0x0806C2DE RL_FNC_UWORD 0 CM_RAW 0 65535 /end CHARACTERISTIC
/begin CHARACTERISTIC CAL_722_0 "кривая #722 8: ? [1/2] [знак по значениям]" CURVE 0x0806CC94 RL_FNC_SWORD 0 CM_RAW -32768 32767 /begin AXIS_DESCR COM_AXIS AXIN_0C4 CM_RAW 8 0 65535 AXIS_PTS_REF AX_0C4 /end AXIS_DESCR /end CHARACTERISTIC
/begin CHARACTERISTIC CAL_722_1 "кривая #722 8: ? [2/2] [знак по значениям]" CURVE 0x0806CCA4 RL_FNC_SWORD 0 CM_RAW -32768 32767 /begin AXIS_DESCR COM_AXIS AXIN_0C4 CM_RAW 8 0 65535 AXIS_PTS_REF AX_0C4 /end AXIS_DESCR /end CHARACTERISTIC
/begin CHARACTERISTIC CAL_723_0 "кривая #723 8: ? [1/2]" CURVE 0x0806CCC0 RL_FNC_UWORD 0 CM_RAW 0 65535 /begin AXIS_DESCR COM_AXIS AXIN_0C4 CM_RAW 8 0 65535 AXIS_PTS_REF AX_0C4 /end AXIS_DESCR /end CHARACTERISTIC
/begin CHARACTERISTIC CAL_723_1 "кривая #723 8: ? [2/2]" CURVE 0x0806CCD0 RL_FNC_UWORD 0 CM_RAW 0 65535 /begin AXIS_DESCR COM_AXIS AXIN_0C4 CM_RAW 8 0 65535 AXIS_PTS_REF AX_0C4 /end AXIS_DESCR /end CHARACTERISTIC
/begin CHARACTERISTIC CAL_724_0 "кривая #724 8: ? [1/2]" CURVE 0x0806CCE0 RL_FNC_UWORD 0 CM_RAW 0 65535 /begin AXIS_DESCR COM_AXIS AXIN_0C4 CM_RAW 8 0 65535 AXIS_PTS_REF AX_0C4 /end AXIS_DESCR /end CHARACTERISTIC
/begin CHARACTERISTIC CAL_724_1 "кривая #724 8: ? [2/2]" CURVE 0x0806CCF0 RL_FNC_UWORD 0 CM_RAW 0 65535 /begin AXIS_DESCR COM_AXIS AXIN_0C4 CM_RAW 8 0 65535 AXIS_PTS_REF AX_0C4 /end AXIS_DESCR /end CHARACTERISTIC
/begin CHARACTERISTIC CAL_725 "массив #725" VAL_BLK 0x0806CD0C RL_FNC_UWORD 0 CM_RAW 0 65535 MATRIX_DIM 2 1 1 /end CHARACTERISTIC
/begin CHARACTERISTIC CAL_726 "значение #726" VALUE 0x0806BE0C RL_FNC_UWORD 0 CM_RAW 0 65535 /end CHARACTERISTIC
/begin CHARACTERISTIC CAL_727 "карта #727 25x24: N × ?" MAP 0x0806BE10 RL_FNC_UWORD 0 CM_RAW 0 65535
 /begin AXIS_DESCR COM_AXIS AXIN_0C5_N CM_RPM2 24 0 32767.5 AXIS_PTS_REF AX_0C5_N /end AXIS_DESCR
 /begin AXIS_DESCR COM_AXIS AXIN_0C7 CM_RAW 25 0 65535 AXIS_PTS_REF AX_0C7 /end AXIS_DESCR
/end CHARACTERISTIC
/begin CHARACTERISTIC CAL_728 "значение #728" VALUE 0x0806C2C0 RL_FNC_UWORD 0 CM_RAW 0 65535 /end CHARACTERISTIC
/begin CHARACTERISTIC CAL_729 "значение #729" VALUE 0x0806C2C2 RL_FNC_UWORD 0 CM_RAW 0 65535 /end CHARACTERISTIC
/begin CHARACTERISTIC CAL_72A "значение #72A" VALUE 0x0806C2DC RL_FNC_UWORD 0 CM_RAW 0 65535 /end CHARACTERISTIC
/begin CHARACTERISTIC CAL_72B_0 "кривая #72B 8: ? [1/2]" CURVE 0x0806CC54 RL_FNC_UWORD 0 CM_RAW 0 65535 /begin AXIS_DESCR COM_AXIS AXIN_0C9 CM_RAW 8 0 65535 AXIS_PTS_REF AX_0C9 /end AXIS_DESCR /end CHARACTERISTIC
/begin CHARACTERISTIC CAL_72B_1 "кривая #72B 8: ? [2/2]" CURVE 0x0806CC64 RL_FNC_UWORD 0 CM_RAW 0 65535 /begin AXIS_DESCR COM_AXIS AXIN_0C9 CM_RAW 8 0 65535 AXIS_PTS_REF AX_0C9 /end AXIS_DESCR /end CHARACTERISTIC
/begin CHARACTERISTIC CAL_72C_0 "кривая #72C 8: ? [1/2]" CURVE 0x0806CC74 RL_FNC_UWORD 0 CM_RAW 0 65535 /begin AXIS_DESCR COM_AXIS AXIN_0C9 CM_RAW 8 0 65535 AXIS_PTS_REF AX_0C9 /end AXIS_DESCR /end CHARACTERISTIC
/begin CHARACTERISTIC CAL_72C_1 "кривая #72C 8: ? [2/2]" CURVE 0x0806CC84 RL_FNC_UWORD 0 CM_RAW 0 65535 /begin AXIS_DESCR COM_AXIS AXIN_0C9 CM_RAW 8 0 65535 AXIS_PTS_REF AX_0C9 /end AXIS_DESCR /end CHARACTERISTIC
/begin CHARACTERISTIC CAL_72D "массив #72D" VAL_BLK 0x0806CCB4 RL_FNC_UWORD 0 CM_RAW 0 65535 MATRIX_DIM 5 1 1 /end CHARACTERISTIC
/begin CHARACTERISTIC CAL_72E "массив #72E" VAL_BLK 0x0806CD00 RL_FNC_UWORD 0 CM_RAW 0 65535 MATRIX_DIM 3 1 1 /end CHARACTERISTIC
/begin CHARACTERISTIC CAL_72F "массив #72F [знак по значениям]" VAL_BLK 0x0806CD10 RL_FNC_SWORD 0 CM_RAW -32768 32767 MATRIX_DIM 2 1 1 /end CHARACTERISTIC
/begin CHARACTERISTIC CAL_730 "массив #730" VAL_BLK 0x0806CD14 RL_FNC_UWORD 0 CM_RAW 0 65535 MATRIX_DIM 5 1 1 /end CHARACTERISTIC
/begin CHARACTERISTIC CAL_731 "карта #731 25x24: N × ?" MAP 0x0806C2F4 RL_FNC_UWORD 0 CM_RAW 0 65535
 /begin AXIS_DESCR COM_AXIS AXIN_0C5_N CM_RPM2 24 0 32767.5 AXIS_PTS_REF AX_0C5_N /end AXIS_DESCR
 /begin AXIS_DESCR COM_AXIS AXIN_0C7 CM_RAW 25 0 65535 AXIS_PTS_REF AX_0C7 /end AXIS_DESCR
/end CHARACTERISTIC
/begin CHARACTERISTIC CAL_732 "карта #732 25x24: N × ?" MAP 0x0806C7A4 RL_FNC_UWORD 0 CM_RAW 0 65535
 /begin AXIS_DESCR COM_AXIS AXIN_0C6_N CM_RPM2 24 0 32767.5 AXIS_PTS_REF AX_0C6_N /end AXIS_DESCR
 /begin AXIS_DESCR COM_AXIS AXIN_0C7 CM_RAW 25 0 65535 AXIS_PTS_REF AX_0C7 /end AXIS_DESCR
/end CHARACTERISTIC
/begin CHARACTERISTIC CAL_733_0 "кривая #733 5: ? [1/2]" CURVE 0x0806BDB4 RL_FNC_UWORD 0 CM_RAW 0 65535 /begin AXIS_DESCR COM_AXIS AXIN_06E CM_RAW 5 0 65535 AXIS_PTS_REF AX_06E /end AXIS_DESCR /end CHARACTERISTIC
/begin CHARACTERISTIC CAL_733_1 "кривая #733 5: ? [2/2]" CURVE 0x0806BDBE RL_FNC_UWORD 0 CM_RAW 0 65535 /begin AXIS_DESCR COM_AXIS AXIN_06E CM_RAW 5 0 65535 AXIS_PTS_REF AX_06E /end AXIS_DESCR /end CHARACTERISTIC
/begin CHARACTERISTIC CAL_734_0 "кривая #734 5: ? [1/2]" CURVE 0x0806BDA0 RL_FNC_UWORD 0 CM_RAW 0 65535 /begin AXIS_DESCR COM_AXIS AXIN_06E CM_RAW 5 0 65535 AXIS_PTS_REF AX_06E /end AXIS_DESCR /end CHARACTERISTIC
/begin CHARACTERISTIC CAL_734_1 "кривая #734 5: ? [2/2]" CURVE 0x0806BDAA RL_FNC_UWORD 0 CM_RAW 0 65535 /begin AXIS_DESCR COM_AXIS AXIN_06E CM_RAW 5 0 65535 AXIS_PTS_REF AX_06E /end AXIS_DESCR /end CHARACTERISTIC
/begin CHARACTERISTIC CAL_735 "массив #735" VAL_BLK 0x0806BDCC RL_FNC_UWORD 0 CM_RAW 0 65535 MATRIX_DIM 2 1 1 /end CHARACTERISTIC
/begin CHARACTERISTIC CAL_736 "кривая #736 10: N" CURVE 0x0806BDD0 RL_FNC_UWORD 0 CM_RAW 0 65535
 /begin AXIS_DESCR COM_AXIS AXIN_00C_N CM_RPM2 10 0 32767.5 AXIS_PTS_REF AX_00C_N /end AXIS_DESCR
/end CHARACTERISTIC
/begin CHARACTERISTIC CAL_737 "значение #737" VALUE 0x0806C2C4 RL_FNC_SBYTE 0 CM_RAW -128 127 /end CHARACTERISTIC
/begin CHARACTERISTIC CAL_738 "кривая #738 10: N" CURVE 0x0806C2E0 RL_FNC_UWORD 0 CM_RAW 0 65535
 /begin AXIS_DESCR COM_AXIS AXIN_00C_N CM_RPM2 10 0 32767.5 AXIS_PTS_REF AX_00C_N /end AXIS_DESCR
/end CHARACTERISTIC
/begin CHARACTERISTIC CAL_739 "кривая #739 8: ?" CURVE 0x08065C3C RL_FNC_UWORD 0 CM_RAW 0 65535 /begin AXIS_DESCR COM_AXIS AXIN_05D CM_RAW 8 -128 127 AXIS_PTS_REF AX_05D /end AXIS_DESCR /end CHARACTERISTIC
/begin CHARACTERISTIC CAL_73A "кривая #73A 9: TCOOL [знак по значениям]" CURVE 0x08065A48 RL_FNC_SWORD 0 CM_RAW -32768 32767
 /begin AXIS_DESCR COM_AXIS AXIN_00A_TCOOL CM_C128 9 -256 255.992 AXIS_PTS_REF AX_00A_TCOOL /end AXIS_DESCR
/end CHARACTERISTIC
/begin CHARACTERISTIC CAL_73B "кривая #73B 9: ?" CURVE 0x08065A5C RL_FNC_UWORD 0 CM_RAW 0 65535 /begin AXIS_DESCR COM_AXIS AXIN_0CA CM_RAW 9 0 65535 AXIS_PTS_REF AX_0CA /end AXIS_DESCR /end CHARACTERISTIC
/begin CHARACTERISTIC CAL_73C "значение #73C" VALUE 0x08065A6E RL_FNC_SBYTE 0 CM_RAW -128 127 /end CHARACTERISTIC
/begin CHARACTERISTIC CAL_73D_0 "кривая #73D 8: GEAR [1/2]" CURVE 0x08065A70 RL_FNC_UWORD 0 CM_RAW 0 65535
 /begin AXIS_DESCR COM_AXIS AXIN_05E_GEAR CM_RAW 8 -128 127 AXIS_PTS_REF AX_05E_GEAR /end AXIS_DESCR
/end CHARACTERISTIC
/begin CHARACTERISTIC CAL_73D_1 "кривая #73D 8: GEAR [2/2]" CURVE 0x08065A80 RL_FNC_UWORD 0 CM_RAW 0 65535
 /begin AXIS_DESCR COM_AXIS AXIN_05E_GEAR CM_RAW 8 -128 127 AXIS_PTS_REF AX_05E_GEAR /end AXIS_DESCR
/end CHARACTERISTIC
/begin CHARACTERISTIC CAL_73E "кривая #73E 8: GEAR" CURVE 0x08065A90 RL_FNC_UWORD 0 CM_RAW 0 65535
 /begin AXIS_DESCR COM_AXIS AXIN_05E_GEAR CM_RAW 8 -128 127 AXIS_PTS_REF AX_05E_GEAR /end AXIS_DESCR
/end CHARACTERISTIC
/begin CHARACTERISTIC CAL_73F "кривая #73F 8: GEAR" CURVE 0x08065AA0 RL_FNC_UWORD 0 CM_RAW 0 65535
 /begin AXIS_DESCR COM_AXIS AXIN_05E_GEAR CM_RAW 8 -128 127 AXIS_PTS_REF AX_05E_GEAR /end AXIS_DESCR
/end CHARACTERISTIC
/begin CHARACTERISTIC CAL_740_0 "кривая #740 9: ? [1/8]" CURVE 0x08065B20 RL_FNC_UWORD 0 CM_RAW 0 65535 /begin AXIS_DESCR COM_AXIS AXIN_0CA CM_RAW 9 0 65535 AXIS_PTS_REF AX_0CA /end AXIS_DESCR /end CHARACTERISTIC
/begin CHARACTERISTIC CAL_740_1 "кривая #740 9: ? [2/8]" CURVE 0x08065B32 RL_FNC_UWORD 0 CM_RAW 0 65535 /begin AXIS_DESCR COM_AXIS AXIN_0CA CM_RAW 9 0 65535 AXIS_PTS_REF AX_0CA /end AXIS_DESCR /end CHARACTERISTIC
/begin CHARACTERISTIC CAL_740_2 "кривая #740 9: ? [3/8]" CURVE 0x08065B44 RL_FNC_UWORD 0 CM_RAW 0 65535 /begin AXIS_DESCR COM_AXIS AXIN_0CA CM_RAW 9 0 65535 AXIS_PTS_REF AX_0CA /end AXIS_DESCR /end CHARACTERISTIC
/begin CHARACTERISTIC CAL_740_3 "кривая #740 9: ? [4/8]" CURVE 0x08065B56 RL_FNC_UWORD 0 CM_RAW 0 65535 /begin AXIS_DESCR COM_AXIS AXIN_0CA CM_RAW 9 0 65535 AXIS_PTS_REF AX_0CA /end AXIS_DESCR /end CHARACTERISTIC
/begin CHARACTERISTIC CAL_740_4 "кривая #740 9: ? [5/8]" CURVE 0x08065B68 RL_FNC_UWORD 0 CM_RAW 0 65535 /begin AXIS_DESCR COM_AXIS AXIN_0CA CM_RAW 9 0 65535 AXIS_PTS_REF AX_0CA /end AXIS_DESCR /end CHARACTERISTIC
/begin CHARACTERISTIC CAL_740_5 "кривая #740 9: ? [6/8]" CURVE 0x08065B7A RL_FNC_UWORD 0 CM_RAW 0 65535 /begin AXIS_DESCR COM_AXIS AXIN_0CA CM_RAW 9 0 65535 AXIS_PTS_REF AX_0CA /end AXIS_DESCR /end CHARACTERISTIC
/begin CHARACTERISTIC CAL_740_6 "кривая #740 9: ? [7/8]" CURVE 0x08065B8C RL_FNC_UWORD 0 CM_RAW 0 65535 /begin AXIS_DESCR COM_AXIS AXIN_0CA CM_RAW 9 0 65535 AXIS_PTS_REF AX_0CA /end AXIS_DESCR /end CHARACTERISTIC
/begin CHARACTERISTIC CAL_740_7 "кривая #740 9: ? [8/8]" CURVE 0x08065B9E RL_FNC_UWORD 0 CM_RAW 0 65535 /begin AXIS_DESCR COM_AXIS AXIN_0CA CM_RAW 9 0 65535 AXIS_PTS_REF AX_0CA /end AXIS_DESCR /end CHARACTERISTIC
/begin CHARACTERISTIC CAL_741 "карта #741 8x7: ? × GEAR [знак по значениям]" MAP 0x08065AB0 RL_FNC_SWORD 0 CM_RAW -32768 32767 /begin AXIS_DESCR COM_AXIS AXIN_0CB CM_RAW 7 0 65535 AXIS_PTS_REF AX_0CB /end AXIS_DESCR
 /begin AXIS_DESCR COM_AXIS AXIN_05E_GEAR CM_RAW 8 -128 127 AXIS_PTS_REF AX_05E_GEAR /end AXIS_DESCR
/end CHARACTERISTIC
/begin CHARACTERISTIC CAL_742 "значение #742" VALUE 0x08065BBA RL_FNC_UWORD 0 CM_RAW 0 65535 /end CHARACTERISTIC
/begin CHARACTERISTIC CAL_743 "значение #743" VALUE 0x08065BB8 RL_FNC_UWORD 0 CM_RAW 0 65535 /end CHARACTERISTIC
/begin CHARACTERISTIC CAL_744 "карта #744 8x7: ? × GEAR [знак по значениям]" MAP 0x08065BBC RL_FNC_SWORD 0 CM_RAW -32768 32767 /begin AXIS_DESCR COM_AXIS AXIN_0CB CM_RAW 7 0 65535 AXIS_PTS_REF AX_0CB /end AXIS_DESCR
 /begin AXIS_DESCR COM_AXIS AXIN_05E_GEAR CM_RAW 8 -128 127 AXIS_PTS_REF AX_05E_GEAR /end AXIS_DESCR
/end CHARACTERISTIC
/begin CHARACTERISTIC CAL_745 "значение #745" VALUE 0x08065C2C RL_FNC_UWORD 0 CM_RAW 0 65535 /end CHARACTERISTIC
/begin CHARACTERISTIC CAL_746 "массив #746" VAL_BLK 0x08065C30 RL_FNC_UWORD 0 CM_RAW 0 65535 MATRIX_DIM 4 1 1 /end CHARACTERISTIC
/begin CHARACTERISTIC CAL_747 "значение #747" VALUE 0x08065C2E RL_FNC_UWORD 0 CM_RAW 0 65535 /end CHARACTERISTIC
/begin CHARACTERISTIC CAL_748 "значение #748" VALUE 0x08065C38 RL_FNC_UWORD 0 CM_RAW 0 65535 /end CHARACTERISTIC
/begin CHARACTERISTIC CAL_749 "кривая #749 17: ?" CURVE 0x08066324 RL_FNC_UWORD 0 CM_RAW 0 65535 /begin AXIS_DESCR COM_AXIS AXIN_0CC CM_RAW 17 0 65535 AXIS_PTS_REF AX_0CC /end AXIS_DESCR /end CHARACTERISTIC
/begin CHARACTERISTIC CAL_74A "массив #74A" VAL_BLK 0x08068FFC RL_FNC_SWORD 0 CM_RAW -32768 32767 MATRIX_DIM 18 1 1 /end CHARACTERISTIC
/begin CHARACTERISTIC CAL_74B "кривая #74B 16: TCOOL" CURVE 0x08064078 RL_FNC_UWORD 0 CM_RAW 0 65535
 /begin AXIS_DESCR COM_AXIS AXIN_0D3_TCOOL CM_C128 16 -256 255.992 AXIS_PTS_REF AX_0D3_TCOOL /end AXIS_DESCR
/end CHARACTERISTIC
/begin CHARACTERISTIC CAL_74C "карта #74C 1x6: ? × ?" MAP 0x0806402C RL_FNC_SBYTE 0 CM_RAW -128 127 /begin AXIS_DESCR COM_AXIS AXIN_071 CM_RAW 6 -128 127 AXIS_PTS_REF AX_071 /end AXIS_DESCR /begin AXIS_DESCR COM_AXIS AXIN_0CE CM_RAW 1 -128 127 AXIS_PTS_REF AX_0CE /end AXIS_DESCR /end CHARACTERISTIC
/begin CHARACTERISTIC CAL_74D_0 "кривая #74D 10: N [1/2]" CURVE 0x08063FC0 RL_FNC_UWORD 0 CM_RAW 0 65535
 /begin AXIS_DESCR COM_AXIS AXIN_00C_N CM_RPM2 10 0 32767.5 AXIS_PTS_REF AX_00C_N /end AXIS_DESCR
/end CHARACTERISTIC
/begin CHARACTERISTIC CAL_74D_1 "кривая #74D 10: N [2/2]" CURVE 0x08063FD4 RL_FNC_UWORD 0 CM_RAW 0 65535
 /begin AXIS_DESCR COM_AXIS AXIN_00C_N CM_RPM2 10 0 32767.5 AXIS_PTS_REF AX_00C_N /end AXIS_DESCR
/end CHARACTERISTIC
/begin CHARACTERISTIC CAL_74E "значение #74E" VALUE 0x08063FBE RL_FNC_UWORD 0 CM_RAW 0 65535 /end CHARACTERISTIC
/begin CHARACTERISTIC CAL_74F "значение #74F" VALUE 0x08063FE8 RL_FNC_SBYTE 0 CM_RAW -128 127 /end CHARACTERISTIC
/begin CHARACTERISTIC CAL_750 "массив #750" VAL_BLK 0x08063FEC RL_FNC_UWORD 0 CM_RAW 0 65535 MATRIX_DIM 2 1 1 /end CHARACTERISTIC
/begin CHARACTERISTIC CAL_751 "массив #751" VAL_BLK 0x08063FF0 RL_FNC_UWORD 0 CM_RAW 0 65535 MATRIX_DIM 2 1 1 /end CHARACTERISTIC
/begin CHARACTERISTIC CAL_752 "кривая #752 11: ?" CURVE 0x08063FF4 RL_FNC_UWORD 0 CM_RAW 0 65535 /begin AXIS_DESCR COM_AXIS AXIN_0D1 CM_RAW 11 0 65535 AXIS_PTS_REF AX_0D1 /end AXIS_DESCR /end CHARACTERISTIC
/begin CHARACTERISTIC CAL_753 "значение #753" VALUE 0x0806400A RL_FNC_SBYTE 0 CM_RAW -128 127 /end CHARACTERISTIC
/begin CHARACTERISTIC CAL_754 "значение #754" VALUE 0x0806400C RL_FNC_UWORD 0 CM_RAW 0 65535 /end CHARACTERISTIC
/begin CHARACTERISTIC CAL_755 "кривая #755 10: ?" CURVE 0x08064010 RL_FNC_UWORD 0 CM_RAW 0 65535
 /begin AXIS_DESCR COM_AXIS AXIN_0D0 CM_RAW 10 -32768 32767 AXIS_PTS_REF AX_0D0 /end AXIS_DESCR
/end CHARACTERISTIC
/begin CHARACTERISTIC CAL_756 "значение #756" VALUE 0x08064024 RL_FNC_UWORD 0 CM_RAW 0 65535 /end CHARACTERISTIC
/begin CHARACTERISTIC CAL_757 "значение #757" VALUE 0x08064026 RL_FNC_SBYTE 0 CM_RAW -128 127 /end CHARACTERISTIC
/begin CHARACTERISTIC CAL_758 "значение #758" VALUE 0x08064028 RL_FNC_ULONG 0 CM_RAW 0 4.29497e+09 /end CHARACTERISTIC
/begin CHARACTERISTIC CAL_759 "значение #759" VALUE 0x0806405A RL_FNC_UWORD 0 CM_RAW 0 65535 /end CHARACTERISTIC
/begin CHARACTERISTIC CAL_75A "массив #75A" VAL_BLK 0x0806405C RL_FNC_UWORD 0 CM_RAW 0 65535 MATRIX_DIM 2 1 1 /end CHARACTERISTIC
/begin CHARACTERISTIC CAL_75B "карта #75B 1x9: ? × ?" MAP 0x08064034 RL_FNC_SBYTE 0 CM_RAW -128 127 /begin AXIS_DESCR COM_AXIS AXIN_070 CM_RAW 9 -128 127 AXIS_PTS_REF AX_070 /end AXIS_DESCR /begin AXIS_DESCR COM_AXIS AXIN_0CE CM_RAW 1 -128 127 AXIS_PTS_REF AX_0CE /end AXIS_DESCR /end CHARACTERISTIC
/begin CHARACTERISTIC CAL_75C "кривая #75C 9: ?" CURVE 0x08064040 RL_FNC_UWORD 0 CM_RAW 0 65535 /begin AXIS_DESCR COM_AXIS AXIN_0CF CM_RAW 9 0 65535 AXIS_PTS_REF AX_0CF /end AXIS_DESCR /end CHARACTERISTIC
/begin CHARACTERISTIC CAL_75D "значение #75D" VALUE 0x08064052 RL_FNC_UWORD 0 CM_RAW 0 65535 /end CHARACTERISTIC
/begin CHARACTERISTIC CAL_75E "значение #75E" VALUE 0x08064054 RL_FNC_UWORD 0 CM_RAW 0 65535 /end CHARACTERISTIC
/begin CHARACTERISTIC CAL_75F "значение #75F" VALUE 0x08064056 RL_FNC_UWORD 0 CM_RAW 0 65535 /end CHARACTERISTIC
/begin CHARACTERISTIC CAL_760 "значение #760" VALUE 0x08064058 RL_FNC_UWORD 0 CM_RAW 0 65535 /end CHARACTERISTIC
/begin CHARACTERISTIC CAL_761 "карта #761 12x24: N × ?" MAP 0x0806CD74 RL_FNC_UWORD 0 CM_RAW 0 65535
 /begin AXIS_DESCR COM_AXIS AXIN_0C5_N CM_RPM2 24 0 32767.5 AXIS_PTS_REF AX_0C5_N /end AXIS_DESCR
 /begin AXIS_DESCR COM_AXIS AXIN_0D2 CM_RAW 12 0 65535 AXIS_PTS_REF AX_0D2 /end AXIS_DESCR
/end CHARACTERISTIC
/begin CHARACTERISTIC CAL_762 "кривая #762 16: TAIR" CURVE 0x0806CFB8 RL_FNC_UWORD 0 CM_RAW 0 65535
 /begin AXIS_DESCR COM_AXIS AXIN_002_TAIR CM_C128 16 -256 255.992 AXIS_PTS_REF AX_002_TAIR /end AXIS_DESCR
/end CHARACTERISTIC
/begin CHARACTERISTIC CAL_763 "значение #763" VALUE 0x0807463C RL_FNC_SBYTE 0 CM_RAW -128 127 /end CHARACTERISTIC
/begin CHARACTERISTIC CAL_766 "кривая #766 2: ?" CURVE 0x08074590 RL_FNC_SBYTE 0 CM_RAW -128 127 /begin AXIS_DESCR COM_AXIS AXIN_0EB CM_RAW 2 -128 127 AXIS_PTS_REF AX_0EB /end AXIS_DESCR /end CHARACTERISTIC
/begin CHARACTERISTIC CAL_767 "значение #767" VALUE 0x08074594 RL_FNC_UWORD 0 CM_RAW 0 65535 /end CHARACTERISTIC
/begin CHARACTERISTIC CAL_76A "значение #76A" VALUE 0x08074596 RL_FNC_UWORD 0 CM_RAW 0 65535 /end CHARACTERISTIC
/begin CHARACTERISTIC CAL_76C "значение #76C" VALUE 0x0807458E RL_FNC_UWORD 0 CM_RAW 0 65535 /end CHARACTERISTIC
/begin CHARACTERISTIC CAL_76E "значение #76E" VALUE 0x08074592 RL_FNC_SWORD 0 CM_RAW -32768 32767 /end CHARACTERISTIC
/begin CHARACTERISTIC CAL_770 "значение #770" VALUE 0x080746CA RL_FNC_SBYTE 0 CM_RAW -128 127 /end CHARACTERISTIC
/begin CHARACTERISTIC CAL_771 "значение #771" VALUE 0x080746CB RL_FNC_SBYTE 0 CM_RAW -128 127 /end CHARACTERISTIC
/begin CHARACTERISTIC CAL_772 "значение #772" VALUE 0x0806537B RL_FNC_SBYTE 0 CM_RAW -128 127 /end CHARACTERISTIC
/begin CHARACTERISTIC CAL_775 "значение #775" VALUE 0x0806B712 RL_FNC_SBYTE 0 CM_RAW -128 127 /end CHARACTERISTIC
/begin CHARACTERISTIC CAL_776 "карта #776 3x9: ? × ?" MAP 0x0806B728 RL_FNC_SBYTE 0 CM_RAW -128 127 /begin AXIS_DESCR COM_AXIS AXIN_070 CM_RAW 9 -128 127 AXIS_PTS_REF AX_070 /end AXIS_DESCR /begin AXIS_DESCR COM_AXIS AXIN_08B CM_RAW 3 -128 127 AXIS_PTS_REF AX_08B /end AXIS_DESCR /end CHARACTERISTIC
/begin CHARACTERISTIC CAL_777 "карта #777 3x6: ? × ?" MAP 0x0806B714 RL_FNC_SBYTE 0 CM_RAW -128 127 /begin AXIS_DESCR COM_AXIS AXIN_071 CM_RAW 6 -128 127 AXIS_PTS_REF AX_071 /end AXIS_DESCR /begin AXIS_DESCR COM_AXIS AXIN_08B CM_RAW 3 -128 127 AXIS_PTS_REF AX_08B /end AXIS_DESCR /end CHARACTERISTIC
/begin CHARACTERISTIC CAL_778 "значение #778" VALUE 0x0806B744 RL_FNC_UWORD 0 CM_RAW 0 65535 /end CHARACTERISTIC
/begin CHARACTERISTIC CAL_779 "значение #779" VALUE 0x0806B746 RL_FNC_UWORD 0 CM_RAW 0 65535 /end CHARACTERISTIC
/begin CHARACTERISTIC CAL_77A "значение #77A" VALUE 0x08063E10 RL_FNC_SWORD 0 CM_RAW -32768 32767 /end CHARACTERISTIC
/begin CHARACTERISTIC CAL_77B "значение #77B" VALUE 0x0806B4EC RL_FNC_UWORD 0 CM_RAW 0 65535 /end CHARACTERISTIC
/begin CHARACTERISTIC CAL_77C "значение #77C" VALUE 0x08073A8C RL_FNC_UWORD 0 CM_RAW 0 65535 /end CHARACTERISTIC
/begin CHARACTERISTIC CAL_77E "значение #77E" VALUE 0x08063EC3 RL_FNC_SBYTE 0 CM_RAW -128 127 /end CHARACTERISTIC
/begin CHARACTERISTIC CAL_77F "массив #77F" VAL_BLK 0x0806825C RL_FNC_SBYTE 0 CM_RAW -128 127 MATRIX_DIM 4 1 1 /end CHARACTERISTIC
/begin CHARACTERISTIC CAL_782 "значение #782" VALUE 0x0807030E RL_FNC_UWORD 0 CM_RAW 0 65535 /end CHARACTERISTIC
/begin CHARACTERISTIC CAL_783 "значение #783" VALUE 0x08070310 RL_FNC_UWORD 0 CM_RAW 0 65535 /end CHARACTERISTIC
/begin CHARACTERISTIC CAL_784 "карта #784 3x9: ? × ?" MAP 0x08070314 RL_FNC_SBYTE 0 CM_RAW -128 127 /begin AXIS_DESCR COM_AXIS AXIN_070 CM_RAW 9 -128 127 AXIS_PTS_REF AX_070 /end AXIS_DESCR /begin AXIS_DESCR COM_AXIS AXIN_0D6 CM_RAW 3 -128 127 AXIS_PTS_REF AX_0D6 /end AXIS_DESCR /end CHARACTERISTIC
/begin CHARACTERISTIC CAL_785 "массив #785" VAL_BLK 0x08070330 RL_FNC_UWORD 0 CM_RAW 0 65535 MATRIX_DIM 2 1 1 /end CHARACTERISTIC
/begin CHARACTERISTIC CAL_786 "значение #786" VALUE 0x08070334 RL_FNC_SBYTE 0 CM_RAW -128 127 /end CHARACTERISTIC
/begin CHARACTERISTIC CAL_787 "карта #787 3x6: ? × ?" MAP 0x08070338 RL_FNC_SBYTE 0 CM_RAW -128 127 /begin AXIS_DESCR COM_AXIS AXIN_071 CM_RAW 6 -128 127 AXIS_PTS_REF AX_071 /end AXIS_DESCR /begin AXIS_DESCR COM_AXIS AXIN_0D6 CM_RAW 3 -128 127 AXIS_PTS_REF AX_0D6 /end AXIS_DESCR /end CHARACTERISTIC
/begin CHARACTERISTIC CAL_788 "значение #788" VALUE 0x0807034A RL_FNC_UWORD 0 CM_RAW 0 65535 /end CHARACTERISTIC
/begin CHARACTERISTIC CAL_789 "значение #789" VALUE 0x0807034C RL_FNC_UWORD 0 CM_RAW 0 65535 /end CHARACTERISTIC
/begin CHARACTERISTIC CAL_78A "значение #78A" VALUE 0x0807034E RL_FNC_UWORD 0 CM_RAW 0 65535 /end CHARACTERISTIC
/begin CHARACTERISTIC CAL_78B "значение #78B" VALUE 0x08070350 RL_FNC_UWORD 0 CM_RAW 0 65535 /end CHARACTERISTIC
/begin CHARACTERISTIC CAL_78E "массив #78E" VAL_BLK 0x0806E7D0 RL_FNC_SBYTE 0 CM_RAW -128 127 MATRIX_DIM 13 1 1 /end CHARACTERISTIC
/begin CHARACTERISTIC CAL_78F "массив #78F" VAL_BLK 0x0806E7E0 RL_FNC_SWORD 0 CM_RAW -32768 32767 MATRIX_DIM 21 1 1 /end CHARACTERISTIC
/begin CHARACTERISTIC CAL_790 "массив #790" VAL_BLK 0x0806E80C RL_FNC_SWORD 0 CM_RAW -32768 32767 MATRIX_DIM 21 1 1 /end CHARACTERISTIC
/begin CHARACTERISTIC CAL_791 "массив #791" VAL_BLK 0x0806E838 RL_FNC_SBYTE 0 CM_RAW -128 127 MATRIX_DIM 21 1 1 /end CHARACTERISTIC
/begin CHARACTERISTIC CAL_792 "массив #792" VAL_BLK 0x0806E850 RL_FNC_SBYTE 0 CM_RAW -128 127 MATRIX_DIM 21 1 1 /end CHARACTERISTIC
/begin CHARACTERISTIC CAL_793 "массив #793" VAL_BLK 0x0806E868 RL_FNC_SBYTE 0 CM_RAW -128 127 MATRIX_DIM 21 1 1 /end CHARACTERISTIC
/begin CHARACTERISTIC CAL_794 "значение #794" VALUE 0x0807459A RL_FNC_UWORD 0 CM_RAW 0 65535 /end CHARACTERISTIC
/begin CHARACTERISTIC CAL_799 "массив #799" VAL_BLK 0x080662C0 RL_FNC_SWORD 0 CM_RAW -32768 32767 MATRIX_DIM 4 1 1 /end CHARACTERISTIC
/begin CHARACTERISTIC CAL_79A "значение #79A" VALUE 0x080662C8 RL_FNC_UWORD 0 CM_RAW 0 65535 /end CHARACTERISTIC
/begin CHARACTERISTIC CAL_79B_0 "кривая #79B 4: ? [1/2]" CURVE 0x080662CC RL_FNC_SWORD 0 CM_RAW -32768 32767 /begin AXIS_DESCR COM_AXIS AXIN_0D7 CM_RAW 4 -128 127 AXIS_PTS_REF AX_0D7 /end AXIS_DESCR /end CHARACTERISTIC
/begin CHARACTERISTIC CAL_79B_1 "кривая #79B 4: ? [2/2]" CURVE 0x080662D4 RL_FNC_SWORD 0 CM_RAW -32768 32767 /begin AXIS_DESCR COM_AXIS AXIN_0D7 CM_RAW 4 -128 127 AXIS_PTS_REF AX_0D7 /end AXIS_DESCR /end CHARACTERISTIC
/begin CHARACTERISTIC CAL_79C "значение #79C" VALUE 0x080703A4 RL_FNC_SWORD 0 CM_RAW -32768 32767 /end CHARACTERISTIC
/begin CHARACTERISTIC CAL_79D "значение #79D" VALUE 0x080703A6 RL_FNC_UWORD 0 CM_RAW 0 65535 /end CHARACTERISTIC
/begin CHARACTERISTIC CAL_79E "массив #79E" VAL_BLK 0x08064454 RL_FNC_SBYTE 0 CM_RAW -128 127 MATRIX_DIM 2 1 1 /end CHARACTERISTIC
/begin CHARACTERISTIC CAL_79F "значение #79F" VALUE 0x08064456 RL_FNC_UWORD 0 CM_RAW 0 65535 /end CHARACTERISTIC
/begin CHARACTERISTIC CAL_7A0 "значение #7A0" VALUE 0x08064458 RL_FNC_UWORD 0 CM_RAW 0 65535 /end CHARACTERISTIC
/begin CHARACTERISTIC CAL_7A1 "значение #7A1" VALUE 0x08070358 RL_FNC_SWORD 0 CM_RAW -32768 32767 /end CHARACTERISTIC
/begin CHARACTERISTIC CAL_7A2 "значение #7A2" VALUE 0x0807035A RL_FNC_SWORD 0 CM_RAW -32768 32767 /end CHARACTERISTIC
/begin CHARACTERISTIC CAL_7A3 "значение #7A3" VALUE 0x0807035E RL_FNC_UWORD 0 CM_RAW 0 65535 /end CHARACTERISTIC
/begin CHARACTERISTIC CAL_7A4 "значение #7A4" VALUE 0x080703A2 RL_FNC_SBYTE 0 CM_RAW -128 127 /end CHARACTERISTIC
/begin CHARACTERISTIC CAL_7A5 "значение #7A5" VALUE 0x08070364 RL_FNC_UWORD 0 CM_RAW 0 65535 /end CHARACTERISTIC
/begin CHARACTERISTIC CAL_7A6 "значение #7A6" VALUE 0x08070366 RL_FNC_UWORD 0 CM_RAW 0 65535 /end CHARACTERISTIC
/begin CHARACTERISTIC CAL_7A7 "значение #7A7" VALUE 0x08070368 RL_FNC_SLONG 0 CM_RAW -2.14748e+09 2.14748e+09 /end CHARACTERISTIC
/begin CHARACTERISTIC CAL_7A8 "значение #7A8" VALUE 0x0807036C RL_FNC_SWORD 0 CM_RAW -32768 32767 /end CHARACTERISTIC
/begin CHARACTERISTIC CAL_7A9 "значение #7A9" VALUE 0x0806CFDA RL_FNC_SBYTE 0 CM_RAW -128 127 /end CHARACTERISTIC
/begin CHARACTERISTIC CAL_7AA "кривая #7AA 42: ?" CURVE 0x0806CD20 RL_FNC_UWORD 0 CM_RAW 0 65535 /begin AXIS_DESCR COM_AXIS AXIN_0DA CM_RAW 42 0 65535 AXIS_PTS_REF AX_0DA /end AXIS_DESCR /end CHARACTERISTIC
/begin CHARACTERISTIC CAL_7AB "значение #7AB" VALUE 0x08074657 RL_FNC_SBYTE 0 CM_RAW -128 127 /end CHARACTERISTIC
/begin CHARACTERISTIC CAL_7AC "кривая #7AC 9: N" CURVE 0x08070C54 RL_FNC_UWORD 0 CM_RAW 0 65535
 /begin AXIS_DESCR COM_AXIS AXIN_0AD_N CM_RPM2 9 0 32767.5 AXIS_PTS_REF AX_0AD_N /end AXIS_DESCR
/end CHARACTERISTIC
/begin CHARACTERISTIC CAL_7AD "массив #7AD" VAL_BLK 0x0806BC6C RL_FNC_UWORD 0 CM_RAW 0 65535 MATRIX_DIM 2 1 1 /end CHARACTERISTIC
/begin CHARACTERISTIC CAL_7AE "значение #7AE" VALUE 0x08068280 RL_FNC_UWORD 0 CM_RAW 0 65535 /end CHARACTERISTIC
/begin CHARACTERISTIC CAL_7AF "массив #7AF" VAL_BLK 0x0806BC74 RL_FNC_UWORD 0 CM_RAW 0 65535 MATRIX_DIM 2 1 1 /end CHARACTERISTIC
/begin CHARACTERISTIC CAL_7B0 "массив #7B0" VAL_BLK 0x0806BC4C RL_FNC_UWORD 0 CM_RAW 0 65535 MATRIX_DIM 2 1 1 /end CHARACTERISTIC
/begin CHARACTERISTIC CAL_7B1 "массив #7B1" VAL_BLK 0x080681F4 RL_FNC_SBYTE 0 CM_RAW -128 127 MATRIX_DIM 3 1 1 /end CHARACTERISTIC
/begin CHARACTERISTIC CAL_7B3 "значение #7B3" VALUE 0x0806E89A RL_FNC_SBYTE 0 CM_RAW -128 127 /end CHARACTERISTIC
/begin CHARACTERISTIC CAL_7B4 "карта #7B4 2x9: ? × ?" MAP 0x0806E888 RL_FNC_SBYTE 0 CM_RAW -128 127 /begin AXIS_DESCR COM_AXIS AXIN_070 CM_RAW 9 -128 127 AXIS_PTS_REF AX_070 /end AXIS_DESCR /begin AXIS_DESCR COM_AXIS AXIN_0DF CM_RAW 2 -128 127 AXIS_PTS_REF AX_0DF /end AXIS_DESCR /end CHARACTERISTIC
/begin CHARACTERISTIC CAL_7B5 "карта #7B5 2x6: ? × ?" MAP 0x0806E89C RL_FNC_SBYTE 0 CM_RAW -128 127 /begin AXIS_DESCR COM_AXIS AXIN_071 CM_RAW 6 -128 127 AXIS_PTS_REF AX_071 /end AXIS_DESCR /begin AXIS_DESCR COM_AXIS AXIN_0DF CM_RAW 2 -128 127 AXIS_PTS_REF AX_0DF /end AXIS_DESCR /end CHARACTERISTIC
/begin CHARACTERISTIC CAL_7B6 "карта #7B6 9x14: N × LOAD" MAP 0x0806A38C RL_FNC_UWORD 0 CM_RAW 0 65535
 /begin AXIS_DESCR COM_AXIS AXIN_027_N CM_RPM2 14 0 32767.5 AXIS_PTS_REF AX_027_N /end AXIS_DESCR
 /begin AXIS_DESCR COM_AXIS AXIN_039_LOAD CM_RAW 9 0 65535 AXIS_PTS_REF AX_039_LOAD /end AXIS_DESCR
/end CHARACTERISTIC
/begin CHARACTERISTIC CAL_7B7 "массив #7B7" VAL_BLK 0x0806E8A8 RL_FNC_SBYTE 0 CM_RAW -128 127 MATRIX_DIM 2 1 1 /end CHARACTERISTIC
/begin CHARACTERISTIC CAL_7B8_0 "кривая #7B8 10: N [1/2]" CURVE 0x08062458 RL_FNC_UWORD 0 CM_RAW 0 65535
 /begin AXIS_DESCR COM_AXIS AXIN_00C_N CM_RPM2 10 0 32767.5 AXIS_PTS_REF AX_00C_N /end AXIS_DESCR
/end CHARACTERISTIC
/begin CHARACTERISTIC CAL_7B8_1 "кривая #7B8 10: N [2/2]" CURVE 0x0806246C RL_FNC_UWORD 0 CM_RAW 0 65535
 /begin AXIS_DESCR COM_AXIS AXIN_00C_N CM_RPM2 10 0 32767.5 AXIS_PTS_REF AX_00C_N /end AXIS_DESCR
/end CHARACTERISTIC
/begin CHARACTERISTIC CAL_7BA "массив #7BA" VAL_BLK 0x0806BC9C RL_FNC_UWORD 0 CM_RAW 0 65535 MATRIX_DIM 2 1 1 /end CHARACTERISTIC
/begin CHARACTERISTIC CAL_7BB "значение #7BB" VALUE 0x0806BCA0 RL_FNC_UWORD 0 CM_RAW 0 65535 /end CHARACTERISTIC
/begin CHARACTERISTIC CAL_7BC "массив #7BC" VAL_BLK 0x0806BCA4 RL_FNC_UWORD 0 CM_RAW 0 65535 MATRIX_DIM 2 1 1 /end CHARACTERISTIC
/begin CHARACTERISTIC CAL_7BD "значение #7BD" VALUE 0x0806BCA8 RL_FNC_UWORD 0 CM_RAW 0 65535 /end CHARACTERISTIC
/begin CHARACTERISTIC CAL_7BE "значение #7BE" VALUE 0x0806BC7C RL_FNC_SBYTE 0 CM_RAW -128 127 /end CHARACTERISTIC
/begin CHARACTERISTIC CAL_7BF "значение #7BF" VALUE 0x0806BC7D RL_FNC_SBYTE 0 CM_RAW -128 127 /end CHARACTERISTIC
/begin CHARACTERISTIC CAL_7C0 "карта #7C0 1x9: ? × ?" MAP 0x0806BC88 RL_FNC_SBYTE 0 CM_RAW -128 127 /begin AXIS_DESCR COM_AXIS AXIN_070 CM_RAW 9 -128 127 AXIS_PTS_REF AX_070 /end AXIS_DESCR /begin AXIS_DESCR COM_AXIS AXIN_0E0 CM_RAW 1 -128 127 AXIS_PTS_REF AX_0E0 /end AXIS_DESCR /end CHARACTERISTIC
/begin CHARACTERISTIC CAL_7C1 "карта #7C1 1x6: ? × ?" MAP 0x0806BC80 RL_FNC_SBYTE 0 CM_RAW -128 127 /begin AXIS_DESCR COM_AXIS AXIN_071 CM_RAW 6 -128 127 AXIS_PTS_REF AX_071 /end AXIS_DESCR /begin AXIS_DESCR COM_AXIS AXIN_0E0 CM_RAW 1 -128 127 AXIS_PTS_REF AX_0E0 /end AXIS_DESCR /end CHARACTERISTIC
/begin CHARACTERISTIC CAL_7C2 "значение #7C2" VALUE 0x0806BC92 RL_FNC_UWORD 0 CM_RAW 0 65535 /end CHARACTERISTIC
/begin CHARACTERISTIC CAL_7C3 "массив #7C3" VAL_BLK 0x0806BC98 RL_FNC_SBYTE 0 CM_RAW -128 127 MATRIX_DIM 2 1 1 /end CHARACTERISTIC
/begin CHARACTERISTIC CAL_7C4 "значение #7C4" VALUE 0x0806BC9A RL_FNC_SBYTE 0 CM_RAW -128 127 /end CHARACTERISTIC
/begin CHARACTERISTIC CAL_7C5 "значение #7C5" VALUE 0x0806BC94 RL_FNC_SBYTE 0 CM_RAW -128 127 /end CHARACTERISTIC
/begin CHARACTERISTIC CAL_7C7 "карта #7C7 3x9: ? × ?" MAP 0x08062680 RL_FNC_SBYTE 0 CM_RAW -128 127 /begin AXIS_DESCR COM_AXIS AXIN_070 CM_RAW 9 -128 127 AXIS_PTS_REF AX_070 /end AXIS_DESCR /begin AXIS_DESCR COM_AXIS AXIN_0E1 CM_RAW 3 -128 127 AXIS_PTS_REF AX_0E1 /end AXIS_DESCR /end CHARACTERISTIC
/begin CHARACTERISTIC CAL_7C8 "карта #7C8 3x6: ? × ?" MAP 0x0806266C RL_FNC_SBYTE 0 CM_RAW -128 127 /begin AXIS_DESCR COM_AXIS AXIN_071 CM_RAW 6 -128 127 AXIS_PTS_REF AX_071 /end AXIS_DESCR /begin AXIS_DESCR COM_AXIS AXIN_0E1 CM_RAW 3 -128 127 AXIS_PTS_REF AX_0E1 /end AXIS_DESCR /end CHARACTERISTIC
/begin CHARACTERISTIC CAL_7C9 "значение #7C9" VALUE 0x080624FA RL_FNC_SBYTE 0 CM_RAW -128 127 /end CHARACTERISTIC
/begin CHARACTERISTIC CAL_7CA "значение #7CA" VALUE 0x0807069A RL_FNC_UBYTE 0 CM_RAW 0 255 /end CHARACTERISTIC
/begin CHARACTERISTIC CAL_7CB "значение #7CB" VALUE 0x08074598 RL_FNC_UWORD 0 CM_RAW 0 65535 /end CHARACTERISTIC
/begin CHARACTERISTIC CAL_7CC "значение #7CC" VALUE 0x08070698 RL_FNC_UWORD 0 CM_RAW 0 65535 /end CHARACTERISTIC
/begin CHARACTERISTIC CAL_7CD "значение #7CD" VALUE 0x08070696 RL_FNC_UWORD 0 CM_RAW 0 65535 /end CHARACTERISTIC
/begin CHARACTERISTIC CAL_7CF "значение #7CF" VALUE 0x08070374 RL_FNC_UWORD 0 CM_RAW 0 65535 /end CHARACTERISTIC
/begin CHARACTERISTIC CAL_7D0 "значение #7D0" VALUE 0x08070376 RL_FNC_UWORD 0 CM_RAW 0 65535 /end CHARACTERISTIC
/begin CHARACTERISTIC CAL_7D1 "массив #7D1" VAL_BLK 0x08070378 RL_FNC_UWORD 0 CM_RAW 0 65535 MATRIX_DIM 2 1 1 /end CHARACTERISTIC
/begin CHARACTERISTIC CAL_7D2 "значение #7D2" VALUE 0x0807037C RL_FNC_SBYTE 0 CM_RAW -128 127 /end CHARACTERISTIC
/begin CHARACTERISTIC CAL_7D3 "значение #7D3" VALUE 0x0807037E RL_FNC_UWORD 0 CM_RAW 0 65535 /end CHARACTERISTIC
/begin CHARACTERISTIC CAL_7D4 "карта #7D4 2x9: ? × ?" MAP 0x0807038C RL_FNC_SBYTE 0 CM_RAW -128 127 /begin AXIS_DESCR COM_AXIS AXIN_070 CM_RAW 9 -128 127 AXIS_PTS_REF AX_070 /end AXIS_DESCR /begin AXIS_DESCR COM_AXIS AXIN_0E2 CM_RAW 2 -128 127 AXIS_PTS_REF AX_0E2 /end AXIS_DESCR /end CHARACTERISTIC
/begin CHARACTERISTIC CAL_7D5 "карта #7D5 2x6: ? × ?" MAP 0x08070380 RL_FNC_SBYTE 0 CM_RAW -128 127 /begin AXIS_DESCR COM_AXIS AXIN_071 CM_RAW 6 -128 127 AXIS_PTS_REF AX_071 /end AXIS_DESCR /begin AXIS_DESCR COM_AXIS AXIN_0E2 CM_RAW 2 -128 127 AXIS_PTS_REF AX_0E2 /end AXIS_DESCR /end CHARACTERISTIC
/begin CHARACTERISTIC CAL_7D6 "значение #7D6" VALUE 0x0807039E RL_FNC_UWORD 0 CM_RAW 0 65535 /end CHARACTERISTIC
/begin CHARACTERISTIC CAL_7D7 "значение #7D7" VALUE 0x080703A0 RL_FNC_UWORD 0 CM_RAW 0 65535 /end CHARACTERISTIC
/begin CHARACTERISTIC CAL_7D8 "кривая #7D8 9: ?" CURVE 0x0806ABE0 RL_FNC_UWORD 0 CM_RAW 0 65535 /begin AXIS_DESCR COM_AXIS AXIN_0E3 CM_RAW 9 0 65535 AXIS_PTS_REF AX_0E3 /end AXIS_DESCR /end CHARACTERISTIC
/begin CHARACTERISTIC CAL_7D9 "массив #7D9" VAL_BLK 0x0806F930 RL_FNC_SBYTE 0 CM_RAW -128 127 MATRIX_DIM 2 1 1 /end CHARACTERISTIC
/begin CHARACTERISTIC CAL_7DC "массив #7DC" VAL_BLK 0x0806D30C RL_FNC_SBYTE 0 CM_RAW -128 127 MATRIX_DIM 4 1 1 /end CHARACTERISTIC
/begin CHARACTERISTIC CAL_7DD_0 "карта #7DD 2x9: ? × ? [1/4]" MAP 0x0806D344 RL_FNC_SBYTE 0 CM_RAW -128 127 /begin AXIS_DESCR COM_AXIS AXIN_070 CM_RAW 9 -128 127 AXIS_PTS_REF AX_070 /end AXIS_DESCR /begin AXIS_DESCR COM_AXIS AXIN_0E4 CM_RAW 2 -128 127 AXIS_PTS_REF AX_0E4 /end AXIS_DESCR /end CHARACTERISTIC
/begin CHARACTERISTIC CAL_7DD_1 "карта #7DD 2x9: ? × ? [2/4]" MAP 0x0806D356 RL_FNC_SBYTE 0 CM_RAW -128 127 /begin AXIS_DESCR COM_AXIS AXIN_070 CM_RAW 9 -128 127 AXIS_PTS_REF AX_070 /end AXIS_DESCR /begin AXIS_DESCR COM_AXIS AXIN_0E4 CM_RAW 2 -128 127 AXIS_PTS_REF AX_0E4 /end AXIS_DESCR /end CHARACTERISTIC
/begin CHARACTERISTIC CAL_7DD_2 "карта #7DD 2x9: ? × ? [3/4]" MAP 0x0806D368 RL_FNC_SBYTE 0 CM_RAW -128 127 /begin AXIS_DESCR COM_AXIS AXIN_070 CM_RAW 9 -128 127 AXIS_PTS_REF AX_070 /end AXIS_DESCR /begin AXIS_DESCR COM_AXIS AXIN_0E4 CM_RAW 2 -128 127 AXIS_PTS_REF AX_0E4 /end AXIS_DESCR /end CHARACTERISTIC
/begin CHARACTERISTIC CAL_7DD_3 "карта #7DD 2x9: ? × ? [4/4]" MAP 0x0806D37A RL_FNC_SBYTE 0 CM_RAW -128 127 /begin AXIS_DESCR COM_AXIS AXIN_070 CM_RAW 9 -128 127 AXIS_PTS_REF AX_070 /end AXIS_DESCR /begin AXIS_DESCR COM_AXIS AXIN_0E4 CM_RAW 2 -128 127 AXIS_PTS_REF AX_0E4 /end AXIS_DESCR /end CHARACTERISTIC
/begin CHARACTERISTIC CAL_7DE_0 "карта #7DE 2x6: ? × ? [1/4]" MAP 0x0806D314 RL_FNC_SBYTE 0 CM_RAW -128 127 /begin AXIS_DESCR COM_AXIS AXIN_071 CM_RAW 6 -128 127 AXIS_PTS_REF AX_071 /end AXIS_DESCR /begin AXIS_DESCR COM_AXIS AXIN_0E4 CM_RAW 2 -128 127 AXIS_PTS_REF AX_0E4 /end AXIS_DESCR /end CHARACTERISTIC
/begin CHARACTERISTIC CAL_7DE_1 "карта #7DE 2x6: ? × ? [2/4]" MAP 0x0806D320 RL_FNC_SBYTE 0 CM_RAW -128 127 /begin AXIS_DESCR COM_AXIS AXIN_071 CM_RAW 6 -128 127 AXIS_PTS_REF AX_071 /end AXIS_DESCR /begin AXIS_DESCR COM_AXIS AXIN_0E4 CM_RAW 2 -128 127 AXIS_PTS_REF AX_0E4 /end AXIS_DESCR /end CHARACTERISTIC
/begin CHARACTERISTIC CAL_7DE_2 "карта #7DE 2x6: ? × ? [3/4]" MAP 0x0806D32C RL_FNC_SBYTE 0 CM_RAW -128 127 /begin AXIS_DESCR COM_AXIS AXIN_071 CM_RAW 6 -128 127 AXIS_PTS_REF AX_071 /end AXIS_DESCR /begin AXIS_DESCR COM_AXIS AXIN_0E4 CM_RAW 2 -128 127 AXIS_PTS_REF AX_0E4 /end AXIS_DESCR /end CHARACTERISTIC
/begin CHARACTERISTIC CAL_7DE_3 "карта #7DE 2x6: ? × ? [4/4]" MAP 0x0806D338 RL_FNC_SBYTE 0 CM_RAW -128 127 /begin AXIS_DESCR COM_AXIS AXIN_071 CM_RAW 6 -128 127 AXIS_PTS_REF AX_071 /end AXIS_DESCR /begin AXIS_DESCR COM_AXIS AXIN_0E4 CM_RAW 2 -128 127 AXIS_PTS_REF AX_0E4 /end AXIS_DESCR /end CHARACTERISTIC
/begin CHARACTERISTIC CAL_7E0 "значение #7E0" VALUE 0x08065758 RL_FNC_SBYTE 0 CM_RAW -128 127 /end CHARACTERISTIC
/begin CHARACTERISTIC CAL_7E1 "массив #7E1 [знак по значениям]" VAL_BLK 0x0806575C RL_FNC_SWORD 0 CM_RAW -32768 32767 MATRIX_DIM 2 1 1 /end CHARACTERISTIC
/begin CHARACTERISTIC CAL_7E2 "карта #7E2 8x9: ? × ?" MAP 0x08065790 RL_FNC_SBYTE 0 CM_RAW -128 127 /begin AXIS_DESCR COM_AXIS AXIN_070 CM_RAW 9 -128 127 AXIS_PTS_REF AX_070 /end AXIS_DESCR /begin AXIS_DESCR COM_AXIS AXIN_0E5 CM_RAW 8 -128 127 AXIS_PTS_REF AX_0E5 /end AXIS_DESCR /end CHARACTERISTIC
/begin CHARACTERISTIC CAL_7E3 "карта #7E3 8x6: ? × ?" MAP 0x08065760 RL_FNC_SBYTE 0 CM_RAW -128 127 /begin AXIS_DESCR COM_AXIS AXIN_071 CM_RAW 6 -128 127 AXIS_PTS_REF AX_071 /end AXIS_DESCR /begin AXIS_DESCR COM_AXIS AXIN_0E5 CM_RAW 8 -128 127 AXIS_PTS_REF AX_0E5 /end AXIS_DESCR /end CHARACTERISTIC
/begin CHARACTERISTIC CAL_7E4 "массив #7E4 [знак по значениям]" VAL_BLK 0x080657D8 RL_FNC_SWORD 0 CM_RAW -32768 32767 MATRIX_DIM 2 1 1 /end CHARACTERISTIC
/begin CHARACTERISTIC CAL_7E5 "значение #7E5" VALUE 0x080657DC RL_FNC_UWORD 0 CM_RAW 0 65535 /end CHARACTERISTIC
/begin CHARACTERISTIC CAL_7E8 "значение #7E8" VALUE 0x08063E14 RL_FNC_SBYTE 0 CM_RAW -128 127 /end CHARACTERISTIC
/begin CHARACTERISTIC CAL_7E9 "карта #7E9 5x9: ? × ?" MAP 0x08063E38 RL_FNC_SBYTE 0 CM_RAW -128 127 /begin AXIS_DESCR COM_AXIS AXIN_070 CM_RAW 9 -128 127 AXIS_PTS_REF AX_070 /end AXIS_DESCR /begin AXIS_DESCR COM_AXIS AXIN_0E7 CM_RAW 5 -128 127 AXIS_PTS_REF AX_0E7 /end AXIS_DESCR /end CHARACTERISTIC
/begin CHARACTERISTIC CAL_7EA "карта #7EA 5x6: ? × ?" MAP 0x08063E18 RL_FNC_SBYTE 0 CM_RAW -128 127 /begin AXIS_DESCR COM_AXIS AXIN_071 CM_RAW 6 -128 127 AXIS_PTS_REF AX_071 /end AXIS_DESCR /begin AXIS_DESCR COM_AXIS AXIN_0E7 CM_RAW 5 -128 127 AXIS_PTS_REF AX_0E7 /end AXIS_DESCR /end CHARACTERISTIC
/begin CHARACTERISTIC CAL_7EB "значение #7EB" VALUE 0x0806447E RL_FNC_SBYTE 0 CM_RAW -128 127 /end CHARACTERISTIC
/begin CHARACTERISTIC CAL_7EC "карта #7EC 2x9: ? × ?" MAP 0x0806448C RL_FNC_SBYTE 0 CM_RAW -128 127 /begin AXIS_DESCR COM_AXIS AXIN_070 CM_RAW 9 -128 127 AXIS_PTS_REF AX_070 /end AXIS_DESCR /begin AXIS_DESCR COM_AXIS AXIN_0E8 CM_RAW 2 -128 127 AXIS_PTS_REF AX_0E8 /end AXIS_DESCR /end CHARACTERISTIC
/begin CHARACTERISTIC CAL_7ED "карта #7ED 2x6: ? × ?" MAP 0x08064480 RL_FNC_SBYTE 0 CM_RAW -128 127 /begin AXIS_DESCR COM_AXIS AXIN_071 CM_RAW 6 -128 127 AXIS_PTS_REF AX_071 /end AXIS_DESCR /begin AXIS_DESCR COM_AXIS AXIN_0E8 CM_RAW 2 -128 127 AXIS_PTS_REF AX_0E8 /end AXIS_DESCR /end CHARACTERISTIC
/begin CHARACTERISTIC CAL_7EE "значение #7EE" VALUE 0x08074660 RL_FNC_SBYTE 0 CM_RAW -128 127 /end CHARACTERISTIC
/begin CHARACTERISTIC CAL_7EF "значение #7EF" VALUE 0x0807465F RL_FNC_SBYTE 0 CM_RAW -128 127 /end CHARACTERISTIC
/begin CHARACTERISTIC CAL_7F0 "значение #7F0" VALUE 0x08074664 RL_FNC_SLONG 0 CM_RAW -2.14748e+09 2.14748e+09 /end CHARACTERISTIC
/begin CHARACTERISTIC CAL_7F1 "значение #7F1" VALUE 0x08074668 RL_FNC_SBYTE 0 CM_RAW -128 127 /end CHARACTERISTIC
/begin CHARACTERISTIC CAL_7F2 "значение #7F2" VALUE 0x08074669 RL_FNC_SBYTE 0 CM_RAW -128 127 /end CHARACTERISTIC
/begin CHARACTERISTIC CAL_7F3 "значение #7F3" VALUE 0x0807466A RL_FNC_SBYTE 0 CM_RAW -128 127 /end CHARACTERISTIC
/begin CHARACTERISTIC CAL_7F4 "значение #7F4" VALUE 0x0807466B RL_FNC_SBYTE 0 CM_RAW -128 127 /end CHARACTERISTIC
/begin CHARACTERISTIC CAL_7F5 "значение #7F5" VALUE 0x0807466C RL_FNC_SBYTE 0 CM_RAW -128 127 /end CHARACTERISTIC
/begin CHARACTERISTIC CAL_7F6 "значение #7F6" VALUE 0x0807466D RL_FNC_SBYTE 0 CM_RAW -128 127 /end CHARACTERISTIC
/begin CHARACTERISTIC CAL_7F7 "значение #7F7" VALUE 0x0807466E RL_FNC_SBYTE 0 CM_RAW -128 127 /end CHARACTERISTIC
/begin CHARACTERISTIC CAL_7F8 "значение #7F8" VALUE 0x08074670 RL_FNC_ULONG 0 CM_RAW 0 4.29497e+09 /end CHARACTERISTIC
/begin CHARACTERISTIC CAL_7F9 "значение #7F9" VALUE 0x08074674 RL_FNC_SBYTE 0 CM_RAW -128 127 /end CHARACTERISTIC
/begin CHARACTERISTIC CAL_7FA "значение #7FA" VALUE 0x08074676 RL_FNC_UWORD 0 CM_RAW 0 65535 /end CHARACTERISTIC
/begin CHARACTERISTIC CAL_7FB "значение #7FB" VALUE 0x08074678 RL_FNC_UWORD 0 CM_RAW 0 65535 /end CHARACTERISTIC
/begin CHARACTERISTIC CAL_7FC "значение #7FC" VALUE 0x0807467C RL_FNC_SLONG 0 CM_RAW -2.14748e+09 2.14748e+09 /end CHARACTERISTIC
/begin CHARACTERISTIC CAL_7FD "значение #7FD" VALUE 0x08074680 RL_FNC_SLONG 0 CM_RAW -2.14748e+09 2.14748e+09 /end CHARACTERISTIC
/begin CHARACTERISTIC CAL_7FE "значение #7FE" VALUE 0x08074684 RL_FNC_SLONG 0 CM_RAW -2.14748e+09 2.14748e+09 /end CHARACTERISTIC
/begin CHARACTERISTIC CAL_7FF "значение #7FF" VALUE 0x08074688 RL_FNC_SBYTE 0 CM_RAW -128 127 /end CHARACTERISTIC
/begin CHARACTERISTIC CAL_800 "значение #800" VALUE 0x08074689 RL_FNC_SBYTE 0 CM_RAW -128 127 /end CHARACTERISTIC
/begin CHARACTERISTIC CAL_801 "значение #801" VALUE 0x0807468A RL_FNC_SBYTE 0 CM_RAW -128 127 /end CHARACTERISTIC
/begin CHARACTERISTIC CAL_803 "массив #803" VAL_BLK 0x08064410 RL_FNC_SBYTE 0 CM_RAW -128 127 MATRIX_DIM 2 1 1 /end CHARACTERISTIC
/begin CHARACTERISTIC CAL_804 "значение #804" VALUE 0x08064414 RL_FNC_SBYTE 0 CM_RAW -128 127 /end CHARACTERISTIC
/begin CHARACTERISTIC CAL_805 "значение #805" VALUE 0x08064412 RL_FNC_UWORD 0 CM_RAW 0 65535 /end CHARACTERISTIC
/begin CHARACTERISTIC CAL_806 "значение #806" VALUE 0x08064416 RL_FNC_UWORD 0 CM_RAW 0 65535 /end CHARACTERISTIC
/begin CHARACTERISTIC CAL_807 "значение #807" VALUE 0x08064418 RL_FNC_SBYTE 0 CM_RAW -128 127 /end CHARACTERISTIC
/begin CHARACTERISTIC CAL_808 "массив #808" VAL_BLK 0x0806441C RL_FNC_SWORD 0 CM_RAW -32768 32767 MATRIX_DIM 2 1 1 /end CHARACTERISTIC
/begin CHARACTERISTIC CAL_809 "значение #809" VALUE 0x08064422 RL_FNC_SBYTE 0 CM_RAW -128 127 /end CHARACTERISTIC
/begin CHARACTERISTIC CAL_80B "карта #80B 2x9: ? × ?" MAP 0x080643FC RL_FNC_SBYTE 0 CM_RAW -128 127 /begin AXIS_DESCR COM_AXIS AXIN_070 CM_RAW 9 -128 127 AXIS_PTS_REF AX_070 /end AXIS_DESCR /begin AXIS_DESCR COM_AXIS AXIN_0E9 CM_RAW 2 -128 127 AXIS_PTS_REF AX_0E9 /end AXIS_DESCR /end CHARACTERISTIC
/begin CHARACTERISTIC CAL_80C "карта #80C 2x6: ? × ?" MAP 0x080643F0 RL_FNC_SBYTE 0 CM_RAW -128 127 /begin AXIS_DESCR COM_AXIS AXIN_071 CM_RAW 6 -128 127 AXIS_PTS_REF AX_071 /end AXIS_DESCR /begin AXIS_DESCR COM_AXIS AXIN_0E9 CM_RAW 2 -128 127 AXIS_PTS_REF AX_0E9 /end AXIS_DESCR /end CHARACTERISTIC
/begin CHARACTERISTIC CAL_80D "массив #80D" VAL_BLK 0x08074618 RL_FNC_SBYTE 0 CM_RAW -128 127 MATRIX_DIM 2 1 1 /end CHARACTERISTIC
/begin CHARACTERISTIC CAL_80E "значение #80E" VALUE 0x08062F7C RL_FNC_UWORD 0 CM_RAW 0 65535 /end CHARACTERISTIC
/begin CHARACTERISTIC CAL_80F "значение #80F" VALUE 0x08062F7E RL_FNC_SBYTE 0 CM_RAW -128 127 /end CHARACTERISTIC
/begin CHARACTERISTIC CAL_810 "значение #810" VALUE 0x08062F7F RL_FNC_SBYTE 0 CM_RAW -128 127 /end CHARACTERISTIC
/begin CHARACTERISTIC CAL_811 "значение #811" VALUE 0x08062F80 RL_FNC_UWORD 0 CM_RAW 0 65535 /end CHARACTERISTIC
/begin CHARACTERISTIC CAL_812 "значение #812" VALUE 0x08062F82 RL_FNC_UWORD 0 CM_RAW 0 65535 /end CHARACTERISTIC
/begin CHARACTERISTIC CAL_813 "значение #813" VALUE 0x08062F84 RL_FNC_UWORD 0 CM_RAW 0 65535 /end CHARACTERISTIC
/begin CHARACTERISTIC CAL_814 "значение #814" VALUE 0x08062F86 RL_FNC_SWORD 0 CM_RAW -32768 32767 /end CHARACTERISTIC
/begin CHARACTERISTIC CAL_815 "значение #815" VALUE 0x08062F88 RL_FNC_SWORD 0 CM_RAW -32768 32767 /end CHARACTERISTIC
/begin CHARACTERISTIC CAL_816 "значение #816" VALUE 0x08062F8A RL_FNC_UWORD 0 CM_RAW 0 65535 /end CHARACTERISTIC
/begin CHARACTERISTIC CAL_817 "массив #817" VAL_BLK 0x08062F8C RL_FNC_SBYTE 0 CM_RAW -128 127 MATRIX_DIM 2 1 1 /end CHARACTERISTIC
/begin CHARACTERISTIC CAL_818 "значение #818" VALUE 0x08062F8E RL_FNC_UWORD 0 CM_RAW 0 65535 /end CHARACTERISTIC
/begin CHARACTERISTIC CAL_819 "карта #819 2x2: ? × ?" MAP 0x08062F90 RL_FNC_SBYTE 0 CM_RAW -128 127 /begin AXIS_DESCR COM_AXIS AXIN_0EB CM_RAW 2 -128 127 AXIS_PTS_REF AX_0EB /end AXIS_DESCR /begin AXIS_DESCR COM_AXIS AXIN_0EA CM_RAW 2 -128 127 AXIS_PTS_REF AX_0EA /end AXIS_DESCR /end CHARACTERISTIC
/begin CHARACTERISTIC CAL_81A "значение #81A" VALUE 0x08062F94 RL_FNC_UWORD 0 CM_RAW 0 65535 /end CHARACTERISTIC
/begin CHARACTERISTIC CAL_81B "значение #81B" VALUE 0x08062F96 RL_FNC_UWORD 0 CM_RAW 0 65535 /end CHARACTERISTIC
/begin CHARACTERISTIC CAL_81C "значение #81C" VALUE 0x08062F98 RL_FNC_UWORD 0 CM_RAW 0 65535 /end CHARACTERISTIC
/begin CHARACTERISTIC CAL_81D "значение #81D" VALUE 0x08062F9A RL_FNC_SBYTE 0 CM_RAW -128 127 /end CHARACTERISTIC
/begin CHARACTERISTIC CAL_81F "карта #81F 3x9: ? × ?" MAP 0x08062F60 RL_FNC_SBYTE 0 CM_RAW -128 127 /begin AXIS_DESCR COM_AXIS AXIN_070 CM_RAW 9 -128 127 AXIS_PTS_REF AX_070 /end AXIS_DESCR /begin AXIS_DESCR COM_AXIS AXIN_0EC CM_RAW 3 -128 127 AXIS_PTS_REF AX_0EC /end AXIS_DESCR /end CHARACTERISTIC
/begin CHARACTERISTIC CAL_820 "карта #820 3x6: ? × ?" MAP 0x08062F4C RL_FNC_SBYTE 0 CM_RAW -128 127 /begin AXIS_DESCR COM_AXIS AXIN_071 CM_RAW 6 -128 127 AXIS_PTS_REF AX_071 /end AXIS_DESCR /begin AXIS_DESCR COM_AXIS AXIN_0EC CM_RAW 3 -128 127 AXIS_PTS_REF AX_0EC /end AXIS_DESCR /end CHARACTERISTIC
/begin CHARACTERISTIC CAL_821 "значение #821" VALUE 0x08070244 RL_FNC_SBYTE 0 CM_RAW -128 127 /end CHARACTERISTIC
/begin CHARACTERISTIC CAL_822 "значение #822" VALUE 0x0806D2E4 RL_FNC_UWORD 0 CM_RAW 0 65535 /end CHARACTERISTIC
/begin CHARACTERISTIC CAL_823 "значение #823" VALUE 0x08063301 RL_FNC_SBYTE 0 CM_RAW -128 127 /end CHARACTERISTIC
/begin CHARACTERISTIC CAL_824 "значение #824" VALUE 0x080632E2 RL_FNC_UWORD 0 CM_RAW 0 65535 /end CHARACTERISTIC
/begin CHARACTERISTIC CAL_825 "значение #825" VALUE 0x08063307 RL_FNC_SBYTE 0 CM_RAW -128 127 /end CHARACTERISTIC
/begin CHARACTERISTIC CAL_826 "значение #826" VALUE 0x08063315 RL_FNC_SBYTE 0 CM_RAW -128 127 /end CHARACTERISTIC
/begin CHARACTERISTIC CAL_827 "значение #827" VALUE 0x08063336 RL_FNC_SBYTE 0 CM_RAW -128 127 /end CHARACTERISTIC
/begin CHARACTERISTIC CAL_828 "значение #828" VALUE 0x0806333A RL_FNC_SBYTE 0 CM_RAW -128 127 /end CHARACTERISTIC
/begin CHARACTERISTIC CAL_829 "значение #829" VALUE 0x0806333B RL_FNC_SBYTE 0 CM_RAW -128 127 /end CHARACTERISTIC
/begin CHARACTERISTIC CAL_82A "значение #82A" VALUE 0x08063356 RL_FNC_SBYTE 0 CM_RAW -128 127 /end CHARACTERISTIC
/begin CHARACTERISTIC CAL_82B "значение #82B" VALUE 0x08063362 RL_FNC_SBYTE 0 CM_RAW -128 127 /end CHARACTERISTIC
/begin CHARACTERISTIC CAL_82C "значение #82C" VALUE 0x080632EC RL_FNC_SBYTE 0 CM_RAW -128 127 /end CHARACTERISTIC
/begin CHARACTERISTIC CAL_82D "значение #82D" VALUE 0x080632E8 RL_FNC_SBYTE 0 CM_RAW -128 127 /end CHARACTERISTIC
/begin CHARACTERISTIC CAL_82E "значение #82E" VALUE 0x0806331A RL_FNC_SBYTE 0 CM_RAW -128 127 /end CHARACTERISTIC
/begin CHARACTERISTIC CAL_82F "значение #82F" VALUE 0x0806333E RL_FNC_SBYTE 0 CM_RAW -128 127 /end CHARACTERISTIC
/begin CHARACTERISTIC CAL_830 "значение #830" VALUE 0x080632E5 RL_FNC_SBYTE 0 CM_RAW -128 127 /end CHARACTERISTIC
/begin CHARACTERISTIC CAL_831 "значение #831" VALUE 0x08063308 RL_FNC_SBYTE 0 CM_RAW -128 127 /end CHARACTERISTIC
/begin CHARACTERISTIC CAL_832 "значение #832" VALUE 0x08063314 RL_FNC_SBYTE 0 CM_RAW -128 127 /end CHARACTERISTIC
/begin CHARACTERISTIC CAL_833 "значение #833" VALUE 0x0806333D RL_FNC_SBYTE 0 CM_RAW -128 127 /end CHARACTERISTIC
/begin CHARACTERISTIC CAL_834 "значение #834" VALUE 0x08063348 RL_FNC_SLONG 0 CM_RAW -2.14748e+09 2.14748e+09 /end CHARACTERISTIC
/begin CHARACTERISTIC CAL_835 "значение #835" VALUE 0x08063303 RL_FNC_SBYTE 0 CM_RAW -128 127 /end CHARACTERISTIC
/begin CHARACTERISTIC CAL_836 "значение #836" VALUE 0x08063340 RL_FNC_SBYTE 0 CM_RAW -128 127 /end CHARACTERISTIC
/begin CHARACTERISTIC CAL_837 "значение #837" VALUE 0x080632E0 RL_FNC_SBYTE 0 CM_RAW -128 127 /end CHARACTERISTIC
/begin CHARACTERISTIC CAL_838 "значение #838" VALUE 0x08063332 RL_FNC_SBYTE 0 CM_RAW -128 127 /end CHARACTERISTIC
/begin CHARACTERISTIC CAL_839 "значение #839" VALUE 0x080632F0 RL_FNC_SBYTE 0 CM_RAW -128 127 /end CHARACTERISTIC
/begin CHARACTERISTIC CAL_83A "значение #83A" VALUE 0x08063329 RL_FNC_SBYTE 0 CM_RAW -128 127 /end CHARACTERISTIC
/begin CHARACTERISTIC CAL_83B "значение #83B" VALUE 0x08063328 RL_FNC_SBYTE 0 CM_RAW -128 127 /end CHARACTERISTIC
/begin CHARACTERISTIC CAL_83C "значение #83C" VALUE 0x080632D0 RL_FNC_SWORD 0 CM_RAW -32768 32767 /end CHARACTERISTIC
/begin CHARACTERISTIC CAL_83D "значение #83D" VALUE 0x080632D2 RL_FNC_SWORD 0 CM_RAW -32768 32767 /end CHARACTERISTIC
/begin CHARACTERISTIC CAL_83E "значение #83E" VALUE 0x08063318 RL_FNC_SBYTE 0 CM_RAW -128 127 /end CHARACTERISTIC
/begin CHARACTERISTIC CAL_83F "значение #83F" VALUE 0x08063326 RL_FNC_SWORD 0 CM_RAW -32768 32767 /end CHARACTERISTIC
/begin CHARACTERISTIC CAL_840 "значение #840" VALUE 0x08063364 RL_FNC_SWORD 0 CM_RAW -32768 32767 /end CHARACTERISTIC
/begin CHARACTERISTIC CAL_841 "значение #841" VALUE 0x08063366 RL_FNC_SWORD 0 CM_RAW -32768 32767 /end CHARACTERISTIC
/begin CHARACTERISTIC CAL_842 "значение #842" VALUE 0x08063324 RL_FNC_SBYTE 0 CM_RAW -128 127 /end CHARACTERISTIC
/begin CHARACTERISTIC CAL_843 "значение #843" VALUE 0x0806335E RL_FNC_SWORD 0 CM_RAW -32768 32767 /end CHARACTERISTIC
/begin CHARACTERISTIC CAL_844 "значение #844" VALUE 0x080632CA RL_FNC_SBYTE 0 CM_RAW -128 127 /end CHARACTERISTIC
/begin CHARACTERISTIC CAL_845 "значение #845" VALUE 0x080632CB RL_FNC_SBYTE 0 CM_RAW -128 127 /end CHARACTERISTIC
/begin CHARACTERISTIC CAL_846 "значение #846" VALUE 0x08063337 RL_FNC_SBYTE 0 CM_RAW -128 127 /end CHARACTERISTIC
/begin CHARACTERISTIC CAL_847 "значение #847" VALUE 0x0806332C RL_FNC_SLONG 0 CM_RAW -2.14748e+09 2.14748e+09 /end CHARACTERISTIC
/begin CHARACTERISTIC CAL_848 "значение #848" VALUE 0x0806330D RL_FNC_SBYTE 0 CM_RAW -128 127 /end CHARACTERISTIC
/begin CHARACTERISTIC CAL_849 "значение #849" VALUE 0x08063319 RL_FNC_SBYTE 0 CM_RAW -128 127 /end CHARACTERISTIC
/begin CHARACTERISTIC CAL_84A "значение #84A" VALUE 0x08063304 RL_FNC_SBYTE 0 CM_RAW -128 127 /end CHARACTERISTIC
/begin CHARACTERISTIC CAL_84B "значение #84B" VALUE 0x080632E4 RL_FNC_SBYTE 0 CM_RAW -128 127 /end CHARACTERISTIC
/begin CHARACTERISTIC CAL_84C "значение #84C" VALUE 0x08063309 RL_FNC_SBYTE 0 CM_RAW -128 127 /end CHARACTERISTIC
/begin CHARACTERISTIC CAL_84D "значение #84D" VALUE 0x08063341 RL_FNC_SBYTE 0 CM_RAW -128 127 /end CHARACTERISTIC
/begin CHARACTERISTIC CAL_84E "значение #84E" VALUE 0x080632F3 RL_FNC_SBYTE 0 CM_RAW -128 127 /end CHARACTERISTIC
/begin CHARACTERISTIC CAL_84F "значение #84F" VALUE 0x08063344 RL_FNC_SWORD 0 CM_RAW -32768 32767 /end CHARACTERISTIC
/begin CHARACTERISTIC CAL_850 "значение #850" VALUE 0x08063302 RL_FNC_SBYTE 0 CM_RAW -128 127 /end CHARACTERISTIC
/begin CHARACTERISTIC CAL_851 "значение #851" VALUE 0x0806331C RL_FNC_SBYTE 0 CM_RAW -128 127 /end CHARACTERISTIC
/begin CHARACTERISTIC CAL_852 "значение #852" VALUE 0x0806334E RL_FNC_SBYTE 0 CM_RAW -128 127 /end CHARACTERISTIC
/begin CHARACTERISTIC CAL_853 "значение #853" VALUE 0x08063350 RL_FNC_SBYTE 0 CM_RAW -128 127 /end CHARACTERISTIC
/begin CHARACTERISTIC CAL_854 "значение #854" VALUE 0x08063317 RL_FNC_SBYTE 0 CM_RAW -128 127 /end CHARACTERISTIC
/begin CHARACTERISTIC CAL_855 "значение #855" VALUE 0x08063330 RL_FNC_SBYTE 0 CM_RAW -128 127 /end CHARACTERISTIC
/begin CHARACTERISTIC CAL_856 "значение #856" VALUE 0x0806333C RL_FNC_SBYTE 0 CM_RAW -128 127 /end CHARACTERISTIC
/begin CHARACTERISTIC CAL_857 "значение #857" VALUE 0x0806334D RL_FNC_SBYTE 0 CM_RAW -128 127 /end CHARACTERISTIC
/begin CHARACTERISTIC CAL_858 "значение #858" VALUE 0x08063354 RL_FNC_SBYTE 0 CM_RAW -128 127 /end CHARACTERISTIC
/begin CHARACTERISTIC CAL_859 "значение #859" VALUE 0x0806335A RL_FNC_SBYTE 0 CM_RAW -128 127 /end CHARACTERISTIC
/begin CHARACTERISTIC CAL_85A "значение #85A" VALUE 0x08063352 RL_FNC_SWORD 0 CM_RAW -32768 32767 /end CHARACTERISTIC
/begin CHARACTERISTIC CAL_85B "значение #85B" VALUE 0x080632D7 RL_FNC_SBYTE 0 CM_RAW -128 127 /end CHARACTERISTIC
/begin CHARACTERISTIC CAL_85C "значение #85C" VALUE 0x080632F8 RL_FNC_SBYTE 0 CM_RAW -128 127 /end CHARACTERISTIC
/begin CHARACTERISTIC CAL_85D "значение #85D" VALUE 0x08063346 RL_FNC_SBYTE 0 CM_RAW -128 127 /end CHARACTERISTIC
/begin CHARACTERISTIC CAL_85E "значение #85E" VALUE 0x08063358 RL_FNC_SWORD 0 CM_RAW -32768 32767 /end CHARACTERISTIC
/begin CHARACTERISTIC CAL_85F "значение #85F" VALUE 0x080632E6 RL_FNC_SBYTE 0 CM_RAW -128 127 /end CHARACTERISTIC
/begin CHARACTERISTIC CAL_860 "значение #860" VALUE 0x08063338 RL_FNC_SBYTE 0 CM_RAW -128 127 /end CHARACTERISTIC
/begin CHARACTERISTIC CAL_861 "значение #861" VALUE 0x080632E7 RL_FNC_SBYTE 0 CM_RAW -128 127 /end CHARACTERISTIC
/begin CHARACTERISTIC CAL_862 "значение #862" VALUE 0x08063312 RL_FNC_SBYTE 0 CM_RAW -128 127 /end CHARACTERISTIC
/begin CHARACTERISTIC CAL_863 "значение #863" VALUE 0x0806334C RL_FNC_SBYTE 0 CM_RAW -128 127 /end CHARACTERISTIC
/begin CHARACTERISTIC CAL_864 "значение #864" VALUE 0x080659AA RL_FNC_UWORD 0 CM_RAW 0 65535 /end CHARACTERISTIC
/begin CHARACTERISTIC CAL_865 "значение #865" VALUE 0x080659AC RL_FNC_UWORD 0 CM_RAW 0 65535 /end CHARACTERISTIC
/begin CHARACTERISTIC CAL_866 "значение #866" VALUE 0x080659AE RL_FNC_UWORD 0 CM_RAW 0 65535 /end CHARACTERISTIC
/begin CHARACTERISTIC CAL_867 "значение #867" VALUE 0x080659B0 RL_FNC_UWORD 0 CM_RAW 0 65535 /end CHARACTERISTIC
/begin CHARACTERISTIC CAL_868 "кривая #868 8: GEAR" CURVE 0x08071C84 RL_FNC_UWORD 0 CM_RAW 0 65535
 /begin AXIS_DESCR COM_AXIS AXIN_05E_GEAR CM_RAW 8 -128 127 AXIS_PTS_REF AX_05E_GEAR /end AXIS_DESCR
/end CHARACTERISTIC
/begin CHARACTERISTIC CAL_869_0 "кривая #869 8: GEAR [1/3]" CURVE 0x0806D0C8 RL_FNC_UWORD 0 CM_RAW 0 65535
 /begin AXIS_DESCR COM_AXIS AXIN_05E_GEAR CM_RAW 8 -128 127 AXIS_PTS_REF AX_05E_GEAR /end AXIS_DESCR
/end CHARACTERISTIC
/begin CHARACTERISTIC CAL_869_1 "кривая #869 8: GEAR [2/3]" CURVE 0x0806D0D8 RL_FNC_UWORD 0 CM_RAW 0 65535
 /begin AXIS_DESCR COM_AXIS AXIN_05E_GEAR CM_RAW 8 -128 127 AXIS_PTS_REF AX_05E_GEAR /end AXIS_DESCR
/end CHARACTERISTIC
/begin CHARACTERISTIC CAL_869_2 "кривая #869 8: GEAR [3/3]" CURVE 0x0806D0E8 RL_FNC_UWORD 0 CM_RAW 0 65535
 /begin AXIS_DESCR COM_AXIS AXIN_05E_GEAR CM_RAW 8 -128 127 AXIS_PTS_REF AX_05E_GEAR /end AXIS_DESCR
/end CHARACTERISTIC
/begin CHARACTERISTIC CAL_86A "кривая #86A 11: ?" CURVE 0x08071C40 RL_FNC_UWORD 0 CM_RAW 0 65535
 /begin AXIS_DESCR COM_AXIS AXIN_0B4 CM_RAW 11 -32768 32767 AXIS_PTS_REF AX_0B4 /end AXIS_DESCR
/end CHARACTERISTIC
/begin CHARACTERISTIC CAL_86B "значение #86B" VALUE 0x0806199A RL_FNC_SBYTE 0 CM_RAW -128 127 /end CHARACTERISTIC
/begin CHARACTERISTIC CAL_86C "карта #86C 2x2: ? × ?" MAP 0x080619A4 RL_FNC_UWORD 0 CM_RAW 0 65535 /begin AXIS_DESCR COM_AXIS AXIN_0ED CM_RAW 2 0 255 AXIS_PTS_REF AX_0ED /end AXIS_DESCR /begin AXIS_DESCR COM_AXIS AXIN_0ED CM_RAW 2 0 255 AXIS_PTS_REF AX_0ED /end AXIS_DESCR /end CHARACTERISTIC
/begin CHARACTERISTIC CAL_86D "массив #86D" VAL_BLK 0x080745BC RL_FNC_UWORD 0 CM_RAW 0 65535 MATRIX_DIM 2 1 1 /end CHARACTERISTIC
/begin CHARACTERISTIC CAL_86E "значение #86E" VALUE 0x08062C80 RL_FNC_UWORD 0 CM_RAW 0 65535 /end CHARACTERISTIC
/begin CHARACTERISTIC CAL_874 "массив #874" VAL_BLK 0x080690A8 RL_FNC_SBYTE 0 CM_RAW -128 127 MATRIX_DIM 8 1 1 /end CHARACTERISTIC
/begin CHARACTERISTIC CAL_875 "массив #875" VAL_BLK 0x080690B0 RL_FNC_SBYTE 0 CM_RAW -128 127 MATRIX_DIM 11 1 1 /end CHARACTERISTIC
/begin CHARACTERISTIC CAL_876 "массив #876" VAL_BLK 0x080690CC RL_FNC_SBYTE 0 CM_RAW -128 127 MATRIX_DIM 10 1 1 /end CHARACTERISTIC
/begin CHARACTERISTIC CAL_877 "массив #877" VAL_BLK 0x080690D8 RL_FNC_SBYTE 0 CM_RAW -128 127 MATRIX_DIM 4 1 1 /end CHARACTERISTIC
/begin CHARACTERISTIC CAL_878 "массив #878" VAL_BLK 0x080690E8 RL_FNC_SBYTE 0 CM_RAW -128 127 MATRIX_DIM 15 1 1 /end CHARACTERISTIC
/begin CHARACTERISTIC CAL_879 "массив #879" VAL_BLK 0x080690DC RL_FNC_SBYTE 0 CM_RAW -128 127 MATRIX_DIM 10 1 1 /end CHARACTERISTIC
/begin CHARACTERISTIC CAL_87A "массив #87A" VAL_BLK 0x080690F8 RL_FNC_SBYTE 0 CM_RAW -128 127 MATRIX_DIM 10 1 1 /end CHARACTERISTIC
/begin CHARACTERISTIC CAL_87B "массив #87B" VAL_BLK 0x08069104 RL_FNC_SBYTE 0 CM_RAW -128 127 MATRIX_DIM 15 1 1 /end CHARACTERISTIC
/begin CHARACTERISTIC CAL_87C "массив #87C" VAL_BLK 0x08069114 RL_FNC_SBYTE 0 CM_RAW -128 127 MATRIX_DIM 10 1 1 /end CHARACTERISTIC
/begin CHARACTERISTIC CAL_87D "массив #87D" VAL_BLK 0x08069120 RL_FNC_SBYTE 0 CM_RAW -128 127 MATRIX_DIM 11 1 1 /end CHARACTERISTIC
/begin CHARACTERISTIC CAL_87E "массив #87E" VAL_BLK 0x08069130 RL_FNC_SBYTE 0 CM_RAW -128 127 MATRIX_DIM 16 1 1 /end CHARACTERISTIC
/begin CHARACTERISTIC CAL_87F "массив #87F" VAL_BLK 0x08069140 RL_FNC_SBYTE 0 CM_RAW -128 127 MATRIX_DIM 10 1 1 /end CHARACTERISTIC
/begin CHARACTERISTIC CAL_880 "массив #880" VAL_BLK 0x08068FA0 RL_FNC_SBYTE 0 CM_RAW -128 127 MATRIX_DIM 7 1 1 /end CHARACTERISTIC
/begin CHARACTERISTIC CAL_881 "значение #881" VALUE 0x0806912C RL_FNC_UWORD 0 CM_RAW 0 65535 /end CHARACTERISTIC
/begin CHARACTERISTIC CAL_882 "массив #882" VAL_BLK 0x08069044 RL_FNC_SWORD 0 CM_RAW -32768 32767 MATRIX_DIM 10 1 1 /end CHARACTERISTIC
/begin CHARACTERISTIC CAL_883 "массив #883" VAL_BLK 0x080690C0 RL_FNC_SBYTE 0 CM_RAW -128 127 MATRIX_DIM 10 1 1 /end CHARACTERISTIC
/begin CHARACTERISTIC CAL_884 "значение #884" VALUE 0x0806EAB1 RL_FNC_SBYTE 0 CM_RAW -128 127 /end CHARACTERISTIC
/begin CHARACTERISTIC CAL_885 "значение #885" VALUE 0x0806EAB2 RL_FNC_SBYTE 0 CM_RAW -128 127 /end CHARACTERISTIC
/begin CHARACTERISTIC CAL_886 "значение #886" VALUE 0x0806EAB0 RL_FNC_SBYTE 0 CM_RAW -128 127 /end CHARACTERISTIC
/begin CHARACTERISTIC CAL_887 "значение #887" VALUE 0x0806EAB3 RL_FNC_SBYTE 0 CM_RAW -128 127 /end CHARACTERISTIC
/begin CHARACTERISTIC CAL_888 "значение #888" VALUE 0x0806EAB4 RL_FNC_SBYTE 0 CM_RAW -128 127 /end CHARACTERISTIC
/begin CHARACTERISTIC CAL_889 "массив #889" VAL_BLK 0x0806EAB8 RL_FNC_SBYTE 0 CM_RAW -128 127 MATRIX_DIM 20 1 1 /end CHARACTERISTIC
/begin CHARACTERISTIC CAL_88A "значение #88A" VALUE 0x0806912E RL_FNC_SBYTE 0 CM_RAW -128 127 /end CHARACTERISTIC
/begin CHARACTERISTIC CAL_88B "значение #88B" VALUE 0x0807463A RL_FNC_UWORD 0 CM_RAW 0 65535 /end CHARACTERISTIC
/begin CHARACTERISTIC CAL_88D "значение #88D" VALUE 0x0806969A RL_FNC_SBYTE 0 CM_RAW -128 127 /end CHARACTERISTIC
/begin CHARACTERISTIC CAL_88E "карта #88E 3x9: ? × ?" MAP 0x080696F0 RL_FNC_SBYTE 0 CM_RAW -128 127 /begin AXIS_DESCR COM_AXIS AXIN_070 CM_RAW 9 -128 127 AXIS_PTS_REF AX_070 /end AXIS_DESCR /begin AXIS_DESCR COM_AXIS AXIN_0EE CM_RAW 3 -128 127 AXIS_PTS_REF AX_0EE /end AXIS_DESCR /end CHARACTERISTIC
/begin CHARACTERISTIC CAL_88F "карта #88F 3x6: ? × ?" MAP 0x080696DC RL_FNC_SBYTE 0 CM_RAW -128 127 /begin AXIS_DESCR COM_AXIS AXIN_071 CM_RAW 6 -128 127 AXIS_PTS_REF AX_071 /end AXIS_DESCR /begin AXIS_DESCR COM_AXIS AXIN_0EE CM_RAW 3 -128 127 AXIS_PTS_REF AX_0EE /end AXIS_DESCR /end CHARACTERISTIC
/begin CHARACTERISTIC CAL_890 "массив #890" VAL_BLK 0x080690A0 RL_FNC_SWORD 0 CM_RAW -32768 32767 MATRIX_DIM 4 1 1 /end CHARACTERISTIC
/begin CHARACTERISTIC CAL_891 "значение #891" VALUE 0x080691EA RL_FNC_UWORD 0 CM_RAW 0 65535 /end CHARACTERISTIC
/begin CHARACTERISTIC CAL_893 "значение #893" VALUE 0x0806620C RL_FNC_UWORD 0 CM_RAW 0 65535 /end CHARACTERISTIC
/begin CHARACTERISTIC CAL_894 "значение #894" VALUE 0x0806620E RL_FNC_UBYTE 0 CM_RAW 0 255 /end CHARACTERISTIC
/begin CHARACTERISTIC CAL_895 "кривая #895 8: TAIR" CURVE 0x0806623C RL_FNC_UWORD 0 CM_RAW 0 65535
 /begin AXIS_DESCR COM_AXIS AXIN_049_TAIR CM_C128 8 -256 255.992 AXIS_PTS_REF AX_049_TAIR /end AXIS_DESCR
/end CHARACTERISTIC
/begin CHARACTERISTIC CAL_896 "значение #896" VALUE 0x08066238 RL_FNC_UWORD 0 CM_RAW 0 65535 /end CHARACTERISTIC
/begin CHARACTERISTIC CAL_897 "значение #897" VALUE 0x0806624C RL_FNC_UWORD 0 CM_RAW 0 65535 /end CHARACTERISTIC
/begin CHARACTERISTIC CAL_898 "массив #898" VAL_BLK 0x08066250 RL_FNC_UWORD 0 CM_RAW 0 65535 MATRIX_DIM 4 1 1 /end CHARACTERISTIC
/begin CHARACTERISTIC CAL_899 "массив #899" VAL_BLK 0x08066258 RL_FNC_UWORD 0 CM_RAW 0 65535 MATRIX_DIM 3 1 1 /end CHARACTERISTIC
/begin CHARACTERISTIC CAL_89A "карта #89A 4x2: ? × ?" MAP 0x0806627C RL_FNC_UWORD 0 CM_RAW 0 65535 /begin AXIS_DESCR COM_AXIS AXIN_0EF CM_RAW 2 -128 127 AXIS_PTS_REF AX_0EF /end AXIS_DESCR /begin AXIS_DESCR COM_AXIS AXIN_0F0 CM_RAW 4 -128 127 AXIS_PTS_REF AX_0F0 /end AXIS_DESCR /end CHARACTERISTIC
/begin CHARACTERISTIC CAL_89B "массив #89B" VAL_BLK 0x080662A0 RL_FNC_UWORD 0 CM_RAW 0 65535 MATRIX_DIM 2 1 1 /end CHARACTERISTIC
/begin CHARACTERISTIC CAL_89C "массив #89C" VAL_BLK 0x080662A4 RL_FNC_UWORD 0 CM_RAW 0 65535 MATRIX_DIM 2 1 1 /end CHARACTERISTIC
/begin CHARACTERISTIC CAL_89D "значение #89D" VALUE 0x080662A8 RL_FNC_UWORD 0 CM_RAW 0 65535 /end CHARACTERISTIC
/begin CHARACTERISTIC CAL_89E "значение #89E" VALUE 0x080662AA RL_FNC_UWORD 0 CM_RAW 0 65535 /end CHARACTERISTIC
/begin CHARACTERISTIC CAL_89F "значение #89F" VALUE 0x080662AC RL_FNC_SBYTE 0 CM_RAW -128 127 /end CHARACTERISTIC
/begin CHARACTERISTIC CAL_8A0 "значение #8A0" VALUE 0x08074574 RL_FNC_SWORD 0 CM_RAW -32768 32767 /end CHARACTERISTIC
/begin CHARACTERISTIC CAL_8A1 "значение #8A1" VALUE 0x08074576 RL_FNC_UWORD 0 CM_RAW 0 65535 /end CHARACTERISTIC
/begin CHARACTERISTIC CAL_8A2 "значение #8A2" VALUE 0x08074578 RL_FNC_UWORD 0 CM_RAW 0 65535 /end CHARACTERISTIC
/begin CHARACTERISTIC CAL_8A3 "массив #8A3" VAL_BLK 0x0807457C RL_FNC_SWORD 0 CM_RAW -32768 32767 MATRIX_DIM 2 1 1 /end CHARACTERISTIC
/begin CHARACTERISTIC CAL_8A4 "значение #8A4" VALUE 0x08074580 RL_FNC_UWORD 0 CM_RAW 0 65535 /end CHARACTERISTIC
/begin CHARACTERISTIC CAL_8A5 "значение #8A5" VALUE 0x08074582 RL_FNC_UWORD 0 CM_RAW 0 65535 /end CHARACTERISTIC
/begin CHARACTERISTIC CAL_8A6 "массив #8A6" VAL_BLK 0x08074588 RL_FNC_UWORD 0 CM_RAW 0 65535 MATRIX_DIM 2 1 1 /end CHARACTERISTIC
/begin CHARACTERISTIC CAL_8A8 "массив #8A8" VAL_BLK 0x08068098 RL_FNC_SBYTE 0 CM_RAW -128 127 MATRIX_DIM 4 1 1 /end CHARACTERISTIC
/begin CHARACTERISTIC CAL_8A9 "карта #8A9 3x9: ? × ?" MAP 0x080680E4 RL_FNC_SBYTE 0 CM_RAW -128 127 /begin AXIS_DESCR COM_AXIS AXIN_070 CM_RAW 9 -128 127 AXIS_PTS_REF AX_070 /end AXIS_DESCR /begin AXIS_DESCR COM_AXIS AXIN_0F1 CM_RAW 3 -128 127 AXIS_PTS_REF AX_0F1 /end AXIS_DESCR /end CHARACTERISTIC
/begin CHARACTERISTIC CAL_8AA_0 "карта #8AA 3x6: ? × ? [1/4]" MAP 0x0806809C RL_FNC_SBYTE 0 CM_RAW -128 127 /begin AXIS_DESCR COM_AXIS AXIN_071 CM_RAW 6 -128 127 AXIS_PTS_REF AX_071 /end AXIS_DESCR /begin AXIS_DESCR COM_AXIS AXIN_0F1 CM_RAW 3 -128 127 AXIS_PTS_REF AX_0F1 /end AXIS_DESCR /end CHARACTERISTIC
/begin CHARACTERISTIC CAL_8AA_1 "карта #8AA 3x6: ? × ? [2/4]" MAP 0x080680AE RL_FNC_SBYTE 0 CM_RAW -128 127 /begin AXIS_DESCR COM_AXIS AXIN_071 CM_RAW 6 -128 127 AXIS_PTS_REF AX_071 /end AXIS_DESCR /begin AXIS_DESCR COM_AXIS AXIN_0F1 CM_RAW 3 -128 127 AXIS_PTS_REF AX_0F1 /end AXIS_DESCR /end CHARACTERISTIC
/begin CHARACTERISTIC CAL_8AA_2 "карта #8AA 3x6: ? × ? [3/4]" MAP 0x080680C0 RL_FNC_SBYTE 0 CM_RAW -128 127 /begin AXIS_DESCR COM_AXIS AXIN_071 CM_RAW 6 -128 127 AXIS_PTS_REF AX_071 /end AXIS_DESCR /begin AXIS_DESCR COM_AXIS AXIN_0F1 CM_RAW 3 -128 127 AXIS_PTS_REF AX_0F1 /end AXIS_DESCR /end CHARACTERISTIC
/begin CHARACTERISTIC CAL_8AA_3 "карта #8AA 3x6: ? × ? [4/4]" MAP 0x080680D2 RL_FNC_SBYTE 0 CM_RAW -128 127 /begin AXIS_DESCR COM_AXIS AXIN_071 CM_RAW 6 -128 127 AXIS_PTS_REF AX_071 /end AXIS_DESCR /begin AXIS_DESCR COM_AXIS AXIN_0F1 CM_RAW 3 -128 127 AXIS_PTS_REF AX_0F1 /end AXIS_DESCR /end CHARACTERISTIC
/begin CHARACTERISTIC CAL_8AB "значение #8AB" VALUE 0x08069D54 RL_FNC_UWORD 0 CM_RAW 0 65535 /end CHARACTERISTIC
/begin CHARACTERISTIC CAL_8AC "значение #8AC" VALUE 0x08069936 RL_FNC_UBYTE 0 CM_RAW 0 255 /end CHARACTERISTIC
/begin CHARACTERISTIC CAL_8AD "значение #8AD" VALUE 0x08065C4C RL_FNC_SBYTE 0 CM_RAW -128 127 /end CHARACTERISTIC
/begin CHARACTERISTIC CAL_8AE "кривая #8AE 10: ?" CURVE 0x08062C6C RL_FNC_UWORD 0 CM_RAW 0 65535 /begin AXIS_DESCR COM_AXIS AXIN_0F2 CM_RAW 10 0 255 AXIS_PTS_REF AX_0F2 /end AXIS_DESCR /end CHARACTERISTIC
/begin CHARACTERISTIC CAL_8AF "карта #8AF 5x2: ? × ?" MAP 0x08066210 RL_FNC_UWORD 0 CM_RAW 0 65535 /begin AXIS_DESCR COM_AXIS AXIN_0F3 CM_RAW 2 -128 127 AXIS_PTS_REF AX_0F3 /end AXIS_DESCR /begin AXIS_DESCR COM_AXIS AXIN_0F4 CM_RAW 5 -128 127 AXIS_PTS_REF AX_0F4 /end AXIS_DESCR /end CHARACTERISTIC
/begin CHARACTERISTIC CAL_8B0 "карта #8B0 5x2: ? × ?" MAP 0x08066224 RL_FNC_UWORD 0 CM_RAW 0 65535 /begin AXIS_DESCR COM_AXIS AXIN_0F3 CM_RAW 2 -128 127 AXIS_PTS_REF AX_0F3 /end AXIS_DESCR /begin AXIS_DESCR COM_AXIS AXIN_0F4 CM_RAW 5 -128 127 AXIS_PTS_REF AX_0F4 /end AXIS_DESCR /end CHARACTERISTIC
/begin CHARACTERISTIC CAL_8B1 "массив #8B1" VAL_BLK 0x08066260 RL_FNC_UWORD 0 CM_RAW 0 65535 MATRIX_DIM 3 1 1 /end CHARACTERISTIC
/begin CHARACTERISTIC CAL_8B2 "карта #8B2 5x2: ? × ?" MAP 0x08066268 RL_FNC_UWORD 0 CM_RAW 0 65535 /begin AXIS_DESCR COM_AXIS AXIN_0F3 CM_RAW 2 -128 127 AXIS_PTS_REF AX_0F3 /end AXIS_DESCR /begin AXIS_DESCR COM_AXIS AXIN_0F4 CM_RAW 5 -128 127 AXIS_PTS_REF AX_0F4 /end AXIS_DESCR /end CHARACTERISTIC
/begin CHARACTERISTIC CAL_8B3 "карта #8B3 5x2: ? × ?" MAP 0x0806628C RL_FNC_UWORD 0 CM_RAW 0 65535 /begin AXIS_DESCR COM_AXIS AXIN_0F3 CM_RAW 2 -128 127 AXIS_PTS_REF AX_0F3 /end AXIS_DESCR /begin AXIS_DESCR COM_AXIS AXIN_0F4 CM_RAW 5 -128 127 AXIS_PTS_REF AX_0F4 /end AXIS_DESCR /end CHARACTERISTIC
/begin CHARACTERISTIC CAL_8B4 "массив #8B4" VAL_BLK 0x080662B0 RL_FNC_UWORD 0 CM_RAW 0 65535 MATRIX_DIM 4 1 1 /end CHARACTERISTIC
/begin CHARACTERISTIC CAL_8B5 "массив #8B5" VAL_BLK 0x080662B8 RL_FNC_UWORD 0 CM_RAW 0 65535 MATRIX_DIM 4 1 1 /end CHARACTERISTIC
/begin CHARACTERISTIC CAL_8B6 "значение #8B6" VALUE 0x080647B4 RL_FNC_UWORD 0 CM_RAW 0 65535 /end CHARACTERISTIC
/begin CHARACTERISTIC CAL_8B7 "значение #8B7" VALUE 0x08062E68 RL_FNC_UWORD 0 CM_RAW 0 65535 /end CHARACTERISTIC
/begin CHARACTERISTIC CAL_8B8 "значение #8B8" VALUE 0x08062EC8 RL_FNC_SWORD 0 CM_RAW -32768 32767 /end CHARACTERISTIC
/begin CHARACTERISTIC CAL_8BC "значение #8BC" VALUE 0x0807465B RL_FNC_SBYTE 0 CM_RAW -128 127 /end CHARACTERISTIC
/begin CHARACTERISTIC CAL_8BD "значение #8BD" VALUE 0x08068238 RL_FNC_SBYTE 0 CM_RAW -128 127 /end CHARACTERISTIC
/begin CHARACTERISTIC CAL_8BE "значение #8BE" VALUE 0x0806823C RL_FNC_SLONG 0 CM_RAW -2.14748e+09 2.14748e+09 /end CHARACTERISTIC
/begin CHARACTERISTIC CAL_8BF "значение #8BF" VALUE 0x08068F5C RL_FNC_SBYTE 0 CM_RAW -128 127 /end CHARACTERISTIC
/begin CHARACTERISTIC CAL_8C0 "значение #8C0" VALUE 0x08068F5A RL_FNC_UWORD 0 CM_RAW 0 65535 /end CHARACTERISTIC
/begin CHARACTERISTIC CAL_8C1 "значение #8C1" VALUE 0x08074616 RL_FNC_UWORD 0 CM_RAW 0 65535 /end CHARACTERISTIC
/begin CHARACTERISTIC CAL_8C2 "значение #8C2" VALUE 0x08074614 RL_FNC_UWORD 0 CM_RAW 0 65535 /end CHARACTERISTIC
/begin CHARACTERISTIC CAL_8C3 "массив #8C3" VAL_BLK 0x0806D2C4 RL_FNC_UWORD 0 CM_RAW 0 65535 MATRIX_DIM 2 1 1 /end CHARACTERISTIC
/begin CHARACTERISTIC CAL_8C4 "значение #8C4" VALUE 0x0806BB2E RL_FNC_SWORD 0 CM_RAW -32768 32767 /end CHARACTERISTIC
/begin CHARACTERISTIC CAL_8C5 "кривая #8C5 8: TAIR" CURVE 0x08073870 RL_FNC_UWORD 0 CM_RAW 0 65535
 /begin AXIS_DESCR COM_AXIS AXIN_049_TAIR CM_C128 8 -256 255.992 AXIS_PTS_REF AX_049_TAIR /end AXIS_DESCR
/end CHARACTERISTIC
/begin CHARACTERISTIC CAL_8C7 "массив #8C7" VAL_BLK 0x0806B770 RL_FNC_UWORD 0 CM_RAW 0 65535 MATRIX_DIM 2 1 1 /end CHARACTERISTIC
/begin CHARACTERISTIC CAL_8C8 "массив #8C8" VAL_BLK 0x0806B8A0 RL_FNC_UWORD 0 CM_RAW 0 65535 MATRIX_DIM 2 1 1 /end CHARACTERISTIC
/begin CHARACTERISTIC CAL_8C9 "массив #8C9" VAL_BLK 0x0806B8A4 RL_FNC_UWORD 0 CM_RAW 0 65535 MATRIX_DIM 2 1 1 /end CHARACTERISTIC
/begin CHARACTERISTIC CAL_8CA "массив #8CA" VAL_BLK 0x0806B74C RL_FNC_UWORD 0 CM_RAW 0 65535 MATRIX_DIM 2 1 1 /end CHARACTERISTIC
/begin CHARACTERISTIC CAL_8CB "массив #8CB" VAL_BLK 0x0806B89C RL_FNC_UWORD 0 CM_RAW 0 65535 MATRIX_DIM 2 1 1 /end CHARACTERISTIC
/begin CHARACTERISTIC CAL_8CC "массив #8CC" VAL_BLK 0x0806B88C RL_FNC_UWORD 0 CM_RAW 0 65535 MATRIX_DIM 2 1 1 /end CHARACTERISTIC
/begin CHARACTERISTIC CAL_8CD "массив #8CD" VAL_BLK 0x0806B890 RL_FNC_UWORD 0 CM_RAW 0 65535 MATRIX_DIM 2 1 1 /end CHARACTERISTIC
/begin CHARACTERISTIC CAL_8CE "карта #8CE 2x2: ? × ?" MAP 0x0806B894 RL_FNC_UWORD 0 CM_RAW 0 65535 /begin AXIS_DESCR COM_AXIS AXIN_0D4 CM_RAW 2 -128 127 AXIS_PTS_REF AX_0D4 /end AXIS_DESCR /begin AXIS_DESCR COM_AXIS AXIN_046 CM_RAW 2 -128 127 AXIS_PTS_REF AX_046 /end AXIS_DESCR /end CHARACTERISTIC
/begin CHARACTERISTIC CAL_8D0 "массив #8D0" VAL_BLK 0x0806B774 RL_FNC_UWORD 0 CM_RAW 0 65535 MATRIX_DIM 2 1 1 /end CHARACTERISTIC
/begin CHARACTERISTIC CAL_8D1 "массив #8D1" VAL_BLK 0x0806B888 RL_FNC_UWORD 0 CM_RAW 0 65535 MATRIX_DIM 2 1 1 /end CHARACTERISTIC
/begin CHARACTERISTIC CAL_8D2 "массив #8D2" VAL_BLK 0x0806B778 RL_FNC_SBYTE 0 CM_RAW -128 127 MATRIX_DIM 2 1 1 /end CHARACTERISTIC
/begin CHARACTERISTIC CAL_8D3 "массив #8D3" VAL_BLK 0x0806B77C RL_FNC_SBYTE 0 CM_RAW -128 127 MATRIX_DIM 2 1 1 /end CHARACTERISTIC
/begin CHARACTERISTIC CAL_8D4 "массив #8D4" VAL_BLK 0x0806B780 RL_FNC_UWORD 0 CM_RAW 0 65535 MATRIX_DIM 2 1 1 /end CHARACTERISTIC
/begin CHARACTERISTIC CAL_8D5 "массив #8D5" VAL_BLK 0x0806B784 RL_FNC_UWORD 0 CM_RAW 0 65535 MATRIX_DIM 2 1 1 /end CHARACTERISTIC
/begin CHARACTERISTIC CAL_8D6 "массив #8D6" VAL_BLK 0x0806B788 RL_FNC_UWORD 0 CM_RAW 0 65535 MATRIX_DIM 2 1 1 /end CHARACTERISTIC
/begin CHARACTERISTIC CAL_8D7 "массив #8D7" VAL_BLK 0x0806B78C RL_FNC_UWORD 0 CM_RAW 0 65535 MATRIX_DIM 2 1 1 /end CHARACTERISTIC
/begin CHARACTERISTIC CAL_8D8 "карта #8D8 8x9: ? × ?" MAP 0x0806B7F0 RL_FNC_SBYTE 0 CM_RAW -128 127 /begin AXIS_DESCR COM_AXIS AXIN_070 CM_RAW 9 -128 127 AXIS_PTS_REF AX_070 /end AXIS_DESCR /begin AXIS_DESCR COM_AXIS AXIN_0F8 CM_RAW 8 -128 127 AXIS_PTS_REF AX_0F8 /end AXIS_DESCR /end CHARACTERISTIC
/begin CHARACTERISTIC CAL_8D9 "карта #8D9 8x9: ? × ?" MAP 0x0806B838 RL_FNC_SBYTE 0 CM_RAW -128 127 /begin AXIS_DESCR COM_AXIS AXIN_070 CM_RAW 9 -128 127 AXIS_PTS_REF AX_070 /end AXIS_DESCR /begin AXIS_DESCR COM_AXIS AXIN_0F8 CM_RAW 8 -128 127 AXIS_PTS_REF AX_0F8 /end AXIS_DESCR /end CHARACTERISTIC
/begin CHARACTERISTIC CAL_8DA "карта #8DA 8x6: ? × ?" MAP 0x0806B790 RL_FNC_SBYTE 0 CM_RAW -128 127 /begin AXIS_DESCR COM_AXIS AXIN_071 CM_RAW 6 -128 127 AXIS_PTS_REF AX_071 /end AXIS_DESCR /begin AXIS_DESCR COM_AXIS AXIN_0F8 CM_RAW 8 -128 127 AXIS_PTS_REF AX_0F8 /end AXIS_DESCR /end CHARACTERISTIC
/begin CHARACTERISTIC CAL_8DB "карта #8DB 8x6: ? × ?" MAP 0x0806B7C0 RL_FNC_SBYTE 0 CM_RAW -128 127 /begin AXIS_DESCR COM_AXIS AXIN_071 CM_RAW 6 -128 127 AXIS_PTS_REF AX_071 /end AXIS_DESCR /begin AXIS_DESCR COM_AXIS AXIN_0F8 CM_RAW 8 -128 127 AXIS_PTS_REF AX_0F8 /end AXIS_DESCR /end CHARACTERISTIC
/begin CHARACTERISTIC CAL_8DE "массив #8DE" VAL_BLK 0x0806D310 RL_FNC_SBYTE 0 CM_RAW -128 127 MATRIX_DIM 4 1 1 /end CHARACTERISTIC
/begin CHARACTERISTIC CAL_8DF "карта #8DF 2x9: ? × ?" MAP 0x0806D2F8 RL_FNC_SBYTE 0 CM_RAW -128 127 /begin AXIS_DESCR COM_AXIS AXIN_070 CM_RAW 9 -128 127 AXIS_PTS_REF AX_070 /end AXIS_DESCR /begin AXIS_DESCR COM_AXIS AXIN_0E4 CM_RAW 2 -128 127 AXIS_PTS_REF AX_0E4 /end AXIS_DESCR /end CHARACTERISTIC
/begin CHARACTERISTIC CAL_8E0 "карта #8E0 2x6: ? × ?" MAP 0x0806D2EC RL_FNC_SBYTE 0 CM_RAW -128 127 /begin AXIS_DESCR COM_AXIS AXIN_071 CM_RAW 6 -128 127 AXIS_PTS_REF AX_071 /end AXIS_DESCR /begin AXIS_DESCR COM_AXIS AXIN_0E4 CM_RAW 2 -128 127 AXIS_PTS_REF AX_0E4 /end AXIS_DESCR /end CHARACTERISTIC
/begin CHARACTERISTIC CAL_8E2 "значение #8E2" VALUE 0x0806D2E8 RL_FNC_SBYTE 0 CM_RAW -128 127 /end CHARACTERISTIC
/begin CHARACTERISTIC CAL_8E6 "массив #8E6" VAL_BLK 0x080681C4 RL_FNC_SWORD 0 CM_RAW -32768 32767 MATRIX_DIM 8 1 1 /end CHARACTERISTIC
/begin CHARACTERISTIC CAL_8E7 "значение #8E7" VALUE 0x08070372 RL_FNC_SBYTE 0 CM_RAW -128 127 /end CHARACTERISTIC
/begin CHARACTERISTIC CAL_8E8 "массив #8E8" VAL_BLK 0x0806902C RL_FNC_SWORD 0 CM_RAW -32768 32767 MATRIX_DIM 11 1 1 /end CHARACTERISTIC
/begin CHARACTERISTIC CAL_8EB "значение #8EB" VALUE 0x080746AE RL_FNC_SBYTE 0 CM_RAW -128 127 /end CHARACTERISTIC
/begin CHARACTERISTIC CAL_8EC "значение #8EC" VALUE 0x08063DFA RL_FNC_UWORD 0 CM_RAW 0 65535 /end CHARACTERISTIC
/begin CHARACTERISTIC CAL_8ED "кривая #8ED 9: TCOOL" CURVE 0x08071CA8 RL_FNC_UWORD 0 CM_RAW 0 65535
 /begin AXIS_DESCR COM_AXIS AXIN_00A_TCOOL CM_C128 9 -256 255.992 AXIS_PTS_REF AX_00A_TCOOL /end AXIS_DESCR
/end CHARACTERISTIC
/begin CHARACTERISTIC CAL_8EE "кривая #8EE 9: TCOOL" CURVE 0x08071C70 RL_FNC_UWORD 0 CM_RAW 0 65535
 /begin AXIS_DESCR COM_AXIS AXIN_00A_TCOOL CM_C128 9 -256 255.992 AXIS_PTS_REF AX_00A_TCOOL /end AXIS_DESCR
/end CHARACTERISTIC
/begin CHARACTERISTIC CAL_8EF "кривая #8EF 9: TCOOL" CURVE 0x08071C94 RL_FNC_UWORD 0 CM_RAW 0 65535
 /begin AXIS_DESCR COM_AXIS AXIN_00A_TCOOL CM_C128 9 -256 255.992 AXIS_PTS_REF AX_00A_TCOOL /end AXIS_DESCR
/end CHARACTERISTIC
/begin CHARACTERISTIC CAL_8F0 "массив #8F0" VAL_BLK 0x0806CD08 RL_FNC_UWORD 0 CM_RAW 0 65535 MATRIX_DIM 2 1 1 /end CHARACTERISTIC
/begin CHARACTERISTIC CAL_8F1 "значение #8F1" VALUE 0x0806D2C8 RL_FNC_UWORD 0 CM_RAW 0 65535 /end CHARACTERISTIC
/begin CHARACTERISTIC CAL_8F2 "значение #8F2" VALUE 0x08070362 RL_FNC_UWORD 0 CM_RAW 0 65535 /end CHARACTERISTIC
/begin CHARACTERISTIC CAL_8F3 "значение #8F3" VALUE 0x08070724 RL_FNC_UWORD 0 CM_RAW 0 65535 /end CHARACTERISTIC
/begin CHARACTERISTIC CAL_8F8 "значение #8F8" VALUE 0x080746C9 RL_FNC_SBYTE 0 CM_RAW -128 127 /end CHARACTERISTIC
/begin CHARACTERISTIC CAL_8F9 "значение #8F9" VALUE 0x08066D89 RL_FNC_SBYTE 0 CM_RAW -128 127 /end CHARACTERISTIC
/begin CHARACTERISTIC CAL_8FA "значение #8FA" VALUE 0x08066D8A RL_FNC_UWORD 0 CM_RAW 0 65535 /end CHARACTERISTIC
/begin CHARACTERISTIC CAL_8FB "массив #8FB" VAL_BLK 0x08066D8C RL_FNC_SBYTE 0 CM_RAW -128 127 MATRIX_DIM 2 1 1 /end CHARACTERISTIC
/begin CHARACTERISTIC CAL_8FC "значение #8FC" VALUE 0x08066D8E RL_FNC_UWORD 0 CM_RAW 0 65535 /end CHARACTERISTIC
/begin CHARACTERISTIC CAL_902 "значение #902" VALUE 0x0807035C RL_FNC_SWORD 0 CM_RAW -32768 32767 /end CHARACTERISTIC
/begin CHARACTERISTIC CAL_903 "массив #903" VAL_BLK 0x0806B4E8 RL_FNC_UWORD 0 CM_RAW 0 65535 MATRIX_DIM 2 1 1 /end CHARACTERISTIC
/begin CHARACTERISTIC CAL_904 "значение #904" VALUE 0x080746C6 RL_FNC_SBYTE 0 CM_RAW -128 127 /end CHARACTERISTIC
/begin CHARACTERISTIC CAL_905 "значение #905" VALUE 0x080746C7 RL_FNC_SBYTE 0 CM_RAW -128 127 /end CHARACTERISTIC
/begin CHARACTERISTIC CAL_906 "массив #906" VAL_BLK 0x08068274 RL_FNC_SBYTE 0 CM_RAW -128 127 MATRIX_DIM 4 1 1 /end CHARACTERISTIC
/begin CHARACTERISTIC CAL_907 "массив #907" VAL_BLK 0x08068F78 RL_FNC_SBYTE 0 CM_RAW -128 127 MATRIX_DIM 4 1 1 /end CHARACTERISTIC
/begin CHARACTERISTIC CAL_908 "значение #908" VALUE 0x0806EAD0 RL_FNC_UWORD 0 CM_RAW 0 65535 /end CHARACTERISTIC
/begin CHARACTERISTIC CAL_909 "значение #909" VALUE 0x0806EACC RL_FNC_SLONG 0 CM_RAW -2.14748e+09 2.14748e+09 /end CHARACTERISTIC
/begin CHARACTERISTIC CAL_90A "кривая #90A 9: N" CURVE 0x0807104C RL_FNC_UWORD 0 CM_RAW 0 65535
 /begin AXIS_DESCR COM_AXIS AXIN_0AD_N CM_RPM2 9 0 32767.5 AXIS_PTS_REF AX_0AD_N /end AXIS_DESCR
/end CHARACTERISTIC
/begin CHARACTERISTIC CAL_90B_0 "кривая #90B 17: N [1/2]" CURVE 0x08071BF4 RL_FNC_UWORD 0 CM_RAW 0 65535
 /begin AXIS_DESCR COM_AXIS AXIN_001_N CM_RPM2 17 0 32767.5 AXIS_PTS_REF AX_001_N /end AXIS_DESCR
/end CHARACTERISTIC
/begin CHARACTERISTIC CAL_90B_1 "кривая #90B 17: N [2/2]" CURVE 0x08071C16 RL_FNC_UWORD 0 CM_RAW 0 65535
 /begin AXIS_DESCR COM_AXIS AXIN_001_N CM_RPM2 17 0 32767.5 AXIS_PTS_REF AX_001_N /end AXIS_DESCR
/end CHARACTERISTIC
/begin CHARACTERISTIC CAL_90C "кривая #90C 9: N" CURVE 0x08071038 RL_FNC_UWORD 0 CM_RAW 0 65535
 /begin AXIS_DESCR COM_AXIS AXIN_0AD_N CM_RPM2 9 0 32767.5 AXIS_PTS_REF AX_0AD_N /end AXIS_DESCR
/end CHARACTERISTIC
/begin CHARACTERISTIC CAL_90D_0 "кривая #90D 17: N [1/2]" CURVE 0x08071BB0 RL_FNC_UWORD 0 CM_RAW 0 65535
 /begin AXIS_DESCR COM_AXIS AXIN_001_N CM_RPM2 17 0 32767.5 AXIS_PTS_REF AX_001_N /end AXIS_DESCR
/end CHARACTERISTIC
/begin CHARACTERISTIC CAL_90D_1 "кривая #90D 17: N [2/2]" CURVE 0x08071BD2 RL_FNC_UWORD 0 CM_RAW 0 65535
 /begin AXIS_DESCR COM_AXIS AXIN_001_N CM_RPM2 17 0 32767.5 AXIS_PTS_REF AX_001_N /end AXIS_DESCR
/end CHARACTERISTIC
/begin CHARACTERISTIC CAL_90E "массив #90E" VAL_BLK 0x08065BB4 RL_FNC_UWORD 0 CM_RAW 0 65535 MATRIX_DIM 2 1 1 /end CHARACTERISTIC
/begin CHARACTERISTIC CAL_90F "массив #90F" VAL_BLK 0x08065BB0 RL_FNC_UWORD 0 CM_RAW 0 65535 MATRIX_DIM 2 1 1 /end CHARACTERISTIC
/begin CHARACTERISTIC CAL_910 "массив #910" VAL_BLK 0x08073610 RL_FNC_UWORD 0 CM_RAW 0 65535 MATRIX_DIM 2 1 1 /end CHARACTERISTIC
/begin CHARACTERISTIC CAL_911 "массив #911" VAL_BLK 0x0806BC48 RL_FNC_UWORD 0 CM_RAW 0 65535 MATRIX_DIM 2 1 1 /end CHARACTERISTIC
/begin CHARACTERISTIC CAL_912 "массив #912" VAL_BLK 0x0806BC40 RL_FNC_UWORD 0 CM_RAW 0 65535 MATRIX_DIM 2 1 1 /end CHARACTERISTIC
/begin CHARACTERISTIC CAL_913 "массив #913" VAL_BLK 0x0806BC44 RL_FNC_UWORD 0 CM_RAW 0 65535 MATRIX_DIM 2 1 1 /end CHARACTERISTIC
/begin CHARACTERISTIC CAL_914 "значение #914" VALUE 0x08073608 RL_FNC_SWORD 0 CM_RAW -32768 32767 /end CHARACTERISTIC
/begin CHARACTERISTIC CAL_915 "значение #915" VALUE 0x08064424 RL_FNC_UWORD 0 CM_RAW 0 65535 /end CHARACTERISTIC
/begin CHARACTERISTIC CAL_916 "значение #916" VALUE 0x08066D90 RL_FNC_UWORD 0 CM_RAW 0 65535 /end CHARACTERISTIC
/begin CHARACTERISTIC CAL_918 "значение #918" VALUE 0x08068F64 RL_FNC_SBYTE 0 CM_RAW -128 127 /end CHARACTERISTIC
/begin CHARACTERISTIC CAL_919 "значение #919" VALUE 0x08068F7C RL_FNC_UWORD 0 CM_RAW 0 65535 /end CHARACTERISTIC
/begin CHARACTERISTIC CAL_91A "кривая #91A 14: UBAT" CURVE 0x08068044 RL_FNC_SWORD 0 CM_RAW -32768 32767
 /begin AXIS_DESCR COM_AXIS AXIN_003_UBAT CM_RAW 14 0 65535 AXIS_PTS_REF AX_003_UBAT /end AXIS_DESCR
/end CHARACTERISTIC
/begin CHARACTERISTIC CAL_91B "кривая #91B 14: UBAT" CURVE 0x08068060 RL_FNC_SWORD 0 CM_RAW -32768 32767
 /begin AXIS_DESCR COM_AXIS AXIN_003_UBAT CM_RAW 14 0 65535 AXIS_PTS_REF AX_003_UBAT /end AXIS_DESCR
/end CHARACTERISTIC
/begin CHARACTERISTIC CAL_91C "кривая #91C 14: UBAT" CURVE 0x08068100 RL_FNC_SWORD 0 CM_RAW -32768 32767
 /begin AXIS_DESCR COM_AXIS AXIN_003_UBAT CM_RAW 14 0 65535 AXIS_PTS_REF AX_003_UBAT /end AXIS_DESCR
/end CHARACTERISTIC
/begin CHARACTERISTIC CAL_91D "кривая #91D 14: UBAT" CURVE 0x0806811C RL_FNC_SWORD 0 CM_RAW -32768 32767
 /begin AXIS_DESCR COM_AXIS AXIN_003_UBAT CM_RAW 14 0 65535 AXIS_PTS_REF AX_003_UBAT /end AXIS_DESCR
/end CHARACTERISTIC
/begin CHARACTERISTIC CAL_91E "кривая #91E 14: UBAT" CURVE 0x08068138 RL_FNC_SWORD 0 CM_RAW -32768 32767
 /begin AXIS_DESCR COM_AXIS AXIN_003_UBAT CM_RAW 14 0 65535 AXIS_PTS_REF AX_003_UBAT /end AXIS_DESCR
/end CHARACTERISTIC
/begin CHARACTERISTIC CAL_91F "кривая #91F 14: UBAT" CURVE 0x0806807C RL_FNC_SWORD 0 CM_RAW -32768 32767
 /begin AXIS_DESCR COM_AXIS AXIN_003_UBAT CM_RAW 14 0 65535 AXIS_PTS_REF AX_003_UBAT /end AXIS_DESCR
/end CHARACTERISTIC
/begin CHARACTERISTIC CAL_920 "кривая #920 14: UBAT" CURVE 0x08068154 RL_FNC_SWORD 0 CM_RAW -32768 32767
 /begin AXIS_DESCR COM_AXIS AXIN_003_UBAT CM_RAW 14 0 65535 AXIS_PTS_REF AX_003_UBAT /end AXIS_DESCR
/end CHARACTERISTIC
/begin CHARACTERISTIC CAL_921 "кривая #921 14: UBAT" CURVE 0x08068170 RL_FNC_SWORD 0 CM_RAW -32768 32767
 /begin AXIS_DESCR COM_AXIS AXIN_003_UBAT CM_RAW 14 0 65535 AXIS_PTS_REF AX_003_UBAT /end AXIS_DESCR
/end CHARACTERISTIC
/begin CHARACTERISTIC CAL_922 "кривая #922 14: UBAT" CURVE 0x0806818C RL_FNC_SWORD 0 CM_RAW -32768 32767
 /begin AXIS_DESCR COM_AXIS AXIN_003_UBAT CM_RAW 14 0 65535 AXIS_PTS_REF AX_003_UBAT /end AXIS_DESCR
/end CHARACTERISTIC
/begin CHARACTERISTIC CAL_923 "кривая #923 14: UBAT" CURVE 0x080681A8 RL_FNC_SWORD 0 CM_RAW -32768 32767
 /begin AXIS_DESCR COM_AXIS AXIN_003_UBAT CM_RAW 14 0 65535 AXIS_PTS_REF AX_003_UBAT /end AXIS_DESCR
/end CHARACTERISTIC
/begin CHARACTERISTIC CAL_924 "значение #924" VALUE 0x080624EA RL_FNC_UWORD 0 CM_RAW 0 65535 /end CHARACTERISTIC
/begin CHARACTERISTIC CAL_925 "значение #925" VALUE 0x08064420 RL_FNC_SWORD 0 CM_RAW -32768 32767 /end CHARACTERISTIC
/begin CHARACTERISTIC CAL_926 "значение #926" VALUE 0x0806E7BA RL_FNC_SBYTE 0 CM_RAW -128 127 /end CHARACTERISTIC
/begin CHARACTERISTIC CAL_927 "значение #927" VALUE 0x08064428 RL_FNC_UWORD 0 CM_RAW 0 65535 /end CHARACTERISTIC
/begin CHARACTERISTIC CAL_928 "значение #928" VALUE 0x0806442A RL_FNC_UWORD 0 CM_RAW 0 65535 /end CHARACTERISTIC
/begin CHARACTERISTIC CAL_929 "значение #929" VALUE 0x08064426 RL_FNC_UWORD 0 CM_RAW 0 65535 /end CHARACTERISTIC
/begin CHARACTERISTIC CAL_92A "значение #92A" VALUE 0x0806442C RL_FNC_SWORD 0 CM_RAW -32768 32767 /end CHARACTERISTIC
/begin CHARACTERISTIC CAL_92B "значение #92B" VALUE 0x08066D98 RL_FNC_SWORD 0 CM_RAW -32768 32767 /end CHARACTERISTIC
/begin CHARACTERISTIC CAL_92C "значение #92C" VALUE 0x08066D94 RL_FNC_UWORD 0 CM_RAW 0 65535 /end CHARACTERISTIC
/begin CHARACTERISTIC CAL_92D "значение #92D" VALUE 0x08066D96 RL_FNC_UWORD 0 CM_RAW 0 65535 /end CHARACTERISTIC
/begin CHARACTERISTIC CAL_92E "значение #92E" VALUE 0x08066D92 RL_FNC_UWORD 0 CM_RAW 0 65535 /end CHARACTERISTIC
/begin CHARACTERISTIC CAL_92F "массив #92F" VAL_BLK 0x0806AA20 RL_FNC_UWORD 0 CM_RAW 0 65535 MATRIX_DIM 2 1 1 /end CHARACTERISTIC
/begin CHARACTERISTIC CAL_930 "значение #930" VALUE 0x0806AA1E RL_FNC_UWORD 0 CM_RAW 0 65535 /end CHARACTERISTIC
/begin CHARACTERISTIC CAL_931 "значение #931" VALUE 0x0806A856 RL_FNC_UWORD 0 CM_RAW 0 65535 /end CHARACTERISTIC
/begin CHARACTERISTIC CAL_932 "значение #932" VALUE 0x0806A85A RL_FNC_SWORD 0 CM_RAW -32768 32767 /end CHARACTERISTIC
/begin CHARACTERISTIC CAL_933_0 "кривая #933 17: N [1/2]" CURVE 0x0806A864 RL_FNC_UWORD 0 CM_RAW 0 65535
 /begin AXIS_DESCR COM_AXIS AXIN_001_N CM_RPM2 17 0 32767.5 AXIS_PTS_REF AX_001_N /end AXIS_DESCR
/end CHARACTERISTIC
/begin CHARACTERISTIC CAL_933_1 "кривая #933 17: N [2/2]" CURVE 0x0806A886 RL_FNC_UWORD 0 CM_RAW 0 65535
 /begin AXIS_DESCR COM_AXIS AXIN_001_N CM_RPM2 17 0 32767.5 AXIS_PTS_REF AX_001_N /end AXIS_DESCR
/end CHARACTERISTIC
/begin CHARACTERISTIC CAL_934 "массив #934" VAL_BLK 0x0806A974 RL_FNC_UWORD 0 CM_RAW 0 65535 MATRIX_DIM 2 1 1 /end CHARACTERISTIC
/begin CHARACTERISTIC CAL_935 "значение #935" VALUE 0x0806A97A RL_FNC_UWORD 0 CM_RAW 0 65535 /end CHARACTERISTIC
/begin CHARACTERISTIC CAL_936 "значение #936" VALUE 0x0806AA26 RL_FNC_UWORD 0 CM_RAW 0 65535 /end CHARACTERISTIC
/begin CHARACTERISTIC CAL_937 "значение #937" VALUE 0x0806AA24 RL_FNC_UWORD 0 CM_RAW 0 65535 /end CHARACTERISTIC
/begin CHARACTERISTIC CAL_938 "значение #938" VALUE 0x0806A978 RL_FNC_UWORD 0 CM_RAW 0 65535 /end CHARACTERISTIC
/begin CHARACTERISTIC CAL_93B "массив #93B" VAL_BLK 0x0806A860 RL_FNC_UWORD 0 CM_RAW 0 65535 MATRIX_DIM 2 1 1 /end CHARACTERISTIC
/begin CHARACTERISTIC CAL_93C "массив #93C" VAL_BLK 0x0806A8A8 RL_FNC_SBYTE 0 CM_RAW -128 127 MATRIX_DIM 2 1 1 /end CHARACTERISTIC
/begin CHARACTERISTIC CAL_93D "карта #93D 10x10: N × LOAD" MAP 0x0806A8AC RL_FNC_UWORD 0 CM_RAW 0 65535
 /begin AXIS_DESCR COM_AXIS AXIN_00C_N CM_RPM2 10 0 32767.5 AXIS_PTS_REF AX_00C_N /end AXIS_DESCR
 /begin AXIS_DESCR COM_AXIS AXIN_01E_LOAD CM_RAW 10 0 65535 AXIS_PTS_REF AX_01E_LOAD /end AXIS_DESCR
/end CHARACTERISTIC
/begin CHARACTERISTIC CAL_93E "карта #93E 5x9: ? × ?" MAP 0x0806A9C0 RL_FNC_SBYTE 0 CM_RAW -128 127 /begin AXIS_DESCR COM_AXIS AXIN_070 CM_RAW 9 -128 127 AXIS_PTS_REF AX_070 /end AXIS_DESCR /begin AXIS_DESCR COM_AXIS AXIN_0F9 CM_RAW 5 -128 127 AXIS_PTS_REF AX_0F9 /end AXIS_DESCR /end CHARACTERISTIC
/begin CHARACTERISTIC CAL_93F "карта #93F 5x9: ? × ?" MAP 0x0806A9F0 RL_FNC_SBYTE 0 CM_RAW -128 127 /begin AXIS_DESCR COM_AXIS AXIN_070 CM_RAW 9 -128 127 AXIS_PTS_REF AX_070 /end AXIS_DESCR /begin AXIS_DESCR COM_AXIS AXIN_0F9 CM_RAW 5 -128 127 AXIS_PTS_REF AX_0F9 /end AXIS_DESCR /end CHARACTERISTIC
/begin CHARACTERISTIC CAL_940 "карта #940 5x6: ? × ?" MAP 0x0806A980 RL_FNC_SBYTE 0 CM_RAW -128 127 /begin AXIS_DESCR COM_AXIS AXIN_071 CM_RAW 6 -128 127 AXIS_PTS_REF AX_071 /end AXIS_DESCR /begin AXIS_DESCR COM_AXIS AXIN_0F9 CM_RAW 5 -128 127 AXIS_PTS_REF AX_0F9 /end AXIS_DESCR /end CHARACTERISTIC
/begin CHARACTERISTIC CAL_941 "карта #941 5x6: ? × ?" MAP 0x0806A9A0 RL_FNC_SBYTE 0 CM_RAW -128 127 /begin AXIS_DESCR COM_AXIS AXIN_071 CM_RAW 6 -128 127 AXIS_PTS_REF AX_071 /end AXIS_DESCR /begin AXIS_DESCR COM_AXIS AXIN_0F9 CM_RAW 5 -128 127 AXIS_PTS_REF AX_0F9 /end AXIS_DESCR /end CHARACTERISTIC
/begin CHARACTERISTIC CAL_942 "значение #942" VALUE 0x0806A97C RL_FNC_UWORD 0 CM_RAW 0 65535 /end CHARACTERISTIC
/begin CHARACTERISTIC CAL_943 "значение #943" VALUE 0x0806A97E RL_FNC_UWORD 0 CM_RAW 0 65535 /end CHARACTERISTIC
/begin CHARACTERISTIC CAL_946 "значение #946" VALUE 0x0806555E RL_FNC_SWORD 0 CM_RAW -32768 32767 /end CHARACTERISTIC
/begin CHARACTERISTIC CAL_947 "значение #947" VALUE 0x08065560 RL_FNC_SWORD 0 CM_RAW -32768 32767 /end CHARACTERISTIC
/begin CHARACTERISTIC CAL_948 "значение #948" VALUE 0x08065562 RL_FNC_SWORD 0 CM_RAW -32768 32767 /end CHARACTERISTIC
/begin CHARACTERISTIC CAL_949 "массив #949" VAL_BLK 0x080691E0 RL_FNC_UWORD 0 CM_RAW 0 65535 MATRIX_DIM 2 1 1 /end CHARACTERISTIC
/begin CHARACTERISTIC CAL_94A "массив #94A" VAL_BLK 0x080691E4 RL_FNC_UWORD 0 CM_RAW 0 65535 MATRIX_DIM 2 1 1 /end CHARACTERISTIC
/begin CHARACTERISTIC CAL_94B "значение #94B" VALUE 0x08065406 RL_FNC_SWORD 0 CM_RAW -32768 32767 /end CHARACTERISTIC
/begin CHARACTERISTIC CAL_94E "значение #94E" VALUE 0x0806E7B8 RL_FNC_SWORD 0 CM_RAW -32768 32767 /end CHARACTERISTIC
/begin CHARACTERISTIC CAL_94F "значение #94F" VALUE 0x0806A858 RL_FNC_SWORD 0 CM_RAW -32768 32767 /end CHARACTERISTIC
/begin CHARACTERISTIC CAL_951 "значение #951" VALUE 0x0807030C RL_FNC_SWORD 0 CM_RAW -32768 32767 /end CHARACTERISTIC
/begin CHARACTERISTIC CAL_952 "значение #952" VALUE 0x080690BC RL_FNC_UWORD 0 CM_RAW 0 65535 /end CHARACTERISTIC
/begin CHARACTERISTIC CAL_953 "карта #953 6x15: ? × ?" MAP 0x08074448 RL_FNC_SWORD 0 CM_RAW -32768 32767
 /begin AXIS_DESCR COM_AXIS AXIN_0FD CM_RAW 15 -32768 32767 AXIS_PTS_REF AX_0FD /end AXIS_DESCR
 /begin AXIS_DESCR COM_AXIS AXIN_0FB CM_RAW 6 0 65535 AXIS_PTS_REF AX_0FB /end AXIS_DESCR
/end CHARACTERISTIC
/begin CHARACTERISTIC CAL_954_0 "кривая #954 16: ? [1/2]" CURVE 0x080744FC RL_FNC_SWORD 0 CM_RAW -32768 32767 /begin AXIS_DESCR COM_AXIS AXIN_0FC CM_RAW 16 0 65535 AXIS_PTS_REF AX_0FC /end AXIS_DESCR /end CHARACTERISTIC
/begin CHARACTERISTIC CAL_954_1 "кривая #954 16: ? [2/2]" CURVE 0x0807451C RL_FNC_SWORD 0 CM_RAW -32768 32767 /begin AXIS_DESCR COM_AXIS AXIN_0FC CM_RAW 16 0 65535 AXIS_PTS_REF AX_0FC /end AXIS_DESCR /end CHARACTERISTIC
/begin CHARACTERISTIC CAL_955 "карта #955 16x6: ? × ?" MAP 0x08073F3C RL_FNC_UWORD 0 CM_RAW 0 65535 /begin AXIS_DESCR COM_AXIS AXIN_0FB CM_RAW 6 0 65535 AXIS_PTS_REF AX_0FB /end AXIS_DESCR /begin AXIS_DESCR COM_AXIS AXIN_0FC CM_RAW 16 0 65535 AXIS_PTS_REF AX_0FC /end AXIS_DESCR /end CHARACTERISTIC
/begin CHARACTERISTIC CAL_956 "кривая #956 16: ?" CURVE 0x08074408 RL_FNC_UWORD 0 CM_RAW 0 65535 /begin AXIS_DESCR COM_AXIS AXIN_0FC CM_RAW 16 0 65535 AXIS_PTS_REF AX_0FC /end AXIS_DESCR /end CHARACTERISTIC
/begin CHARACTERISTIC CAL_957 "кривая #957 16: ?" CURVE 0x08074428 RL_FNC_UWORD 0 CM_RAW 0 65535 /begin AXIS_DESCR COM_AXIS AXIN_0FC CM_RAW 16 0 65535 AXIS_PTS_REF AX_0FC /end AXIS_DESCR /end CHARACTERISTIC
/begin CHARACTERISTIC CAL_958 "кривая #958 16: ?" CURVE 0x08073EFC RL_FNC_UWORD 0 CM_RAW 0 65535 /begin AXIS_DESCR COM_AXIS AXIN_0FC CM_RAW 16 0 65535 AXIS_PTS_REF AX_0FC /end AXIS_DESCR /end CHARACTERISTIC
/begin CHARACTERISTIC CAL_959 "кривая #959 16: ?" CURVE 0x08073F1C RL_FNC_UWORD 0 CM_RAW 0 65535 /begin AXIS_DESCR COM_AXIS AXIN_0FC CM_RAW 16 0 65535 AXIS_PTS_REF AX_0FC /end AXIS_DESCR /end CHARACTERISTIC
/begin CHARACTERISTIC CAL_95A "кривая #95A 16: ?" CURVE 0x08073EBC RL_FNC_UWORD 0 CM_RAW 0 65535 /begin AXIS_DESCR COM_AXIS AXIN_0FC CM_RAW 16 0 65535 AXIS_PTS_REF AX_0FC /end AXIS_DESCR /end CHARACTERISTIC
/begin CHARACTERISTIC CAL_95B "кривая #95B 16: ?" CURVE 0x08073EDC RL_FNC_UWORD 0 CM_RAW 0 65535 /begin AXIS_DESCR COM_AXIS AXIN_0FC CM_RAW 16 0 65535 AXIS_PTS_REF AX_0FC /end AXIS_DESCR /end CHARACTERISTIC
/begin CHARACTERISTIC CAL_95C "значение #95C" VALUE 0x08073EB8 RL_FNC_SBYTE 0 CM_RAW -128 127 /end CHARACTERISTIC
/begin CHARACTERISTIC CAL_95D "значение #95D" VALUE 0x080746C8 RL_FNC_SBYTE 0 CM_RAW -128 127 /end CHARACTERISTIC
/begin CHARACTERISTIC CAL_95E "значение #95E" VALUE 0x080632CD RL_FNC_SBYTE 0 CM_RAW -128 127 /end CHARACTERISTIC
/begin CHARACTERISTIC CAL_95F "кривая #95F 8: N" CURVE 0x080706B4 RL_FNC_UWORD 0 CM_RAW 0 65535
 /begin AXIS_DESCR COM_AXIS AXIN_050_N CM_RPM2 8 0 32767.5 AXIS_PTS_REF AX_050_N /end AXIS_DESCR
/end CHARACTERISTIC
/begin CHARACTERISTIC CAL_960 "кривая #960 8: TAIR" CURVE 0x08068488 RL_FNC_UWORD 0 CM_RAW 0 65535
 /begin AXIS_DESCR COM_AXIS AXIN_049_TAIR CM_C128 8 -256 255.992 AXIS_PTS_REF AX_049_TAIR /end AXIS_DESCR
/end CHARACTERISTIC
/begin CHARACTERISTIC CAL_961 "значение #961" VALUE 0x08066DDA RL_FNC_SWORD 0 CM_RAW -32768 32767 /end CHARACTERISTIC
/begin CHARACTERISTIC CAL_962 "значение #962" VALUE 0x08066DDC RL_FNC_UWORD 0 CM_RAW 0 65535 /end CHARACTERISTIC
/begin CHARACTERISTIC CAL_963 "значение #963" VALUE 0x08066DDE RL_FNC_UWORD 0 CM_RAW 0 65535 /end CHARACTERISTIC
/begin CHARACTERISTIC CAL_964 "значение #964" VALUE 0x08066DE0 RL_FNC_UWORD 0 CM_RAW 0 65535 /end CHARACTERISTIC
/begin CHARACTERISTIC CAL_965 "значение #965" VALUE 0x08066DE2 RL_FNC_UWORD 0 CM_RAW 0 65535 /end CHARACTERISTIC
/begin CHARACTERISTIC CAL_966 "значение #966" VALUE 0x08066DD6 RL_FNC_UWORD 0 CM_RAW 0 65535 /end CHARACTERISTIC
/begin CHARACTERISTIC CAL_967 "значение #967" VALUE 0x08066DD8 RL_FNC_UWORD 0 CM_RAW 0 65535 /end CHARACTERISTIC
/begin CHARACTERISTIC CAL_968 "кривая #968 9: TCOOL" CURVE 0x0807461C RL_FNC_UWORD 0 CM_RAW 0 65535
 /begin AXIS_DESCR COM_AXIS AXIN_00A_TCOOL CM_C128 9 -256 255.992 AXIS_PTS_REF AX_00A_TCOOL /end AXIS_DESCR
/end CHARACTERISTIC
/begin CHARACTERISTIC CAL_969 "кривая #969 17: N" CURVE 0x08066300 RL_FNC_UWORD 0 CM_RAW 0 65535
 /begin AXIS_DESCR COM_AXIS AXIN_001_N CM_RPM2 17 0 32767.5 AXIS_PTS_REF AX_001_N /end AXIS_DESCR
/end CHARACTERISTIC
/begin CHARACTERISTIC CAL_96A "значение #96A" VALUE 0x080703A8 RL_FNC_UWORD 0 CM_RAW 0 65535 /end CHARACTERISTIC
/begin CHARACTERISTIC CAL_96B "значение #96B" VALUE 0x080653E0 RL_FNC_UWORD 0 CM_RAW 0 65535 /end CHARACTERISTIC
/begin CHARACTERISTIC CAL_96C "значение #96C" VALUE 0x08070360 RL_FNC_UWORD 0 CM_RAW 0 65535 /end CHARACTERISTIC
/begin CHARACTERISTIC CAL_96D "значение #96D" VALUE 0x080746B0 RL_FNC_SBYTE 0 CM_RAW -128 127 /end CHARACTERISTIC
/begin CHARACTERISTIC CAL_96E "значение #96E" VALUE 0x08065385 RL_FNC_SBYTE 0 CM_RAW -128 127 /end CHARACTERISTIC
/begin CHARACTERISTIC CAL_96F "значение #96F" VALUE 0x08065386 RL_FNC_SBYTE 0 CM_RAW -128 127 /end CHARACTERISTIC
/begin CHARACTERISTIC CAL_970 "значение #970" VALUE 0x08063DDC RL_FNC_UWORD 0 CM_RAW 0 65535 /end CHARACTERISTIC
/begin CHARACTERISTIC CAL_971 "массив #971" VAL_BLK 0x08063DE0 RL_FNC_UWORD 0 CM_RAW 0 65535 MATRIX_DIM 2 1 1 /end CHARACTERISTIC
/begin CHARACTERISTIC CAL_972 "значение #972" VALUE 0x08063DE8 RL_FNC_UWORD 0 CM_RAW 0 65535 /end CHARACTERISTIC
/begin CHARACTERISTIC CAL_973 "значение #973" VALUE 0x08063368 RL_FNC_UWORD 0 CM_RAW 0 65535 /end CHARACTERISTIC
/begin CHARACTERISTIC CAL_974 "значение #974" VALUE 0x08063C12 RL_FNC_UWORD 0 CM_RAW 0 65535 /end CHARACTERISTIC
/begin CHARACTERISTIC CAL_975 "значение #975" VALUE 0x08063DDA RL_FNC_UWORD 0 CM_RAW 0 65535 /end CHARACTERISTIC
/begin CHARACTERISTIC CAL_976 "значение #976" VALUE 0x08063DF6 RL_FNC_UWORD 0 CM_RAW 0 65535 /end CHARACTERISTIC
/begin CHARACTERISTIC CAL_977 "значение #977" VALUE 0x08063DF8 RL_FNC_UWORD 0 CM_RAW 0 65535 /end CHARACTERISTIC
/begin CHARACTERISTIC CAL_978 "значение #978" VALUE 0x080633AC RL_FNC_SBYTE 0 CM_RAW -128 127 /end CHARACTERISTIC
/begin CHARACTERISTIC CRUISE_SUPPORT "признак поддержки круиза [?, флаг]" VAL_BLK 0x08063BD8 RL_FNC_SBYTE 0 CM_RAW -128 127 MATRIX_DIM 2 1 1 /end CHARACTERISTIC
/begin CHARACTERISTIC CRUISE_BTN_WIN_4A "кнопки круиза: окно [мин, макс] АЦП x4" VAL_BLK 0x08063CF4 RL_FNC_UWORD 0 CM_RAW 0 65535 MATRIX_DIM 2 1 1 /end CHARACTERISTIC
/begin CHARACTERISTIC CRUISE_BTN_WIN_4B "кнопки круиза: окно [мин, макс] АЦП x4" VAL_BLK 0x08063CF8 RL_FNC_UWORD 0 CM_RAW 0 65535 MATRIX_DIM 2 1 1 /end CHARACTERISTIC
/begin CHARACTERISTIC CAL_97C "значение #97C" VALUE 0x08074632 RL_FNC_UWORD 0 CM_RAW 0 65535 /end CHARACTERISTIC
/begin CHARACTERISTIC CAL_97D "значение #97D" VALUE 0x08065383 RL_FNC_SBYTE 0 CM_RAW -128 127 /end CHARACTERISTIC
/begin CHARACTERISTIC CAL_97E "значение #97E" VALUE 0x0806537C RL_FNC_SBYTE 0 CM_RAW -128 127 /end CHARACTERISTIC
/begin CHARACTERISTIC CAL_97F "значение #97F" VALUE 0x08065384 RL_FNC_SBYTE 0 CM_RAW -128 127 /end CHARACTERISTIC
/begin CHARACTERISTIC CAL_980 "значение #980" VALUE 0x08063BD4 RL_FNC_UWORD 0 CM_RAW 0 65535 /end CHARACTERISTIC
/begin CHARACTERISTIC CAL_982 "кривая #982 17: N" CURVE 0x08068294 RL_FNC_UWORD 0 CM_RAW 0 65535
 /begin AXIS_DESCR COM_AXIS AXIN_001_N CM_RPM2 17 0 32767.5 AXIS_PTS_REF AX_001_N /end AXIS_DESCR
/end CHARACTERISTIC
/begin CHARACTERISTIC CAL_983 "кривая #983 8: N" CURVE 0x080702E4 RL_FNC_SBYTE 0 CM_RAW -128 127
 /begin AXIS_DESCR COM_AXIS AXIN_050_N CM_RPM2 8 0 32767.5 AXIS_PTS_REF AX_050_N /end AXIS_DESCR
/end CHARACTERISTIC
/begin CHARACTERISTIC CAL_984 "значение #984" VALUE 0x080690BE RL_FNC_SBYTE 0 CM_RAW -128 127 /end CHARACTERISTIC
/begin CHARACTERISTIC CAL_985 "значение #985" VALUE 0x08074630 RL_FNC_SBYTE 0 CM_RAW -128 127 /end CHARACTERISTIC
/begin CHARACTERISTIC CAL_986 "массив #986" VAL_BLK 0x080632F4 RL_FNC_UWORD 0 CM_RAW 0 65535 MATRIX_DIM 2 1 1 /end CHARACTERISTIC
/begin CHARACTERISTIC CAL_987 "значение #987" VALUE 0x08063D6A RL_FNC_UWORD 0 CM_RAW 0 65535 /end CHARACTERISTIC
/begin CHARACTERISTIC CAL_988 "значение #988" VALUE 0x08063C10 RL_FNC_UWORD 0 CM_RAW 0 65535 /end CHARACTERISTIC
/begin CHARACTERISTIC CAL_989 "значение #989" VALUE 0x08063DD8 RL_FNC_UWORD 0 CM_RAW 0 65535 /end CHARACTERISTIC
/begin CHARACTERISTIC CAL_98A "значение #98A" VALUE 0x08063DE6 RL_FNC_UWORD 0 CM_RAW 0 65535 /end CHARACTERISTIC
/begin CHARACTERISTIC CAL_98B "значение #98B" VALUE 0x0806A85C RL_FNC_UWORD 0 CM_RAW 0 65535 /end CHARACTERISTIC
/begin CHARACTERISTIC CAL_98D "значение #98D" VALUE 0x0807360A RL_FNC_UWORD 0 CM_RAW 0 65535 /end CHARACTERISTIC
/begin CHARACTERISTIC CAL_98E "значение #98E" VALUE 0x08070722 RL_FNC_UWORD 0 CM_RAW 0 65535 /end CHARACTERISTIC
/begin CHARACTERISTIC CAL_98F "значение #98F" VALUE 0x0806D128 RL_FNC_UWORD 0 CM_RAW 0 65535 /end CHARACTERISTIC
/begin CHARACTERISTIC CAL_990 "значение #990" VALUE 0x0806D26A RL_FNC_UWORD 0 CM_RAW 0 65535 /end CHARACTERISTIC
/begin CHARACTERISTIC CAL_991 "значение #991" VALUE 0x0806D26E RL_FNC_UWORD 0 CM_RAW 0 65535 /end CHARACTERISTIC
/begin CHARACTERISTIC CAL_992 "значение #992" VALUE 0x0806D0F9 RL_FNC_SBYTE 0 CM_RAW -128 127 /end CHARACTERISTIC
/begin CHARACTERISTIC CAL_993 "массив #993" VAL_BLK 0x0806D270 RL_FNC_UWORD 0 CM_RAW 0 65535 MATRIX_DIM 2 1 1 /end CHARACTERISTIC
/begin CHARACTERISTIC CAL_994 "значение #994" VALUE 0x0806D26C RL_FNC_UWORD 0 CM_RAW 0 65535 /end CHARACTERISTIC
/begin CHARACTERISTIC CAL_996_0 "кривая #996 10: N [1/2]" CURVE 0x08070268 RL_FNC_UWORD 0 CM_RAW 0 65535
 /begin AXIS_DESCR COM_AXIS AXIN_00C_N CM_RPM2 10 0 32767.5 AXIS_PTS_REF AX_00C_N /end AXIS_DESCR
/end CHARACTERISTIC
/begin CHARACTERISTIC CAL_996_1 "кривая #996 10: N [2/2]" CURVE 0x0807027C RL_FNC_UWORD 0 CM_RAW 0 65535
 /begin AXIS_DESCR COM_AXIS AXIN_00C_N CM_RPM2 10 0 32767.5 AXIS_PTS_REF AX_00C_N /end AXIS_DESCR
/end CHARACTERISTIC
/begin CHARACTERISTIC CAL_997_0 "кривая #997 11: ? [1/2]" CURVE 0x080657E8 RL_FNC_UWORD 0 CM_RAW 0 65535 /begin AXIS_DESCR COM_AXIS AXIN_08E CM_RAW 11 0 65535 AXIS_PTS_REF AX_08E /end AXIS_DESCR /end CHARACTERISTIC
/begin CHARACTERISTIC CAL_997_1 "кривая #997 11: ? [2/2]" CURVE 0x080657FE RL_FNC_UWORD 0 CM_RAW 0 65535 /begin AXIS_DESCR COM_AXIS AXIN_08E CM_RAW 11 0 65535 AXIS_PTS_REF AX_08E /end AXIS_DESCR /end CHARACTERISTIC
/begin CHARACTERISTIC CAL_998 "кривая #998 8: GEAR" CURVE 0x08062CD4 RL_FNC_UBYTE 0 CM_RAW 0 255
 /begin AXIS_DESCR COM_AXIS AXIN_05E_GEAR CM_RAW 8 -128 127 AXIS_PTS_REF AX_05E_GEAR /end AXIS_DESCR
/end CHARACTERISTIC
/begin CHARACTERISTIC CAL_99A "значение #99A" VALUE 0x08074638 RL_FNC_SBYTE 0 CM_RAW -128 127 /end CHARACTERISTIC
/begin CHARACTERISTIC CAL_99B "значение #99B" VALUE 0x08074636 RL_FNC_UWORD 0 CM_RAW 0 65535 /end CHARACTERISTIC
/begin CHARACTERISTIC CAL_99C "значение #99C" VALUE 0x0806446E RL_FNC_UWORD 0 CM_RAW 0 65535 /end CHARACTERISTIC
/begin CHARACTERISTIC CAL_99D "значение #99D" VALUE 0x0806446C RL_FNC_UWORD 0 CM_RAW 0 65535 /end CHARACTERISTIC
/begin CHARACTERISTIC CAL_99E "значение #99E" VALUE 0x080633AA RL_FNC_SBYTE 0 CM_RAW -128 127 /end CHARACTERISTIC
/begin CHARACTERISTIC CAL_9A0 "значение #9A0" VALUE 0x08066DC4 RL_FNC_UWORD 0 CM_RAW 0 65535 /end CHARACTERISTIC
/begin CHARACTERISTIC CAL_9A1 "массив #9A1" VAL_BLK 0x0806A750 RL_FNC_UWORD 0 CM_RAW 0 65535 MATRIX_DIM 4 1 1 /end CHARACTERISTIC
/begin CHARACTERISTIC CAL_9A2_0 "карта #9A2 16x16: N × LOAD [1/4]" MAP 0x0806EDC8 RL_FNC_UWORD 0 CM_RAW 0 65535
 /begin AXIS_DESCR COM_AXIS AXIN_026_N CM_RPM2 16 0 32767.5 AXIS_PTS_REF AX_026_N /end AXIS_DESCR
 /begin AXIS_DESCR COM_AXIS AXIN_024_LOAD CM_RAW 16 0 65535 AXIS_PTS_REF AX_024_LOAD /end AXIS_DESCR
/end CHARACTERISTIC
/begin CHARACTERISTIC CAL_9A2_1 "карта #9A2 16x16: N × LOAD [2/4]" MAP 0x0806EFC8 RL_FNC_UWORD 0 CM_RAW 0 65535
 /begin AXIS_DESCR COM_AXIS AXIN_026_N CM_RPM2 16 0 32767.5 AXIS_PTS_REF AX_026_N /end AXIS_DESCR
 /begin AXIS_DESCR COM_AXIS AXIN_024_LOAD CM_RAW 16 0 65535 AXIS_PTS_REF AX_024_LOAD /end AXIS_DESCR
/end CHARACTERISTIC
/begin CHARACTERISTIC CAL_9A2_2 "карта #9A2 16x16: N × LOAD [3/4]" MAP 0x0806F1C8 RL_FNC_UWORD 0 CM_RAW 0 65535
 /begin AXIS_DESCR COM_AXIS AXIN_026_N CM_RPM2 16 0 32767.5 AXIS_PTS_REF AX_026_N /end AXIS_DESCR
 /begin AXIS_DESCR COM_AXIS AXIN_024_LOAD CM_RAW 16 0 65535 AXIS_PTS_REF AX_024_LOAD /end AXIS_DESCR
/end CHARACTERISTIC
/begin CHARACTERISTIC CAL_9A2_3 "карта #9A2 16x16: N × LOAD [4/4]" MAP 0x0806F3C8 RL_FNC_UWORD 0 CM_RAW 0 65535
 /begin AXIS_DESCR COM_AXIS AXIN_026_N CM_RPM2 16 0 32767.5 AXIS_PTS_REF AX_026_N /end AXIS_DESCR
 /begin AXIS_DESCR COM_AXIS AXIN_024_LOAD CM_RAW 16 0 65535 AXIS_PTS_REF AX_024_LOAD /end AXIS_DESCR
/end CHARACTERISTIC
/begin CHARACTERISTIC CAL_9A3 "значение #9A3" VALUE 0x080745C0 RL_FNC_SBYTE 0 CM_RAW -128 127 /end CHARACTERISTIC
/begin CHARACTERISTIC CAL_9A4 "кривая #9A4 10: N" CURVE 0x0806C2C8 RL_FNC_UWORD 0 CM_RAW 0 65535
 /begin AXIS_DESCR COM_AXIS AXIN_00C_N CM_RPM2 10 0 32767.5 AXIS_PTS_REF AX_00C_N /end AXIS_DESCR
/end CHARACTERISTIC
/begin CHARACTERISTIC CAL_9A5 "значение #9A5" VALUE 0x08063D68 RL_FNC_UWORD 0 CM_RAW 0 65535 /end CHARACTERISTIC
/begin CHARACTERISTIC CAL_9A6 "значение #9A6" VALUE 0x08062500 RL_FNC_UWORD 0 CM_RAW 0 65535 /end CHARACTERISTIC
/begin CHARACTERISTIC CAL_9A7 "массив #9A7" VAL_BLK 0x080624FC RL_FNC_UWORD 0 CM_RAW 0 65535 MATRIX_DIM 2 1 1 /end CHARACTERISTIC
/begin CHARACTERISTIC CAL_9A8 "значение #9A8" VALUE 0x0806269C RL_FNC_UWORD 0 CM_RAW 0 65535 /end CHARACTERISTIC
/begin CHARACTERISTIC CAL_9A9 "значение #9A9" VALUE 0x080726F4 RL_FNC_UWORD 0 CM_RAW 0 65535 /end CHARACTERISTIC
/begin CHARACTERISTIC CAL_9AA "значение #9AA" VALUE 0x08074585 RL_FNC_UBYTE 0 CM_RAW 0 255 /end CHARACTERISTIC
/begin CHARACTERISTIC CAL_9AB "значение #9AB" VALUE 0x08074584 RL_FNC_UBYTE 0 CM_RAW 0 255 /end CHARACTERISTIC
/begin CHARACTERISTIC CAL_9AC "массив #9AC" VAL_BLK 0x08069058 RL_FNC_SWORD 0 CM_RAW -32768 32767 MATRIX_DIM 34 1 1 /end CHARACTERISTIC
/begin CHARACTERISTIC CAL_9AD "массив #9AD" VAL_BLK 0x0806909C RL_FNC_SWORD 0 CM_RAW -32768 32767 MATRIX_DIM 2 1 1 /end CHARACTERISTIC
/begin CHARACTERISTIC CAL_9AF "массив #9AF" VAL_BLK 0x0806E7C8 RL_FNC_SBYTE 0 CM_RAW -128 127 MATRIX_DIM 2 1 1 /end CHARACTERISTIC
/begin CHARACTERISTIC CAL_9B0 "значение #9B0" VALUE 0x0806E7CA RL_FNC_SBYTE 0 CM_RAW -128 127 /end CHARACTERISTIC
/begin CHARACTERISTIC CAL_9B1 "значение #9B1" VALUE 0x0807465C RL_FNC_SBYTE 0 CM_RAW -128 127 /end CHARACTERISTIC
/begin CHARACTERISTIC CAL_9B5 "значение #9B5" VALUE 0x0806336A RL_FNC_SBYTE 0 CM_RAW -128 127 /end CHARACTERISTIC
/begin CHARACTERISTIC CAL_9B6 "карта #9B6 4x9: ? × ?" MAP 0x08063384 RL_FNC_SBYTE 0 CM_RAW -128 127 /begin AXIS_DESCR COM_AXIS AXIN_070 CM_RAW 9 -128 127 AXIS_PTS_REF AX_070 /end AXIS_DESCR /begin AXIS_DESCR COM_AXIS AXIN_100 CM_RAW 4 -128 127 AXIS_PTS_REF AX_100 /end AXIS_DESCR /end CHARACTERISTIC
/begin CHARACTERISTIC CAL_9B7 "карта #9B7 4x6: ? × ?" MAP 0x0806336C RL_FNC_SBYTE 0 CM_RAW -128 127 /begin AXIS_DESCR COM_AXIS AXIN_071 CM_RAW 6 -128 127 AXIS_PTS_REF AX_071 /end AXIS_DESCR /begin AXIS_DESCR COM_AXIS AXIN_100 CM_RAW 4 -128 127 AXIS_PTS_REF AX_100 /end AXIS_DESCR /end CHARACTERISTIC
/begin CHARACTERISTIC CAL_9B8 "массив #9B8" VAL_BLK 0x0806B884 RL_FNC_UWORD 0 CM_RAW 0 65535 MATRIX_DIM 2 1 1 /end CHARACTERISTIC
/begin CHARACTERISTIC CAL_9B9 "массив #9B9" VAL_BLK 0x0806B880 RL_FNC_UWORD 0 CM_RAW 0 65535 MATRIX_DIM 2 1 1 /end CHARACTERISTIC
/begin CHARACTERISTIC CAL_9BA "кривая #9BA 8: ?" CURVE 0x08070728 RL_FNC_UWORD 0 CM_RAW 0 65535 /begin AXIS_DESCR COM_AXIS AXIN_101 CM_RAW 8 0 65535 AXIS_PTS_REF AX_101 /end AXIS_DESCR /end CHARACTERISTIC
/begin CHARACTERISTIC CAL_9BD "кривая #9BD 8: N" CURVE 0x08062BA8 RL_FNC_UWORD 0 CM_RAW 0 65535
 /begin AXIS_DESCR COM_AXIS AXIN_050_N CM_RPM2 8 0 32767.5 AXIS_PTS_REF AX_050_N /end AXIS_DESCR
/end CHARACTERISTIC
/begin CHARACTERISTIC CAL_9C0 "значение #9C0" VALUE 0x0806E8BE RL_FNC_UWORD 0 CM_RAW 0 65535 /end CHARACTERISTIC
/begin CHARACTERISTIC CAL_9C1 "значение #9C1" VALUE 0x0806E8C0 RL_FNC_UWORD 0 CM_RAW 0 65535 /end CHARACTERISTIC
/begin CHARACTERISTIC CAL_9C2 "значение #9C2" VALUE 0x0806E8C2 RL_FNC_SBYTE 0 CM_RAW -128 127 /end CHARACTERISTIC
/begin CHARACTERISTIC CAL_9C3 "карта #9C3 1x9: ? × ?" MAP 0x0806E8C4 RL_FNC_SBYTE 0 CM_RAW -128 127 /begin AXIS_DESCR COM_AXIS AXIN_0F6 CM_RAW 9 -128 127 AXIS_PTS_REF AX_0F6 /end AXIS_DESCR /begin AXIS_DESCR COM_AXIS AXIN_102 CM_RAW 1 -128 127 AXIS_PTS_REF AX_102 /end AXIS_DESCR /end CHARACTERISTIC
/begin CHARACTERISTIC CAL_9C4 "карта #9C4 1x6: ? × ?" MAP 0x0806E8D0 RL_FNC_SBYTE 0 CM_RAW -128 127 /begin AXIS_DESCR COM_AXIS AXIN_0F7 CM_RAW 6 -128 127 AXIS_PTS_REF AX_0F7 /end AXIS_DESCR /begin AXIS_DESCR COM_AXIS AXIN_102 CM_RAW 1 -128 127 AXIS_PTS_REF AX_102 /end AXIS_DESCR /end CHARACTERISTIC
/begin CHARACTERISTIC CAL_9C7 "значение #9C7" VALUE 0x080746AF RL_FNC_SBYTE 0 CM_RAW -128 127 /end CHARACTERISTIC
/begin CHARACTERISTIC CAL_9C8 "значение #9C8" VALUE 0x08063E16 RL_FNC_UWORD 0 CM_RAW 0 65535 /end CHARACTERISTIC
/end MODULE
/end PROJECT
