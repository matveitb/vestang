ASAP2_VERSION 1 60
/begin PROJECT M74_9 "ИТЭЛМА M74.9, сгенерировано tools/mka2l.py"
/begin HEADER "из таблицы дескрипторов @0x412E4, 2540 записей" VERSION "BB03_w2341v6" /end HEADER
/begin MODULE BB03_w2341v6 "BB03_w2341v6"
/begin MOD_COMMON "" BYTE_ORDER MSB_LAST ALIGNMENT_BYTE 1 ALIGNMENT_WORD 1 ALIGNMENT_LONG 1 /end MOD_COMMON
/begin MOD_PAR ""
 /begin MEMORY_SEGMENT CODE1 "код" CODE FLASH INTERN 0x08001000 0x5F000 -1 -1 -1 -1 -1 /end MEMORY_SEGMENT
 /begin MEMORY_SEGMENT CAL "калибровки" DATA FLASH INTERN 0x08060000 0x20000 -1 -1 -1 -1 -1 /end MEMORY_SEGMENT
 /begin MEMORY_SEGMENT CODE2 "код" CODE FLASH INTERN 0x08080000 0x80000 -1 -1 -1 -1 -1 /end MEMORY_SEGMENT
/end MOD_PAR
/begin COMPU_METHOD CM_RAW "сырое значение" RAT_FUNC "%.3" "" COEFFS 0 1 0 0 0 1 /end COMPU_METHOD
/begin COMPU_METHOD CM_KMH64 "скорость, км/ч (сырое / 64)" RAT_FUNC "%.3" "km/h" COEFFS 0 1 0 0 0 64 /end COMPU_METHOD
/begin COMPU_METHOD CM_C128 "температура, °C (сырое / 128)" RAT_FUNC "%.3" "degC" COEFFS 0 1 0 0 0 128 /end COMPU_METHOD
/begin COMPU_METHOD CM_P128 "педаль / запрос, % (сырое / 128)" RAT_FUNC "%.3" "%" COEFFS 0 1 0 0 0 128 /end COMPU_METHOD
/begin COMPU_METHOD CM_RPM2 "обороты, об/мин (сырое / 2)" RAT_FUNC "%.3" "rpm" COEFFS 0 1 0 0 0 2 /end COMPU_METHOD
/begin RECORD_LAYOUT RL_AX_UWORD_17 AXIS_PTS_X 1 UWORD INDEX_INCR DIRECT FIX_NO_AXIS_PTS_X 17 /end RECORD_LAYOUT
/begin RECORD_LAYOUT RL_AX_SWORD_16 AXIS_PTS_X 1 SWORD INDEX_INCR DIRECT FIX_NO_AXIS_PTS_X 16 /end RECORD_LAYOUT
/begin RECORD_LAYOUT RL_AX_UWORD_14 AXIS_PTS_X 1 UWORD INDEX_INCR DIRECT FIX_NO_AXIS_PTS_X 14 /end RECORD_LAYOUT
/begin RECORD_LAYOUT RL_AX_UWORD_24 AXIS_PTS_X 1 UWORD INDEX_INCR DIRECT FIX_NO_AXIS_PTS_X 24 /end RECORD_LAYOUT
/begin RECORD_LAYOUT RL_AX_SBYTE_4 AXIS_PTS_X 1 SBYTE INDEX_INCR DIRECT FIX_NO_AXIS_PTS_X 4 /end RECORD_LAYOUT
/begin RECORD_LAYOUT RL_AX_SBYTE_3 AXIS_PTS_X 1 SBYTE INDEX_INCR DIRECT FIX_NO_AXIS_PTS_X 3 /end RECORD_LAYOUT
/begin RECORD_LAYOUT RL_AX_UWORD_3 AXIS_PTS_X 1 UWORD INDEX_INCR DIRECT FIX_NO_AXIS_PTS_X 3 /end RECORD_LAYOUT
/begin RECORD_LAYOUT RL_AX_SWORD_9 AXIS_PTS_X 1 SWORD INDEX_INCR DIRECT FIX_NO_AXIS_PTS_X 9 /end RECORD_LAYOUT
/begin RECORD_LAYOUT RL_AX_UWORD_9 AXIS_PTS_X 1 UWORD INDEX_INCR DIRECT FIX_NO_AXIS_PTS_X 9 /end RECORD_LAYOUT
/begin RECORD_LAYOUT RL_AX_UWORD_10 AXIS_PTS_X 1 UWORD INDEX_INCR DIRECT FIX_NO_AXIS_PTS_X 10 /end RECORD_LAYOUT
/begin RECORD_LAYOUT RL_AX_UWORD_21 AXIS_PTS_X 1 UWORD INDEX_INCR DIRECT FIX_NO_AXIS_PTS_X 21 /end RECORD_LAYOUT
/begin RECORD_LAYOUT RL_AX_UWORD_16 AXIS_PTS_X 1 UWORD INDEX_INCR DIRECT FIX_NO_AXIS_PTS_X 16 /end RECORD_LAYOUT
/begin RECORD_LAYOUT RL_AX_UWORD_18 AXIS_PTS_X 1 UWORD INDEX_INCR DIRECT FIX_NO_AXIS_PTS_X 18 /end RECORD_LAYOUT
/begin RECORD_LAYOUT RL_AX_UWORD_6 AXIS_PTS_X 1 UWORD INDEX_INCR DIRECT FIX_NO_AXIS_PTS_X 6 /end RECORD_LAYOUT
/begin RECORD_LAYOUT RL_AX_UWORD_12 AXIS_PTS_X 1 UWORD INDEX_INCR DIRECT FIX_NO_AXIS_PTS_X 12 /end RECORD_LAYOUT
/begin RECORD_LAYOUT RL_AX_UWORD_4 AXIS_PTS_X 1 UWORD INDEX_INCR DIRECT FIX_NO_AXIS_PTS_X 4 /end RECORD_LAYOUT
/begin RECORD_LAYOUT RL_AX_SWORD_32 AXIS_PTS_X 1 SWORD INDEX_INCR DIRECT FIX_NO_AXIS_PTS_X 32 /end RECORD_LAYOUT
/begin RECORD_LAYOUT RL_AX_SBYTE_7 AXIS_PTS_X 1 SBYTE INDEX_INCR DIRECT FIX_NO_AXIS_PTS_X 7 /end RECORD_LAYOUT
/begin RECORD_LAYOUT RL_AX_UWORD_31 AXIS_PTS_X 1 UWORD INDEX_INCR DIRECT FIX_NO_AXIS_PTS_X 31 /end RECORD_LAYOUT
/begin RECORD_LAYOUT RL_AX_UWORD_5 AXIS_PTS_X 1 UWORD INDEX_INCR DIRECT FIX_NO_AXIS_PTS_X 5 /end RECORD_LAYOUT
/begin RECORD_LAYOUT RL_AX_UWORD_7 AXIS_PTS_X 1 UWORD INDEX_INCR DIRECT FIX_NO_AXIS_PTS_X 7 /end RECORD_LAYOUT
/begin RECORD_LAYOUT RL_AX_UWORD_8 AXIS_PTS_X 1 UWORD INDEX_INCR DIRECT FIX_NO_AXIS_PTS_X 8 /end RECORD_LAYOUT
/begin RECORD_LAYOUT RL_AX_SWORD_3 AXIS_PTS_X 1 SWORD INDEX_INCR DIRECT FIX_NO_AXIS_PTS_X 3 /end RECORD_LAYOUT
/begin RECORD_LAYOUT RL_AX_UWORD_60 AXIS_PTS_X 1 UWORD INDEX_INCR DIRECT FIX_NO_AXIS_PTS_X 60 /end RECORD_LAYOUT
/begin RECORD_LAYOUT RL_AX_UWORD_27 AXIS_PTS_X 1 UWORD INDEX_INCR DIRECT FIX_NO_AXIS_PTS_X 27 /end RECORD_LAYOUT
/begin RECORD_LAYOUT RL_AX_SWORD_17 AXIS_PTS_X 1 SWORD INDEX_INCR DIRECT FIX_NO_AXIS_PTS_X 17 /end RECORD_LAYOUT
/begin RECORD_LAYOUT RL_AX_UWORD_30 AXIS_PTS_X 1 UWORD INDEX_INCR DIRECT FIX_NO_AXIS_PTS_X 30 /end RECORD_LAYOUT
/begin RECORD_LAYOUT RL_AX_SWORD_8 AXIS_PTS_X 1 SWORD INDEX_INCR DIRECT FIX_NO_AXIS_PTS_X 8 /end RECORD_LAYOUT
/begin RECORD_LAYOUT RL_AX_UBYTE_26 AXIS_PTS_X 1 UBYTE INDEX_INCR DIRECT FIX_NO_AXIS_PTS_X 26 /end RECORD_LAYOUT
/begin RECORD_LAYOUT RL_AX_UWORD_11 AXIS_PTS_X 1 UWORD INDEX_INCR DIRECT FIX_NO_AXIS_PTS_X 11 /end RECORD_LAYOUT
/begin RECORD_LAYOUT RL_AX_SBYTE_8 AXIS_PTS_X 1 SBYTE INDEX_INCR DIRECT FIX_NO_AXIS_PTS_X 8 /end RECORD_LAYOUT
/begin RECORD_LAYOUT RL_AX_SWORD_11 AXIS_PTS_X 1 SWORD INDEX_INCR DIRECT FIX_NO_AXIS_PTS_X 11 /end RECORD_LAYOUT
/begin RECORD_LAYOUT RL_FNC_SWORD FNC_VALUES 1 SWORD ROW_DIR DIRECT /end RECORD_LAYOUT
/begin RECORD_LAYOUT RL_FNC_UWORD FNC_VALUES 1 UWORD ROW_DIR DIRECT /end RECORD_LAYOUT
/begin RECORD_LAYOUT RL_FNC_UBYTE FNC_VALUES 1 UBYTE ROW_DIR DIRECT /end RECORD_LAYOUT
/begin RECORD_LAYOUT RL_FNC_SBYTE FNC_VALUES 1 SBYTE ROW_DIR DIRECT /end RECORD_LAYOUT
/begin RECORD_LAYOUT RL_FNC_ULONG FNC_VALUES 1 ULONG ROW_DIR DIRECT /end RECORD_LAYOUT
/begin RECORD_LAYOUT RL_FNC_SLONG FNC_VALUES 1 SLONG ROW_DIR DIRECT /end RECORD_LAYOUT
/begin MEASUREMENT AXIN_000 "вход оси AX_000" UWORD CM_RAW 0 0 0 65535 ECU_ADDRESS 0x20000DB2 /end MEASUREMENT
/begin MEASUREMENT AXIN_001_N "вход оси AX_001_N (обороты двигателя [да (60e6/период в 0x1FD40; единица 0,5 об/мин — вероятно)])" UWORD CM_RPM2 0 0 0 32767.5 ECU_ADDRESS 0x20000FF6 /end MEASUREMENT
/begin MEASUREMENT AXIN_002_TAIR "вход оси AX_002_TAIR (температура воздуха на впуске, АЦП канал 8 [вероятно])" SWORD CM_C128 0 0 -256 255.992 ECU_ADDRESS 0x20001022 /end MEASUREMENT
/begin MEASUREMENT AXIN_003_UBAT "вход оси AX_003_UBAT (напряжение бортсети? (масштаб не установлен) [вероятно])" UWORD CM_RAW 0 0 0 65535 ECU_ADDRESS 0x20000F6E /end MEASUREMENT
/begin MEASUREMENT AXIN_004_TCOOL "вход оси AX_004_TCOOL (температура двигателя (ОЖ), АЦП канал 9 [вероятно])" SWORD CM_C128 0 0 -256 255.992 ECU_ADDRESS 0x20000F9A /end MEASUREMENT
/begin MEASUREMENT AXIN_005_N "вход оси AX_005_N (обороты двигателя [да (60e6/период в 0x1FD40; единица 0,5 об/мин — вероятно)])" UWORD CM_RPM2 0 0 0 32767.5 ECU_ADDRESS 0x20000FDE /end MEASUREMENT
/begin MEASUREMENT AXIN_006 "вход оси AX_006" UWORD CM_RAW 0 0 0 65535 ECU_ADDRESS 0x20001036 /end MEASUREMENT
/begin MEASUREMENT AXIN_007 "вход оси AX_007" SBYTE CM_RAW 0 0 -128 127 ECU_ADDRESS 0x20000D3A /end MEASUREMENT
/begin MEASUREMENT AXIN_008 "вход оси AX_008" SBYTE CM_RAW 0 0 -128 127 ECU_ADDRESS 0x20000D3E /end MEASUREMENT
/begin MEASUREMENT AXIN_009 "вход оси AX_009" UWORD CM_RAW 0 0 0 65535 ECU_ADDRESS 0x20000F6A /end MEASUREMENT
/begin MEASUREMENT AXIN_00A_TCOOL "вход оси AX_00A_TCOOL (температура двигателя (ОЖ), АЦП канал 9 [вероятно])" SWORD CM_C128 0 0 -256 255.992 ECU_ADDRESS 0x20000F96 /end MEASUREMENT
/begin MEASUREMENT AXIN_00B "вход оси AX_00B" UWORD CM_RAW 0 0 0 65535 ECU_ADDRESS 0x20000FB6 /end MEASUREMENT
/begin MEASUREMENT AXIN_00C_N "вход оси AX_00C_N (обороты двигателя [да (60e6/период в 0x1FD40; единица 0,5 об/мин — вероятно)])" UWORD CM_RPM2 0 0 0 32767.5 ECU_ADDRESS 0x20000FEA /end MEASUREMENT
/begin MEASUREMENT AXIN_00D "вход оси AX_00D" UWORD CM_RAW 0 0 0 65535 ECU_ADDRESS 0x20000CEA /end MEASUREMENT
/begin MEASUREMENT AXIN_00E "вход оси AX_00E" UWORD CM_RAW 0 0 0 65535 ECU_ADDRESS 0x20000EAE /end MEASUREMENT
/begin MEASUREMENT AXIN_00F "вход оси AX_00F" UWORD CM_RAW 0 0 0 65535 ECU_ADDRESS 0x20000CF6 /end MEASUREMENT
/begin MEASUREMENT AXIN_010 "вход оси AX_010" UWORD CM_RAW 0 0 0 65535 ECU_ADDRESS 0x20000CFA /end MEASUREMENT
/begin MEASUREMENT AXIN_011 "вход оси AX_011" UWORD CM_RAW 0 0 0 65535 ECU_ADDRESS 0x20000FFE /end MEASUREMENT
/begin MEASUREMENT AXIN_012 "вход оси AX_012" UWORD CM_RAW 0 0 0 65535 ECU_ADDRESS 0x20000FCE /end MEASUREMENT
/begin MEASUREMENT AXIN_013 "вход оси AX_013" UBYTE CM_RAW 0 0 0 255 ECU_ADDRESS 0x20000CA2 /end MEASUREMENT
/begin MEASUREMENT AXIN_014 "вход оси AX_014" UWORD CM_RAW 0 0 0 65535 ECU_ADDRESS 0x20000D1E /end MEASUREMENT
/begin MEASUREMENT AXIN_015 "вход оси AX_015" UWORD CM_RAW 0 0 0 65535 ECU_ADDRESS 0x20000D22 /end MEASUREMENT
/begin MEASUREMENT AXIN_016 "вход оси AX_016" UWORD CM_RAW 0 0 0 65535 ECU_ADDRESS 0x20000D26 /end MEASUREMENT
/begin MEASUREMENT AXIN_017 "вход оси AX_017" UWORD CM_RAW 0 0 0 65535 ECU_ADDRESS 0x20000D32 /end MEASUREMENT
/begin MEASUREMENT AXIN_018 "вход оси AX_018" UWORD CM_RAW 0 0 0 65535 ECU_ADDRESS 0x20000D2A /end MEASUREMENT
/begin MEASUREMENT AXIN_019 "вход оси AX_019" UWORD CM_RAW 0 0 0 65535 ECU_ADDRESS 0x20000D2E /end MEASUREMENT
/begin MEASUREMENT AXIN_01A_TCOOL "вход оси AX_01A_TCOOL (температура двигателя (ОЖ), АЦП канал 9 [вероятно])" SWORD CM_C128 0 0 -256 255.992 ECU_ADDRESS 0x20000F8A /end MEASUREMENT
/begin MEASUREMENT AXIN_01B_PEDAL "вход оси AX_01B_PEDAL (положение педали газа [да])" UWORD CM_P128 0 0 0 511.992 ECU_ADDRESS 0x20000F62 /end MEASUREMENT
/begin MEASUREMENT AXIN_01C "вход оси AX_01C" SBYTE CM_RAW 0 0 -128 127 ECU_ADDRESS 0x20000DA2 /end MEASUREMENT
/begin MEASUREMENT AXIN_01D "вход оси AX_01D" SBYTE CM_RAW 0 0 -128 127 ECU_ADDRESS 0x20000DA6 /end MEASUREMENT
/begin MEASUREMENT AXIN_01E_LOAD "вход оси AX_01E_LOAD (нагрузка / наполнение (0x3C28 / 0x3C30 / 0x3C34), масштаб не установлен [вероятно])" UWORD CM_RAW 0 0 0 65535 ECU_ADDRESS 0x20000FA2 /end MEASUREMENT
/begin MEASUREMENT AXIN_01F "вход оси AX_01F" UWORD CM_RAW 0 0 0 65535 ECU_ADDRESS 0x20000D9E /end MEASUREMENT
/begin MEASUREMENT AXIN_020 "вход оси AX_020" UWORD CM_RAW 0 0 0 65535 ECU_ADDRESS 0x20000EB2 /end MEASUREMENT
/begin MEASUREMENT AXIN_021 "вход оси AX_021" UWORD CM_RAW 0 0 0 65535 ECU_ADDRESS 0x20000EBE /end MEASUREMENT
/begin MEASUREMENT AXIN_022 "вход оси AX_022" UWORD CM_RAW 0 0 0 65535 ECU_ADDRESS 0x20000EC6 /end MEASUREMENT
/begin MEASUREMENT AXIN_023 "вход оси AX_023" UWORD CM_RAW 0 0 0 65535 ECU_ADDRESS 0x20000DEE /end MEASUREMENT
/begin MEASUREMENT AXIN_024_LOAD "вход оси AX_024_LOAD (нагрузка / наполнение (0x3C28 / 0x3C30 / 0x3C34), масштаб не установлен [вероятно])" UWORD CM_RAW 0 0 0 65535 ECU_ADDRESS 0x20000EB6 /end MEASUREMENT
/begin MEASUREMENT AXIN_025_N "вход оси AX_025_N (обороты двигателя [да (60e6/период в 0x1FD40; единица 0,5 об/мин — вероятно)])" UWORD CM_RPM2 0 0 0 32767.5 ECU_ADDRESS 0x20000DF2 /end MEASUREMENT
/begin MEASUREMENT AXIN_026_N "вход оси AX_026_N (обороты двигателя [да (60e6/период в 0x1FD40; единица 0,5 об/мин — вероятно)])" UWORD CM_RPM2 0 0 0 32767.5 ECU_ADDRESS 0x20000EC2 /end MEASUREMENT
/begin MEASUREMENT AXIN_027_N "вход оси AX_027_N (обороты двигателя [да (60e6/период в 0x1FD40; единица 0,5 об/мин — вероятно)])" UWORD CM_RPM2 0 0 0 32767.5 ECU_ADDRESS 0x20000E0E /end MEASUREMENT
/begin MEASUREMENT AXIN_028_LOAD "вход оси AX_028_LOAD (нагрузка / наполнение (0x3C28 / 0x3C30 / 0x3C34), масштаб не установлен [вероятно])" UWORD CM_RAW 0 0 0 65535 ECU_ADDRESS 0x20000E0A /end MEASUREMENT
/begin MEASUREMENT AXIN_029 "вход оси AX_029" UWORD CM_RAW 0 0 0 65535 ECU_ADDRESS 0x20000E12 /end MEASUREMENT
/begin MEASUREMENT AXIN_02A "вход оси AX_02A" UWORD CM_RAW 0 0 0 65535 ECU_ADDRESS 0x20000D4A /end MEASUREMENT
/begin MEASUREMENT AXIN_02B "вход оси AX_02B" UWORD CM_RAW 0 0 0 65535 ECU_ADDRESS 0x20000D52 /end MEASUREMENT
/begin MEASUREMENT AXIN_02C "вход оси AX_02C" UWORD CM_RAW 0 0 0 65535 ECU_ADDRESS 0x20000D4E /end MEASUREMENT
/begin MEASUREMENT AXIN_02D "вход оси AX_02D" UWORD CM_RAW 0 0 0 65535 ECU_ADDRESS 0x20000D5E /end MEASUREMENT
/begin MEASUREMENT AXIN_02E "вход оси AX_02E" UWORD CM_RAW 0 0 0 65535 ECU_ADDRESS 0x20000D5A /end MEASUREMENT
/begin MEASUREMENT AXIN_02F "вход оси AX_02F" UWORD CM_RAW 0 0 0 65535 ECU_ADDRESS 0x20000D56 /end MEASUREMENT
/begin MEASUREMENT AXIN_030_N "вход оси AX_030_N (обороты двигателя [да (60e6/период в 0x1FD40; единица 0,5 об/мин — вероятно)])" UWORD CM_RPM2 0 0 0 32767.5 ECU_ADDRESS 0x20000D62 /end MEASUREMENT
/begin MEASUREMENT AXIN_031_TAIR "вход оси AX_031_TAIR (температура воздуха на впуске, АЦП канал 8 [вероятно])" SWORD CM_C128 0 0 -256 255.992 ECU_ADDRESS 0x20000D66 /end MEASUREMENT
/begin MEASUREMENT AXIN_032 "вход оси AX_032" UWORD CM_RAW 0 0 0 65535 ECU_ADDRESS 0x20000D6A /end MEASUREMENT
/begin MEASUREMENT AXIN_033 "вход оси AX_033" UWORD CM_RAW 0 0 0 65535 ECU_ADDRESS 0x20000DC2 /end MEASUREMENT
/begin MEASUREMENT AXIN_034_LOAD "вход оси AX_034_LOAD (нагрузка / наполнение (0x3C28 / 0x3C30 / 0x3C34), масштаб не установлен [вероятно])" UWORD CM_RAW 0 0 0 65535 ECU_ADDRESS 0x20000DBA /end MEASUREMENT
/begin MEASUREMENT AXIN_035_LOAD "вход оси AX_035_LOAD (нагрузка / наполнение (0x3C28 / 0x3C30 / 0x3C34), масштаб не установлен [вероятно])" UWORD CM_RAW 0 0 0 65535 ECU_ADDRESS 0x20000DBE /end MEASUREMENT
/begin MEASUREMENT AXIN_036 "вход оси AX_036" UWORD CM_RAW 0 0 0 65535 ECU_ADDRESS 0x20000DB6 /end MEASUREMENT
/begin MEASUREMENT AXIN_037 "вход оси AX_037" UWORD CM_RAW 0 0 0 65535 ECU_ADDRESS 0x20000DC6 /end MEASUREMENT
/begin MEASUREMENT AXIN_038_N "вход оси AX_038_N (обороты двигателя [да (60e6/период в 0x1FD40; единица 0,5 об/мин — вероятно)])" UWORD CM_RPM2 0 0 0 32767.5 ECU_ADDRESS 0x20000DCA /end MEASUREMENT
/begin MEASUREMENT AXIN_039_LOAD "вход оси AX_039_LOAD (нагрузка / наполнение (0x3C28 / 0x3C30 / 0x3C34), масштаб не установлен [вероятно])" UWORD CM_RAW 0 0 0 65535 ECU_ADDRESS 0x20000E16 /end MEASUREMENT
/begin MEASUREMENT AXIN_03A_N "вход оси AX_03A_N (обороты двигателя [да (60e6/период в 0x1FD40; единица 0,5 об/мин — вероятно)])" UWORD CM_RPM2 0 0 0 32767.5 ECU_ADDRESS 0x20000E1A /end MEASUREMENT
/begin MEASUREMENT AXIN_03B_N "вход оси AX_03B_N (обороты двигателя [да (60e6/период в 0x1FD40; единица 0,5 об/мин — вероятно)])" UWORD CM_RPM2 0 0 0 32767.5 ECU_ADDRESS 0x20000E1E /end MEASUREMENT
/begin MEASUREMENT AXIN_03C_N "вход оси AX_03C_N (обороты двигателя [да (60e6/период в 0x1FD40; единица 0,5 об/мин — вероятно)])" UWORD CM_RPM2 0 0 0 32767.5 ECU_ADDRESS 0x20000F56 /end MEASUREMENT
/begin MEASUREMENT AXIN_03D_LOAD "вход оси AX_03D_LOAD (нагрузка / наполнение (0x3C28 / 0x3C30 / 0x3C34), масштаб не установлен [вероятно])" UWORD CM_RAW 0 0 0 65535 ECU_ADDRESS 0x20000F52 /end MEASUREMENT
/begin MEASUREMENT AXIN_03E_N "вход оси AX_03E_N (обороты двигателя [да (60e6/период в 0x1FD40; единица 0,5 об/мин — вероятно)])" UWORD CM_RPM2 0 0 0 32767.5 ECU_ADDRESS 0x20000F42 /end MEASUREMENT
/begin MEASUREMENT AXIN_03F_LOAD "вход оси AX_03F_LOAD (нагрузка / наполнение (0x3C28 / 0x3C30 / 0x3C34), масштаб не установлен [вероятно])" UWORD CM_RAW 0 0 0 65535 ECU_ADDRESS 0x20000F3E /end MEASUREMENT
/begin MEASUREMENT AXIN_040 "вход оси AX_040" UWORD CM_RAW 0 0 0 65535 ECU_ADDRESS 0x20000F46 /end MEASUREMENT
/begin MEASUREMENT AXIN_041 "вход оси AX_041" UWORD CM_RAW 0 0 0 65535 ECU_ADDRESS 0x20000F3A /end MEASUREMENT
/begin MEASUREMENT AXIN_042_TAIR "вход оси AX_042_TAIR (температура воздуха на впуске, АЦП канал 8 [вероятно])" SWORD CM_C128 0 0 -256 255.992 ECU_ADDRESS 0x20000D82 /end MEASUREMENT
/begin MEASUREMENT AXIN_043 "вход оси AX_043 (педаль 0…100 %)" UWORD CM_P128 0 0 0 511.992 ECU_ADDRESS 0x20000EE6 /end MEASUREMENT
/begin MEASUREMENT AXIN_044 "вход оси AX_044" UWORD CM_RAW 0 0 0 65535 ECU_ADDRESS 0x20000FFA /end MEASUREMENT
/begin MEASUREMENT AXIN_045_TCOOL "вход оси AX_045_TCOOL (температура двигателя (ОЖ), АЦП канал 9 [вероятно])" SWORD CM_C128 0 0 -256 255.992 ECU_ADDRESS 0x20000F86 /end MEASUREMENT
/begin MEASUREMENT AXIN_046 "вход оси AX_046" SBYTE CM_RAW 0 0 -128 127 ECU_ADDRESS 0x2000102A /end MEASUREMENT
/begin MEASUREMENT AXIN_047 "вход оси AX_047" SBYTE CM_RAW 0 0 -128 127 ECU_ADDRESS 0x20000E52 /end MEASUREMENT
/begin MEASUREMENT AXIN_048 "вход оси AX_048" UWORD CM_RAW 0 0 0 65535 ECU_ADDRESS 0x20000F76 /end MEASUREMENT
/begin MEASUREMENT AXIN_049_TAIR "вход оси AX_049_TAIR (температура воздуха на впуске, АЦП канал 8 [вероятно])" SWORD CM_C128 0 0 -256 255.992 ECU_ADDRESS 0x2000101E /end MEASUREMENT
/begin MEASUREMENT AXIN_04A "вход оси AX_04A" UBYTE CM_RAW 0 0 0 255 ECU_ADDRESS 0x20000DFA /end MEASUREMENT
/begin MEASUREMENT AXIN_04B_N "вход оси AX_04B_N (обороты двигателя [да (60e6/период в 0x1FD40; единица 0,5 об/мин — вероятно)])" UWORD CM_RPM2 0 0 0 32767.5 ECU_ADDRESS 0x20000E26 /end MEASUREMENT
/begin MEASUREMENT AXIN_04C_LOAD "вход оси AX_04C_LOAD (нагрузка / наполнение (0x3C28 / 0x3C30 / 0x3C34), масштаб не установлен [вероятно])" UWORD CM_RAW 0 0 0 65535 ECU_ADDRESS 0x20000E2A /end MEASUREMENT
/begin MEASUREMENT AXIN_04D "вход оси AX_04D" UWORD CM_RAW 0 0 0 65535 ECU_ADDRESS 0x20000E2E /end MEASUREMENT
/begin MEASUREMENT AXIN_04E "вход оси AX_04E" UWORD CM_RAW 0 0 0 65535 ECU_ADDRESS 0x20000E32 /end MEASUREMENT
/begin MEASUREMENT AXIN_04F "вход оси AX_04F" UWORD CM_RAW 0 0 0 65535 ECU_ADDRESS 0x20000D8A /end MEASUREMENT
/begin MEASUREMENT AXIN_050_N "вход оси AX_050_N (обороты двигателя [да (60e6/период в 0x1FD40; единица 0,5 об/мин — вероятно)])" UWORD CM_RPM2 0 0 0 32767.5 ECU_ADDRESS 0x20000FE2 /end MEASUREMENT
/begin MEASUREMENT AXIN_051 "вход оси AX_051" UWORD CM_RAW 0 0 0 65535 ECU_ADDRESS 0x20001002 /end MEASUREMENT
/begin MEASUREMENT AXIN_052_N "вход оси AX_052_N (обороты двигателя [да (60e6/период в 0x1FD40; единица 0,5 об/мин — вероятно)])" UWORD CM_RPM2 0 0 0 32767.5 ECU_ADDRESS 0x20000FF2 /end MEASUREMENT
/begin MEASUREMENT AXIN_053 "вход оси AX_053" UWORD CM_RAW 0 0 0 65535 ECU_ADDRESS 0x20000FA6 /end MEASUREMENT
/begin MEASUREMENT AXIN_054 "вход оси AX_054" UWORD CM_RAW 0 0 0 65535 ECU_ADDRESS 0x20000CF2 /end MEASUREMENT
/begin MEASUREMENT AXIN_055 "вход оси AX_055" UWORD CM_RAW 0 0 0 65535 ECU_ADDRESS 0x20000F72 /end MEASUREMENT
/begin MEASUREMENT AXIN_056_VSPEED "вход оси AX_056_VSPEED (скорость автомобиля [вероятно (ось 0…9600 = 0…150 км/ч при /64)])" UWORD CM_KMH64 0 0 0 1023.98 ECU_ADDRESS 0x20000ED6 /end MEASUREMENT
/begin MEASUREMENT AXIN_057_TAIR "вход оси AX_057_TAIR (температура воздуха на впуске, АЦП канал 8 [вероятно])" SWORD CM_C128 0 0 -256 255.992 ECU_ADDRESS 0x20000EDA /end MEASUREMENT
/begin MEASUREMENT AXIN_058 "вход оси AX_058" UWORD CM_RAW 0 0 0 65535 ECU_ADDRESS 0x20000EDE /end MEASUREMENT
/begin MEASUREMENT AXIN_059 "вход оси AX_059" UWORD CM_RAW 0 0 0 65535 ECU_ADDRESS 0x20000EE2 /end MEASUREMENT
/begin MEASUREMENT AXIN_05A "вход оси AX_05A" UWORD CM_RAW 0 0 0 65535 ECU_ADDRESS 0x20000EEA /end MEASUREMENT
/begin MEASUREMENT AXIN_05B "вход оси AX_05B" UWORD CM_RAW 0 0 0 65535 ECU_ADDRESS 0x20000F5E /end MEASUREMENT
/begin MEASUREMENT AXIN_05C "вход оси AX_05C" UWORD CM_RAW 0 0 0 65535 ECU_ADDRESS 0x20000C3A /end MEASUREMENT
/begin MEASUREMENT AXIN_05D "вход оси AX_05D (индекс 0…7 (похоже, передача))" SBYTE CM_RAW 0 0 -128 127 ECU_ADDRESS 0x20001012 /end MEASUREMENT
/begin MEASUREMENT AXIN_05E_GEAR "вход оси AX_05E_GEAR (номер передачи 0…7 [вероятно])" SBYTE CM_RAW 0 0 -128 127 ECU_ADDRESS 0x20001016 /end MEASUREMENT
/begin MEASUREMENT AXIN_05F_N "вход оси AX_05F_N (обороты двигателя [да (60e6/период в 0x1FD40; единица 0,5 об/мин — вероятно)])" UWORD CM_RPM2 0 0 0 32767.5 ECU_ADDRESS 0x20000FD2 /end MEASUREMENT
/begin MEASUREMENT AXIN_060 "вход оси AX_060" SBYTE CM_RAW 0 0 -128 127 ECU_ADDRESS 0x20000DD2 /end MEASUREMENT
/begin MEASUREMENT AXIN_061 "вход оси AX_061" SBYTE CM_RAW 0 0 -128 127 ECU_ADDRESS 0x20000DDA /end MEASUREMENT
/begin MEASUREMENT AXIN_062 "вход оси AX_062" SBYTE CM_RAW 0 0 -128 127 ECU_ADDRESS 0x20000DD6 /end MEASUREMENT
/begin MEASUREMENT AXIN_063 "вход оси AX_063" UWORD CM_RAW 0 0 0 65535 ECU_ADDRESS 0x2000103E /end MEASUREMENT
/begin MEASUREMENT AXIN_064 "вход оси AX_064" UWORD CM_RAW 0 0 0 65535 ECU_ADDRESS 0x20000F66 /end MEASUREMENT
/begin MEASUREMENT AXIN_065 "вход оси AX_065" UWORD CM_RAW 0 0 0 65535 ECU_ADDRESS 0x20000F7A /end MEASUREMENT
/begin MEASUREMENT AXIN_066 "вход оси AX_066" UWORD CM_RAW 0 0 0 65535 ECU_ADDRESS 0x20000C52 /end MEASUREMENT
/begin MEASUREMENT AXIN_067 "вход оси AX_067" UWORD CM_RAW 0 0 0 65535 ECU_ADDRESS 0x20000C56 /end MEASUREMENT
/begin MEASUREMENT AXIN_068 "вход оси AX_068" SBYTE CM_RAW 0 0 -128 127 ECU_ADDRESS 0x20000C5A /end MEASUREMENT
/begin MEASUREMENT AXIN_069 "вход оси AX_069" UWORD CM_RAW 0 0 0 65535 ECU_ADDRESS 0x20000C5E /end MEASUREMENT
/begin MEASUREMENT AXIN_06A_N "вход оси AX_06A_N (обороты двигателя [да (60e6/период в 0x1FD40; единица 0,5 об/мин — вероятно)])" UWORD CM_RPM2 0 0 0 32767.5 ECU_ADDRESS 0x20000CCE /end MEASUREMENT
/begin MEASUREMENT AXIN_06B "вход оси AX_06B" UWORD CM_RAW 0 0 0 65535 ECU_ADDRESS 0x20000CD2 /end MEASUREMENT
/begin MEASUREMENT AXIN_06C_TAIR "вход оси AX_06C_TAIR (температура воздуха на впуске, АЦП канал 8 [вероятно])" SWORD CM_C128 0 0 -256 255.992 ECU_ADDRESS 0x20000CDE /end MEASUREMENT
/begin MEASUREMENT AXIN_06D "вход оси AX_06D" UWORD CM_RAW 0 0 0 65535 ECU_ADDRESS 0x20000CDA /end MEASUREMENT
/begin MEASUREMENT AXIN_06E "вход оси AX_06E" UWORD CM_RAW 0 0 0 65535 ECU_ADDRESS 0x20001032 /end MEASUREMENT
/begin MEASUREMENT AXIN_06F "вход оси AX_06F" UWORD CM_RAW 0 0 0 65535 ECU_ADDRESS 0x20000C66 /end MEASUREMENT
/begin MEASUREMENT AXIN_070 "вход оси AX_070" SBYTE CM_RAW 0 0 -128 127 ECU_ADDRESS 0x20000FAE /end MEASUREMENT
/begin MEASUREMENT AXIN_071 "вход оси AX_071" SBYTE CM_RAW 0 0 -128 127 ECU_ADDRESS 0x20000FB2 /end MEASUREMENT
/begin MEASUREMENT AXIN_072 "вход оси AX_072" SBYTE CM_RAW 0 0 -128 127 ECU_ADDRESS 0x20000D0A /end MEASUREMENT
/begin MEASUREMENT AXIN_073 "вход оси AX_073" SBYTE CM_RAW 0 0 -128 127 ECU_ADDRESS 0x20000D0E /end MEASUREMENT
/begin MEASUREMENT AXIN_074_LOAD "вход оси AX_074_LOAD (нагрузка / наполнение (0x3C28 / 0x3C30 / 0x3C34), масштаб не установлен [вероятно])" UWORD CM_RAW 0 0 0 65535 ECU_ADDRESS 0x20000DFE /end MEASUREMENT
/begin MEASUREMENT AXIN_075_N "вход оси AX_075_N (обороты двигателя [да (60e6/период в 0x1FD40; единица 0,5 об/мин — вероятно)])" UWORD CM_RPM2 0 0 0 32767.5 ECU_ADDRESS 0x20000E02 /end MEASUREMENT
/begin MEASUREMENT AXIN_076 "вход оси AX_076" UWORD CM_RAW 0 0 0 65535 ECU_ADDRESS 0x20000FC2 /end MEASUREMENT
/begin MEASUREMENT AXIN_077 "вход оси AX_077" UWORD CM_RAW 0 0 0 65535 ECU_ADDRESS 0x20000EBA /end MEASUREMENT
/begin MEASUREMENT AXIN_078 "вход оси AX_078" UWORD CM_RAW 0 0 0 65535 ECU_ADDRESS 0x20000E92 /end MEASUREMENT
/begin MEASUREMENT AXIN_079 "вход оси AX_079" UWORD CM_RAW 0 0 0 65535 ECU_ADDRESS 0x20000E9A /end MEASUREMENT
/begin MEASUREMENT AXIN_07A_LOAD "вход оси AX_07A_LOAD (нагрузка / наполнение (0x3C28 / 0x3C30 / 0x3C34), масштаб не установлен [вероятно])" UWORD CM_RAW 0 0 0 65535 ECU_ADDRESS 0x20000E8A /end MEASUREMENT
/begin MEASUREMENT AXIN_07B_LOAD "вход оси AX_07B_LOAD (нагрузка / наполнение (0x3C28 / 0x3C30 / 0x3C34), масштаб не установлен [вероятно])" UWORD CM_RAW 0 0 0 65535 ECU_ADDRESS 0x20000E8E /end MEASUREMENT
/begin MEASUREMENT AXIN_07C "вход оси AX_07C" UWORD CM_RAW 0 0 0 65535 ECU_ADDRESS 0x20000E96 /end MEASUREMENT
/begin MEASUREMENT AXIN_07D "вход оси AX_07D" UWORD CM_RAW 0 0 0 65535 ECU_ADDRESS 0x2000102E /end MEASUREMENT
/begin MEASUREMENT AXIN_07E_PEDAL "вход оси AX_07E_PEDAL (положение педали газа [да])" UWORD CM_P128 0 0 0 511.992 ECU_ADDRESS 0x20000C4E /end MEASUREMENT
/begin MEASUREMENT AXIN_07F_LOAD "вход оси AX_07F_LOAD (нагрузка / наполнение (0x3C28 / 0x3C30 / 0x3C34), масштаб не установлен [вероятно])" UWORD CM_RAW 0 0 0 65535 ECU_ADDRESS 0x20000D96 /end MEASUREMENT
/begin MEASUREMENT AXIN_080_N "вход оси AX_080_N (обороты двигателя [да (60e6/период в 0x1FD40; единица 0,5 об/мин — вероятно)])" UWORD CM_RPM2 0 0 0 32767.5 ECU_ADDRESS 0x20000D9A /end MEASUREMENT
/begin MEASUREMENT AXIN_081 "вход оси AX_081" UWORD CM_RAW 0 0 0 65535 ECU_ADDRESS 0x20000FCA /end MEASUREMENT
/begin MEASUREMENT AXIN_082 "вход оси AX_082" UWORD CM_RAW 0 0 0 65535 ECU_ADDRESS 0x20000F7E /end MEASUREMENT
/begin MEASUREMENT AXIN_083 "вход оси AX_083" UBYTE CM_RAW 0 0 0 255 ECU_ADDRESS 0x20000CBA /end MEASUREMENT
/begin MEASUREMENT AXIN_084 "вход оси AX_084" UBYTE CM_RAW 0 0 0 255 ECU_ADDRESS 0x20000CAA /end MEASUREMENT
/begin MEASUREMENT AXIN_085 "вход оси AX_085" UBYTE CM_RAW 0 0 0 255 ECU_ADDRESS 0x20000CB6 /end MEASUREMENT
/begin MEASUREMENT AXIN_086 "вход оси AX_086" UBYTE CM_RAW 0 0 0 255 ECU_ADDRESS 0x20000C9A /end MEASUREMENT
/begin MEASUREMENT AXIN_087 "вход оси AX_087" SBYTE CM_RAW 0 0 -128 127 ECU_ADDRESS 0x20000C9E /end MEASUREMENT
/begin MEASUREMENT AXIN_088 "вход оси AX_088" UWORD CM_RAW 0 0 0 65535 ECU_ADDRESS 0x20000CA6 /end MEASUREMENT
/begin MEASUREMENT AXIN_089_LOAD "вход оси AX_089_LOAD (нагрузка / наполнение (0x3C28 / 0x3C30 / 0x3C34), масштаб не установлен [вероятно])" UWORD CM_RAW 0 0 0 65535 ECU_ADDRESS 0x20000D92 /end MEASUREMENT
/begin MEASUREMENT AXIN_08A_TCOOL "вход оси AX_08A_TCOOL (температура двигателя (ОЖ), АЦП канал 9 [вероятно])" SWORD CM_C128 0 0 -256 255.992 ECU_ADDRESS 0x20000D8E /end MEASUREMENT
/begin MEASUREMENT AXIN_08B "вход оси AX_08B" SBYTE CM_RAW 0 0 -128 127 ECU_ADDRESS 0x20000CE2 /end MEASUREMENT
/begin MEASUREMENT AXIN_08C_TCOOL "вход оси AX_08C_TCOOL (температура двигателя (ОЖ), АЦП канал 9 [вероятно])" SWORD CM_C128 0 0 -256 255.992 ECU_ADDRESS 0x20000F92 /end MEASUREMENT
/begin MEASUREMENT AXIN_08D "вход оси AX_08D" SBYTE CM_RAW 0 0 -128 127 ECU_ADDRESS 0x20000FAA /end MEASUREMENT
/begin MEASUREMENT AXIN_08E "вход оси AX_08E" UWORD CM_RAW 0 0 0 65535 ECU_ADDRESS 0x20000FBE /end MEASUREMENT
/begin MEASUREMENT AXIN_08F_TCOOL "вход оси AX_08F_TCOOL (температура двигателя (ОЖ), АЦП канал 9 [вероятно])" SWORD CM_C128 0 0 -256 255.992 ECU_ADDRESS 0x20000F8E /end MEASUREMENT
/begin MEASUREMENT AXIN_090_TAIR "вход оси AX_090_TAIR (температура воздуха на впуске, АЦП канал 8 [вероятно])" SWORD CM_C128 0 0 -256 255.992 ECU_ADDRESS 0x2000101A /end MEASUREMENT
/begin MEASUREMENT AXIN_091 "вход оси AX_091" UWORD CM_RAW 0 0 0 65535 ECU_ADDRESS 0x2000100E /end MEASUREMENT
/begin MEASUREMENT AXIN_092 "вход оси AX_092" UWORD CM_RAW 0 0 0 65535 ECU_ADDRESS 0x2000100A /end MEASUREMENT
/begin MEASUREMENT AXIN_093 "вход оси AX_093" UWORD CM_RAW 0 0 0 65535 ECU_ADDRESS 0x20000F12 /end MEASUREMENT
/begin MEASUREMENT AXIN_094 "вход оси AX_094" SBYTE CM_RAW 0 0 -128 127 ECU_ADDRESS 0x20000D16 /end MEASUREMENT
/begin MEASUREMENT AXIN_095 "вход оси AX_095" SBYTE CM_RAW 0 0 -128 127 ECU_ADDRESS 0x20000D1A /end MEASUREMENT
/begin MEASUREMENT AXIN_096 "вход оси AX_096" SBYTE CM_RAW 0 0 -128 127 ECU_ADDRESS 0x20000D12 /end MEASUREMENT
/begin MEASUREMENT AXIN_097 "вход оси AX_097" UWORD CM_RAW 0 0 0 65535 ECU_ADDRESS 0x20001026 /end MEASUREMENT
/begin MEASUREMENT AXIN_098 "вход оси AX_098" UWORD CM_RAW 0 0 0 65535 ECU_ADDRESS 0x20000CD6 /end MEASUREMENT
/begin MEASUREMENT AXIN_099 "вход оси AX_099" UWORD CM_RAW 0 0 0 65535 ECU_ADDRESS 0x20000ED2 /end MEASUREMENT
/begin MEASUREMENT AXIN_09A "вход оси AX_09A" UWORD CM_RAW 0 0 0 65535 ECU_ADDRESS 0x20000C7E /end MEASUREMENT
/begin MEASUREMENT AXIN_09B "вход оси AX_09B" UWORD CM_RAW 0 0 0 65535 ECU_ADDRESS 0x20000C86 /end MEASUREMENT
/begin MEASUREMENT AXIN_09C "вход оси AX_09C" UWORD CM_RAW 0 0 0 65535 ECU_ADDRESS 0x20000C8A /end MEASUREMENT
/begin MEASUREMENT AXIN_09D "вход оси AX_09D" UWORD CM_RAW 0 0 0 65535 ECU_ADDRESS 0x20000C82 /end MEASUREMENT
/begin MEASUREMENT AXIN_09E_GEAR "вход оси AX_09E_GEAR (номер передачи 0…7 [вероятно])" UBYTE CM_RAW 0 0 0 255 ECU_ADDRESS 0x20000C8E /end MEASUREMENT
/begin MEASUREMENT AXIN_09F "вход оси AX_09F" UWORD CM_RAW 0 0 0 65535 ECU_ADDRESS 0x20000C92 /end MEASUREMENT
/begin MEASUREMENT AXIN_0A0 "вход оси AX_0A0 (индекс 0…7 (похоже, передача))" SBYTE CM_RAW 0 0 -128 127 ECU_ADDRESS 0x20000DAA /end MEASUREMENT
/begin MEASUREMENT AXIN_0A1_N "вход оси AX_0A1_N (обороты двигателя [да (60e6/период в 0x1FD40; единица 0,5 об/мин — вероятно)])" UWORD CM_RPM2 0 0 0 32767.5 ECU_ADDRESS 0x20000DAE /end MEASUREMENT
/begin MEASUREMENT AXIN_0A2 "вход оси AX_0A2" UBYTE CM_RAW 0 0 0 255 ECU_ADDRESS 0x20000CAE /end MEASUREMENT
/begin MEASUREMENT AXIN_0A3 "вход оси AX_0A3" UWORD CM_RAW 0 0 0 65535 ECU_ADDRESS 0x20000E42 /end MEASUREMENT
/begin MEASUREMENT AXIN_0A4 "вход оси AX_0A4" SBYTE CM_RAW 0 0 -128 127 ECU_ADDRESS 0x20000E46 /end MEASUREMENT
/begin MEASUREMENT AXIN_0A5 "вход оси AX_0A5" SBYTE CM_RAW 0 0 -128 127 ECU_ADDRESS 0x20000E4A /end MEASUREMENT
/begin MEASUREMENT AXIN_0A6 "вход оси AX_0A6" SBYTE CM_RAW 0 0 -128 127 ECU_ADDRESS 0x20000E4E /end MEASUREMENT
/begin MEASUREMENT AXIN_0A7 "вход оси AX_0A7" SBYTE CM_RAW 0 0 -128 127 ECU_ADDRESS 0x20000E56 /end MEASUREMENT
/begin MEASUREMENT AXIN_0A8 "вход оси AX_0A8" SBYTE CM_RAW 0 0 -128 127 ECU_ADDRESS 0x20000E62 /end MEASUREMENT
/begin MEASUREMENT AXIN_0A9 "вход оси AX_0A9" SBYTE CM_RAW 0 0 -128 127 ECU_ADDRESS 0x20000C6A /end MEASUREMENT
/begin MEASUREMENT AXIN_0AA "вход оси AX_0AA" UWORD CM_RAW 0 0 0 65535 ECU_ADDRESS 0x20000EA6 /end MEASUREMENT
/begin MEASUREMENT AXIN_0AB "вход оси AX_0AB" UWORD CM_RAW 0 0 0 65535 ECU_ADDRESS 0x20000EAA /end MEASUREMENT
/begin MEASUREMENT AXIN_0AC_N "вход оси AX_0AC_N (обороты двигателя [да (60e6/период в 0x1FD40; единица 0,5 об/мин — вероятно)])" UWORD CM_RPM2 0 0 0 32767.5 ECU_ADDRESS 0x20000EFE /end MEASUREMENT
/begin MEASUREMENT AXIN_0AD_N "вход оси AX_0AD_N (обороты двигателя [да (60e6/период в 0x1FD40; единица 0,5 об/мин — вероятно)])" UWORD CM_RPM2 0 0 0 32767.5 ECU_ADDRESS 0x20000F06 /end MEASUREMENT
/begin MEASUREMENT AXIN_0AE "вход оси AX_0AE" UWORD CM_RAW 0 0 0 65535 ECU_ADDRESS 0x20000F02 /end MEASUREMENT
/begin MEASUREMENT AXIN_0AF "вход оси AX_0AF" UWORD CM_RAW 0 0 0 65535 ECU_ADDRESS 0x20000F2A /end MEASUREMENT
/begin MEASUREMENT AXIN_0B0 "вход оси AX_0B0" UWORD CM_RAW 0 0 0 65535 ECU_ADDRESS 0x20000F26 /end MEASUREMENT
/begin MEASUREMENT AXIN_0B1_N "вход оси AX_0B1_N (обороты двигателя [да (60e6/период в 0x1FD40; единица 0,5 об/мин — вероятно)])" UWORD CM_RPM2 0 0 0 32767.5 ECU_ADDRESS 0x20000EFA /end MEASUREMENT
/begin MEASUREMENT AXIN_0B2 "вход оси AX_0B2" UWORD CM_RAW 0 0 0 65535 ECU_ADDRESS 0x20000F1E /end MEASUREMENT
/begin MEASUREMENT AXIN_0B3 "вход оси AX_0B3 (педаль 0…100 %)" UWORD CM_P128 0 0 0 511.992 ECU_ADDRESS 0x20000F22 /end MEASUREMENT
/begin MEASUREMENT AXIN_0B4 "вход оси AX_0B4" SWORD CM_RAW 0 0 -32768 32767 ECU_ADDRESS 0x20000F1A /end MEASUREMENT
/begin MEASUREMENT AXIN_0B5 "вход оси AX_0B5" UWORD CM_RAW 0 0 0 65535 ECU_ADDRESS 0x20000F16 /end MEASUREMENT
/begin MEASUREMENT AXIN_0B6 "вход оси AX_0B6" UWORD CM_RAW 0 0 0 65535 ECU_ADDRESS 0x20000F0A /end MEASUREMENT
/begin MEASUREMENT AXIN_0B7_LOAD "вход оси AX_0B7_LOAD (нагрузка / наполнение (0x3C28 / 0x3C30 / 0x3C34), масштаб не установлен [вероятно])" UWORD CM_RAW 0 0 0 65535 ECU_ADDRESS 0x20000EEE /end MEASUREMENT
/begin MEASUREMENT AXIN_0B8 "вход оси AX_0B8" UWORD CM_RAW 0 0 0 65535 ECU_ADDRESS 0x20000EF2 /end MEASUREMENT
/begin MEASUREMENT AXIN_0B9 "вход оси AX_0B9" UWORD CM_RAW 0 0 0 65535 ECU_ADDRESS 0x20000EF6 /end MEASUREMENT
/begin MEASUREMENT AXIN_0BA "вход оси AX_0BA" SBYTE CM_RAW 0 0 -128 127 ECU_ADDRESS 0x20000F2E /end MEASUREMENT
/begin MEASUREMENT AXIN_0BB "вход оси AX_0BB" UWORD CM_RAW 0 0 0 65535 ECU_ADDRESS 0x20000F36 /end MEASUREMENT
/begin MEASUREMENT AXIN_0BC "вход оси AX_0BC" SBYTE CM_RAW 0 0 -128 127 ECU_ADDRESS 0x20000F32 /end MEASUREMENT
/begin MEASUREMENT AXIN_0BD "вход оси AX_0BD" SBYTE CM_RAW 0 0 -128 127 ECU_ADDRESS 0x20000DE6 /end MEASUREMENT
/begin MEASUREMENT AXIN_0BE "вход оси AX_0BE" SBYTE CM_RAW 0 0 -128 127 ECU_ADDRESS 0x20000DF6 /end MEASUREMENT
/begin MEASUREMENT AXIN_0BF "вход оси AX_0BF" UWORD CM_RAW 0 0 0 65535 ECU_ADDRESS 0x20000DDE /end MEASUREMENT
/begin MEASUREMENT AXIN_0C0 "вход оси AX_0C0" SBYTE CM_RAW 0 0 -128 127 ECU_ADDRESS 0x20000DE2 /end MEASUREMENT
/begin MEASUREMENT AXIN_0C1 "вход оси AX_0C1" UWORD CM_RAW 0 0 0 65535 ECU_ADDRESS 0x20000C3E /end MEASUREMENT
/begin MEASUREMENT AXIN_0C2 "вход оси AX_0C2" UWORD CM_RAW 0 0 0 65535 ECU_ADDRESS 0x20000C42 /end MEASUREMENT
/begin MEASUREMENT AXIN_0C3 "вход оси AX_0C3" UWORD CM_RAW 0 0 0 65535 ECU_ADDRESS 0x20000C46 /end MEASUREMENT
/begin MEASUREMENT AXIN_0C4 "вход оси AX_0C4" UWORD CM_RAW 0 0 0 65535 ECU_ADDRESS 0x20000E6E /end MEASUREMENT
/begin MEASUREMENT AXIN_0C5_N "вход оси AX_0C5_N (обороты двигателя [да (60e6/период в 0x1FD40; единица 0,5 об/мин — вероятно)])" UWORD CM_RPM2 0 0 0 32767.5 ECU_ADDRESS 0x20000E7A /end MEASUREMENT
/begin MEASUREMENT AXIN_0C6_N "вход оси AX_0C6_N (обороты двигателя [да (60e6/период в 0x1FD40; единица 0,5 об/мин — вероятно)])" UWORD CM_RPM2 0 0 0 32767.5 ECU_ADDRESS 0x20000E76 /end MEASUREMENT
/begin MEASUREMENT AXIN_0C7 "вход оси AX_0C7" UWORD CM_RAW 0 0 0 65535 ECU_ADDRESS 0x20000E66 /end MEASUREMENT
/begin MEASUREMENT AXIN_0C8 "вход оси AX_0C8 (педаль 0…100 %)" UWORD CM_P128 0 0 0 511.992 ECU_ADDRESS 0x20000E72 /end MEASUREMENT
/begin MEASUREMENT AXIN_0C9 "вход оси AX_0C9" UWORD CM_RAW 0 0 0 65535 ECU_ADDRESS 0x20000E6A /end MEASUREMENT
/begin MEASUREMENT AXIN_0CA "вход оси AX_0CA" UWORD CM_RAW 0 0 0 65535 ECU_ADDRESS 0x20000D46 /end MEASUREMENT
/begin MEASUREMENT AXIN_0CB "вход оси AX_0CB" UWORD CM_RAW 0 0 0 65535 ECU_ADDRESS 0x20000D42 /end MEASUREMENT
/begin MEASUREMENT AXIN_0CC "вход оси AX_0CC" UWORD CM_RAW 0 0 0 65535 ECU_ADDRESS 0x20000D86 /end MEASUREMENT
/begin MEASUREMENT AXIN_0CD_N "вход оси AX_0CD_N (обороты двигателя [да (60e6/период в 0x1FD40; единица 0,5 об/мин — вероятно)])" UWORD CM_RPM2 0 0 0 32767.5 ECU_ADDRESS 0x20000FDA /end MEASUREMENT
/begin MEASUREMENT AXIN_0CE "вход оси AX_0CE" SBYTE CM_RAW 0 0 -128 127 ECU_ADDRESS 0x20000CBE /end MEASUREMENT
/begin MEASUREMENT AXIN_0CF "вход оси AX_0CF" UWORD CM_RAW 0 0 0 65535 ECU_ADDRESS 0x20000CC2 /end MEASUREMENT
/begin MEASUREMENT AXIN_0D0 "вход оси AX_0D0" SWORD CM_RAW 0 0 -32768 32767 ECU_ADDRESS 0x20000CC6 /end MEASUREMENT
/begin MEASUREMENT AXIN_0D1 "вход оси AX_0D1" UWORD CM_RAW 0 0 0 65535 ECU_ADDRESS 0x20000CCA /end MEASUREMENT
/begin MEASUREMENT AXIN_0D2 "вход оси AX_0D2" UWORD CM_RAW 0 0 0 65535 ECU_ADDRESS 0x20000E7E /end MEASUREMENT
/begin MEASUREMENT AXIN_0D3_TCOOL "вход оси AX_0D3_TCOOL (температура двигателя (ОЖ), АЦП канал 9 [вероятно])" SWORD CM_C128 0 0 -256 255.992 ECU_ADDRESS 0x20000F82 /end MEASUREMENT
/begin MEASUREMENT AXIN_0D4 "вход оси AX_0D4" SBYTE CM_RAW 0 0 -128 127 ECU_ADDRESS 0x20000E3A /end MEASUREMENT
/begin MEASUREMENT AXIN_0D5 "вход оси AX_0D5 (индекс 0…7 (похоже, передача))" SBYTE CM_RAW 0 0 -128 127 ECU_ADDRESS 0x20000E3E /end MEASUREMENT
/begin MEASUREMENT AXIN_0D6 "вход оси AX_0D6" SBYTE CM_RAW 0 0 -128 127 ECU_ADDRESS 0x20000ECA /end MEASUREMENT
/begin MEASUREMENT AXIN_0D7 "вход оси AX_0D7" SBYTE CM_RAW 0 0 -128 127 ECU_ADDRESS 0x20000D7E /end MEASUREMENT
/begin MEASUREMENT AXIN_0D8_N "вход оси AX_0D8_N (обороты двигателя [да (60e6/период в 0x1FD40; единица 0,5 об/мин — вероятно)])" UWORD CM_RPM2 0 0 0 32767.5 ECU_ADDRESS 0x20000FE6 /end MEASUREMENT
/begin MEASUREMENT AXIN_0D9 "вход оси AX_0D9" UWORD CM_RAW 0 0 0 65535 ECU_ADDRESS 0x20000FBA /end MEASUREMENT
/begin MEASUREMENT AXIN_0DA "вход оси AX_0DA" UWORD CM_RAW 0 0 0 65535 ECU_ADDRESS 0x20000E82 /end MEASUREMENT
/begin MEASUREMENT AXIN_0DB "вход оси AX_0DB" UWORD CM_RAW 0 0 0 65535 ECU_ADDRESS 0x20000F9E /end MEASUREMENT
/begin MEASUREMENT AXIN_0DC_N "вход оси AX_0DC_N (обороты двигателя [да (60e6/период в 0x1FD40; единица 0,5 об/мин — вероятно)])" UWORD CM_RPM2 0 0 0 32767.5 ECU_ADDRESS 0x20000FD6 /end MEASUREMENT
/begin MEASUREMENT AXIN_0DD "вход оси AX_0DD" UWORD CM_RAW 0 0 0 65535 ECU_ADDRESS 0x20000FC6 /end MEASUREMENT
/begin MEASUREMENT AXIN_0DE "вход оси AX_0DE" UWORD CM_RAW 0 0 0 65535 ECU_ADDRESS 0x20000E5A /end MEASUREMENT
/begin MEASUREMENT AXIN_0DF "вход оси AX_0DF" SBYTE CM_RAW 0 0 -128 127 ECU_ADDRESS 0x20000E9E /end MEASUREMENT
/begin MEASUREMENT AXIN_0E0 "вход оси AX_0E0" SBYTE CM_RAW 0 0 -128 127 ECU_ADDRESS 0x20000E5E /end MEASUREMENT
/begin MEASUREMENT AXIN_0E1 "вход оси AX_0E1" SBYTE CM_RAW 0 0 -128 127 ECU_ADDRESS 0x20000C4A /end MEASUREMENT
/begin MEASUREMENT AXIN_0E2 "вход оси AX_0E2" SBYTE CM_RAW 0 0 -128 127 ECU_ADDRESS 0x20000ECE /end MEASUREMENT
/begin MEASUREMENT AXIN_0E3 "вход оси AX_0E3" UWORD CM_RAW 0 0 0 65535 ECU_ADDRESS 0x20001006 /end MEASUREMENT
/begin MEASUREMENT AXIN_0E4 "вход оси AX_0E4" SBYTE CM_RAW 0 0 -128 127 ECU_ADDRESS 0x20000E86 /end MEASUREMENT
/begin MEASUREMENT AXIN_0E5 "вход оси AX_0E5 (индекс 0…7 (похоже, передача))" SBYTE CM_RAW 0 0 -128 127 ECU_ADDRESS 0x20000D36 /end MEASUREMENT
/begin MEASUREMENT AXIN_0E6 "вход оси AX_0E6" UWORD CM_RAW 0 0 0 65535 ECU_ADDRESS 0x20000F0E /end MEASUREMENT
/begin MEASUREMENT AXIN_0E7 "вход оси AX_0E7" SBYTE CM_RAW 0 0 -128 127 ECU_ADDRESS 0x20000C96 /end MEASUREMENT
/begin MEASUREMENT AXIN_0E8 "вход оси AX_0E8" SBYTE CM_RAW 0 0 -128 127 ECU_ADDRESS 0x20000CEE /end MEASUREMENT
/begin MEASUREMENT AXIN_0E9 "вход оси AX_0E9" SBYTE CM_RAW 0 0 -128 127 ECU_ADDRESS 0x20000CE6 /end MEASUREMENT
/begin MEASUREMENT AXIN_0EA "вход оси AX_0EA" SBYTE CM_RAW 0 0 -128 127 ECU_ADDRESS 0x20000C72 /end MEASUREMENT
/begin MEASUREMENT AXIN_0EB "вход оси AX_0EB" SBYTE CM_RAW 0 0 -128 127 ECU_ADDRESS 0x20000C76 /end MEASUREMENT
/begin MEASUREMENT AXIN_0EC "вход оси AX_0EC" SBYTE CM_RAW 0 0 -128 127 ECU_ADDRESS 0x20000C6E /end MEASUREMENT
/begin MEASUREMENT AXIN_0ED "вход оси AX_0ED" UBYTE CM_RAW 0 0 0 255 ECU_ADDRESS 0x20000C36 /end MEASUREMENT
/begin MEASUREMENT AXIN_0EE "вход оси AX_0EE" SBYTE CM_RAW 0 0 -128 127 ECU_ADDRESS 0x20000E06 /end MEASUREMENT
/begin MEASUREMENT AXIN_0EF "вход оси AX_0EF" SBYTE CM_RAW 0 0 -128 127 ECU_ADDRESS 0x20000D76 /end MEASUREMENT
/begin MEASUREMENT AXIN_0F0 "вход оси AX_0F0" SBYTE CM_RAW 0 0 -128 127 ECU_ADDRESS 0x20000D7A /end MEASUREMENT
/begin MEASUREMENT AXIN_0F1 "вход оси AX_0F1" SBYTE CM_RAW 0 0 -128 127 ECU_ADDRESS 0x20000DCE /end MEASUREMENT
/begin MEASUREMENT AXIN_0F2 "вход оси AX_0F2" UBYTE CM_RAW 0 0 0 255 ECU_ADDRESS 0x20000C62 /end MEASUREMENT
/begin MEASUREMENT AXIN_0F3 "вход оси AX_0F3" SBYTE CM_RAW 0 0 -128 127 ECU_ADDRESS 0x20000D6E /end MEASUREMENT
/begin MEASUREMENT AXIN_0F4 "вход оси AX_0F4" SBYTE CM_RAW 0 0 -128 127 ECU_ADDRESS 0x20000D72 /end MEASUREMENT
/begin MEASUREMENT AXIN_0F5 "вход оси AX_0F5" SBYTE CM_RAW 0 0 -128 127 ECU_ADDRESS 0x20000CFE /end MEASUREMENT
/begin MEASUREMENT AXIN_0F6 "вход оси AX_0F6" SBYTE CM_RAW 0 0 -128 127 ECU_ADDRESS 0x20000D02 /end MEASUREMENT
/begin MEASUREMENT AXIN_0F7 "вход оси AX_0F7" SBYTE CM_RAW 0 0 -128 127 ECU_ADDRESS 0x20000D06 /end MEASUREMENT
/begin MEASUREMENT AXIN_0F8 "вход оси AX_0F8 (индекс 0…7 (похоже, передача))" SBYTE CM_RAW 0 0 -128 127 ECU_ADDRESS 0x20000E36 /end MEASUREMENT
/begin MEASUREMENT AXIN_0F9 "вход оси AX_0F9" SBYTE CM_RAW 0 0 -128 127 ECU_ADDRESS 0x20000E22 /end MEASUREMENT
/begin MEASUREMENT AXIN_0FA_N "вход оси AX_0FA_N (обороты двигателя [да (60e6/период в 0x1FD40; единица 0,5 об/мин — вероятно)])" UWORD CM_RPM2 0 0 0 32767.5 ECU_ADDRESS 0x20000FEE /end MEASUREMENT
/begin MEASUREMENT AXIN_0FB "вход оси AX_0FB" UWORD CM_RAW 0 0 0 65535 ECU_ADDRESS 0x20000F4A /end MEASUREMENT
/begin MEASUREMENT AXIN_0FC "вход оси AX_0FC" UWORD CM_RAW 0 0 0 65535 ECU_ADDRESS 0x20000F4E /end MEASUREMENT
/begin MEASUREMENT AXIN_0FD "вход оси AX_0FD" SWORD CM_RAW 0 0 -32768 32767 ECU_ADDRESS 0x20000F5A /end MEASUREMENT
/begin MEASUREMENT AXIN_0FE_N "вход оси AX_0FE_N (обороты двигателя [да (60e6/период в 0x1FD40; единица 0,5 об/мин — вероятно)])" UWORD CM_RPM2 0 0 0 32767.5 ECU_ADDRESS 0x20000DEA /end MEASUREMENT
/begin MEASUREMENT AXIN_0FF "вход оси AX_0FF" UBYTE CM_RAW 0 0 0 255 ECU_ADDRESS 0x20000CB2 /end MEASUREMENT
/begin MEASUREMENT AXIN_100 "вход оси AX_100" SBYTE CM_RAW 0 0 -128 127 ECU_ADDRESS 0x20000C7A /end MEASUREMENT
/begin MEASUREMENT AXIN_101 "вход оси AX_101" UWORD CM_RAW 0 0 0 65535 ECU_ADDRESS 0x2000103A /end MEASUREMENT
/begin MEASUREMENT AXIN_102 "вход оси AX_102" SBYTE CM_RAW 0 0 -128 127 ECU_ADDRESS 0x20000EA2 /end MEASUREMENT
/begin MEASUREMENT RAM_103 "RAM-величина #103" UWORD CM_RAW 0 0 0 65535 ECU_ADDRESS 0x20001E92 /end MEASUREMENT
/begin MEASUREMENT RAM_104 "RAM-величина #104" UWORD CM_RAW 0 0 0 65535 ECU_ADDRESS 0x20001E96 /end MEASUREMENT
/begin MEASUREMENT RAM_109 "RAM-величина #109" UWORD CM_RAW 0 0 0 65535 ECU_ADDRESS 0x20002E8A /end MEASUREMENT
/begin MEASUREMENT RAM_10E "RAM-величина #10E" UWORD CM_RAW 0 0 0 65535 ECU_ADDRESS 0x20001D56 /end MEASUREMENT
/begin MEASUREMENT RAM_120 "RAM-величина #120" SBYTE CM_RAW 0 0 -128 127 ECU_ADDRESS 0x20001D30 /end MEASUREMENT
/begin MEASUREMENT RAM_128 "RAM-величина #128" UWORD CM_RAW 0 0 0 65535 ECU_ADDRESS 0x2000192C /end MEASUREMENT
/begin MEASUREMENT RAM_12C "RAM-величина #12C" UWORD CM_RAW 0 0 0 65535 ECU_ADDRESS 0x20001BD2 /end MEASUREMENT
/begin MEASUREMENT RAM_136 "RAM-величина #136" UWORD CM_RAW 0 0 0 65535 ECU_ADDRESS 0x20001BFC /end MEASUREMENT
/begin MEASUREMENT RAM_137 "RAM-величина #137" UWORD CM_RAW 0 0 0 65535 ECU_ADDRESS 0x20001C0C /end MEASUREMENT
/begin MEASUREMENT RAM_14C "RAM-величина #14C" SBYTE CM_RAW 0 0 -128 127 ECU_ADDRESS 0x20001E4C /end MEASUREMENT
/begin MEASUREMENT RAM_14D "RAM-величина #14D" SBYTE CM_RAW 0 0 -128 127 ECU_ADDRESS 0x20001E60 /end MEASUREMENT
/begin MEASUREMENT RAM_14E "RAM-величина #14E" SBYTE CM_RAW 0 0 -128 127 ECU_ADDRESS 0x20001E5F /end MEASUREMENT
/begin MEASUREMENT RAM_15E "RAM-величина #15E" UWORD CM_RAW 0 0 0 65535 ECU_ADDRESS 0x20001E4A /end MEASUREMENT
/begin MEASUREMENT RAM_161 "RAM-величина #161" UWORD CM_RAW 0 0 0 65535 ECU_ADDRESS 0x2000332C /end MEASUREMENT
/begin MEASUREMENT RAM_16D "RAM-величина #16D" SLONG CM_RAW 0 0 -2.14748e+09 2.14748e+09 ECU_ADDRESS 0x200021A4 /end MEASUREMENT
/begin MEASUREMENT RAM_16E "RAM-величина #16E" SLONG CM_RAW 0 0 -2.14748e+09 2.14748e+09 ECU_ADDRESS 0x200021AC /end MEASUREMENT
/begin MEASUREMENT RAM_175 "RAM-величина #175" ULONG CM_RAW 0 0 0 4.29497e+09 ECU_ADDRESS 0x20002194 /end MEASUREMENT
/begin MEASUREMENT RAM_176 "RAM-величина #176" ULONG CM_RAW 0 0 0 4.29497e+09 ECU_ADDRESS 0x20002190 /end MEASUREMENT
/begin MEASUREMENT RAM_177 "RAM-величина #177" UWORD CM_RAW 0 0 0 65535 ECU_ADDRESS 0x20002E8C /end MEASUREMENT
/begin MEASUREMENT RAM_1A0 "RAM-величина #1A0" UWORD CM_RAW 0 0 0 65535 ECU_ADDRESS 0x20001F22 /end MEASUREMENT
/begin MEASUREMENT RAM_1A1 "RAM-величина #1A1" UWORD CM_RAW 0 0 0 65535 ECU_ADDRESS 0x20001F18 MATRIX_DIM 4 1 1 /end MEASUREMENT
/begin MEASUREMENT RAM_1B3 "RAM-величина #1B3" UWORD CM_RAW 0 0 0 65535 ECU_ADDRESS 0x20001EEC /end MEASUREMENT
/begin MEASUREMENT RAM_1DD "RAM-величина #1DD" UWORD CM_RAW 0 0 0 65535 ECU_ADDRESS 0x20001CC8 /end MEASUREMENT
/begin MEASUREMENT RAM_1F8 "RAM-величина #1F8" UWORD CM_RAW 0 0 0 65535 ECU_ADDRESS 0x20003938 MATRIX_DIM 2 1 1 /end MEASUREMENT
/begin MEASUREMENT RAM_1FD "RAM-величина #1FD" SBYTE CM_RAW 0 0 -128 127 ECU_ADDRESS 0x2000139C /end MEASUREMENT
/begin MEASUREMENT RAM_1FE "RAM-величина #1FE" SBYTE CM_RAW 0 0 -128 127 ECU_ADDRESS 0x200013D3 /end MEASUREMENT
/begin MEASUREMENT RAM_1FF "RAM-величина #1FF" SWORD CM_RAW 0 0 -32768 32767 ECU_ADDRESS 0x200013FC /end MEASUREMENT
/begin MEASUREMENT RAM_200 "RAM-величина #200" SWORD CM_RAW 0 0 -32768 32767 ECU_ADDRESS 0x20001408 /end MEASUREMENT
/begin MEASUREMENT RAM_201 "RAM-величина #201" SWORD CM_RAW 0 0 -32768 32767 ECU_ADDRESS 0x20001436 /end MEASUREMENT
/begin MEASUREMENT RAM_202 "RAM-величина #202" SBYTE CM_RAW 0 0 -128 127 ECU_ADDRESS 0x20001374 /end MEASUREMENT
/begin MEASUREMENT RAM_203 "RAM-величина #203" SBYTE CM_RAW 0 0 -128 127 ECU_ADDRESS 0x20001390 /end MEASUREMENT
/begin MEASUREMENT RAM_204 "RAM-величина #204" SWORD CM_RAW 0 0 -32768 32767 ECU_ADDRESS 0x200013A2 /end MEASUREMENT
/begin MEASUREMENT RAM_205 "RAM-величина #205" SBYTE CM_RAW 0 0 -128 127 ECU_ADDRESS 0x200013B7 /end MEASUREMENT
/begin MEASUREMENT RAM_206 "RAM-величина #206" SBYTE CM_RAW 0 0 -128 127 ECU_ADDRESS 0x200013E8 /end MEASUREMENT
/begin MEASUREMENT RAM_207 "RAM-величина #207" SBYTE CM_RAW 0 0 -128 127 ECU_ADDRESS 0x2000140C /end MEASUREMENT
/begin MEASUREMENT RAM_208 "RAM-величина #208" SWORD CM_RAW 0 0 -32768 32767 ECU_ADDRESS 0x2000142C /end MEASUREMENT
/begin MEASUREMENT RAM_209 "RAM-величина #209" SBYTE CM_RAW 0 0 -128 127 ECU_ADDRESS 0x2000135F /end MEASUREMENT
/begin MEASUREMENT RAM_20A "RAM-величина #20A" SBYTE CM_RAW 0 0 -128 127 ECU_ADDRESS 0x200012DC /end MEASUREMENT
/begin MEASUREMENT RAM_20B "RAM-величина #20B" SBYTE CM_RAW 0 0 -128 127 ECU_ADDRESS 0x200013A4 /end MEASUREMENT
/begin MEASUREMENT RAM_20C "RAM-величина #20C" SBYTE CM_RAW 0 0 -128 127 ECU_ADDRESS 0x200013E1 /end MEASUREMENT
/begin MEASUREMENT RAM_20D "RAM-величина #20D" SBYTE CM_RAW 0 0 -128 127 ECU_ADDRESS 0x200013FB /end MEASUREMENT
/begin MEASUREMENT RAM_20E "RAM-величина #20E" SBYTE CM_RAW 0 0 -128 127 ECU_ADDRESS 0x20001410 /end MEASUREMENT
/begin MEASUREMENT RAM_20F "RAM-величина #20F" SBYTE CM_RAW 0 0 -128 127 ECU_ADDRESS 0x20001411 /end MEASUREMENT
/begin MEASUREMENT RAM_210 "RAM-величина #210" SBYTE CM_RAW 0 0 -128 127 ECU_ADDRESS 0x20001412 /end MEASUREMENT
/begin MEASUREMENT RAM_211 "RAM-величина #211" SWORD CM_RAW 0 0 -32768 32767 ECU_ADDRESS 0x20001414 /end MEASUREMENT
/begin MEASUREMENT RAM_212 "RAM-величина #212" SBYTE CM_RAW 0 0 -128 127 ECU_ADDRESS 0x20001416 /end MEASUREMENT
/begin MEASUREMENT RAM_213 "RAM-величина #213" SBYTE CM_RAW 0 0 -128 127 ECU_ADDRESS 0x20001452 /end MEASUREMENT
/begin MEASUREMENT RAM_214 "RAM-величина #214" SBYTE CM_RAW 0 0 -128 127 ECU_ADDRESS 0x20001392 /end MEASUREMENT
/begin MEASUREMENT RAM_215 "RAM-величина #215" SBYTE CM_RAW 0 0 -128 127 ECU_ADDRESS 0x20001396 /end MEASUREMENT
/begin MEASUREMENT RAM_216 "RAM-величина #216" SBYTE CM_RAW 0 0 -128 127 ECU_ADDRESS 0x200013F4 /end MEASUREMENT
/begin MEASUREMENT RAM_217 "RAM-величина #217" SBYTE CM_RAW 0 0 -128 127 ECU_ADDRESS 0x20001435 /end MEASUREMENT
/begin MEASUREMENT RAM_218 "RAM-величина #218" SWORD CM_RAW 0 0 -32768 32767 ECU_ADDRESS 0x20001356 /end MEASUREMENT
/begin MEASUREMENT RAM_219 "RAM-величина #219" SBYTE CM_RAW 0 0 -128 127 ECU_ADDRESS 0x20001364 /end MEASUREMENT
/begin MEASUREMENT RAM_21A "RAM-величина #21A" SBYTE CM_RAW 0 0 -128 127 ECU_ADDRESS 0x20001365 /end MEASUREMENT
/begin MEASUREMENT RAM_21B "RAM-величина #21B" SBYTE CM_RAW 0 0 -128 127 ECU_ADDRESS 0x200013F7 /end MEASUREMENT
/begin MEASUREMENT RAM_21C "RAM-величина #21C" SBYTE CM_RAW 0 0 -128 127 ECU_ADDRESS 0x200013F8 /end MEASUREMENT
/begin MEASUREMENT RAM_21D "RAM-величина #21D" SBYTE CM_RAW 0 0 -128 127 ECU_ADDRESS 0x2000140E /end MEASUREMENT
/begin MEASUREMENT RAM_21E "RAM-величина #21E" SBYTE CM_RAW 0 0 -128 127 ECU_ADDRESS 0x2000143A /end MEASUREMENT
/begin MEASUREMENT RAM_21F "RAM-величина #21F" SWORD CM_RAW 0 0 -32768 32767 ECU_ADDRESS 0x2000143C /end MEASUREMENT
/begin MEASUREMENT RAM_220 "RAM-величина #220" SBYTE CM_RAW 0 0 -128 127 ECU_ADDRESS 0x2000143B /end MEASUREMENT
/begin MEASUREMENT RAM_221 "RAM-величина #221" SBYTE CM_RAW 0 0 -128 127 ECU_ADDRESS 0x2000143E /end MEASUREMENT
/begin MEASUREMENT RAM_222 "RAM-величина #222" SBYTE CM_RAW 0 0 -128 127 ECU_ADDRESS 0x20001442 /end MEASUREMENT
/begin MEASUREMENT RAM_223 "RAM-величина #223" SBYTE CM_RAW 0 0 -128 127 ECU_ADDRESS 0x20001443 /end MEASUREMENT
/begin MEASUREMENT RAM_224 "RAM-величина #224" SBYTE CM_RAW 0 0 -128 127 ECU_ADDRESS 0x20001444 /end MEASUREMENT
/begin MEASUREMENT RAM_225 "RAM-величина #225" SBYTE CM_RAW 0 0 -128 127 ECU_ADDRESS 0x200013AB /end MEASUREMENT
/begin MEASUREMENT RAM_226 "RAM-величина #226" SWORD CM_RAW 0 0 -32768 32767 ECU_ADDRESS 0x20001440 /end MEASUREMENT
/begin MEASUREMENT RAM_227 "RAM-величина #227" SBYTE CM_RAW 0 0 -128 127 ECU_ADDRESS 0x2000141C /end MEASUREMENT
/begin MEASUREMENT RAM_228 "RAM-величина #228" SBYTE CM_RAW 0 0 -128 127 ECU_ADDRESS 0x2000141D /end MEASUREMENT
/begin MEASUREMENT RAM_229 "RAM-величина #229" SWORD CM_RAW 0 0 -32768 32767 ECU_ADDRESS 0x200014B6 /end MEASUREMENT
/begin MEASUREMENT RAM_22A "RAM-величина #22A" SWORD CM_RAW 0 0 -32768 32767 ECU_ADDRESS 0x200014B8 /end MEASUREMENT
/begin MEASUREMENT RAM_22B "RAM-величина #22B" SBYTE CM_RAW 0 0 -128 127 ECU_ADDRESS 0x20001323 /end MEASUREMENT
/begin MEASUREMENT RAM_22C "RAM-величина #22C" SBYTE CM_RAW 0 0 -128 127 ECU_ADDRESS 0x200013A5 /end MEASUREMENT
/begin MEASUREMENT RAM_22D "RAM-величина #22D" SBYTE CM_RAW 0 0 -128 127 ECU_ADDRESS 0x200013A6 /end MEASUREMENT
/begin MEASUREMENT RAM_22E "RAM-величина #22E" SBYTE CM_RAW 0 0 -128 127 ECU_ADDRESS 0x200013AA /end MEASUREMENT
/begin MEASUREMENT RAM_22F "RAM-величина #22F" SBYTE CM_RAW 0 0 -128 127 ECU_ADDRESS 0x200013B5 /end MEASUREMENT
/begin MEASUREMENT RAM_230 "RAM-величина #230" SBYTE CM_RAW 0 0 -128 127 ECU_ADDRESS 0x200013EC /end MEASUREMENT
/begin MEASUREMENT RAM_231 "RAM-величина #231" SBYTE CM_RAW 0 0 -128 127 ECU_ADDRESS 0x200014C1 /end MEASUREMENT
/begin MEASUREMENT RAM_232 "RAM-величина #232" SBYTE CM_RAW 0 0 -128 127 ECU_ADDRESS 0x200012B6 /end MEASUREMENT
/begin MEASUREMENT RAM_233 "RAM-величина #233" SBYTE CM_RAW 0 0 -128 127 ECU_ADDRESS 0x200012B9 /end MEASUREMENT
/begin MEASUREMENT RAM_234 "RAM-величина #234" SWORD CM_RAW 0 0 -32768 32767 ECU_ADDRESS 0x200012BE /end MEASUREMENT
/begin MEASUREMENT RAM_235 "RAM-величина #235" SBYTE CM_RAW 0 0 -128 127 ECU_ADDRESS 0x200012D0 /end MEASUREMENT
/begin MEASUREMENT RAM_236 "RAM-величина #236" SBYTE CM_RAW 0 0 -128 127 ECU_ADDRESS 0x2000138D /end MEASUREMENT
/begin MEASUREMENT RAM_237 "RAM-величина #237" SBYTE CM_RAW 0 0 -128 127 ECU_ADDRESS 0x200013A0 /end MEASUREMENT
/begin MEASUREMENT RAM_238 "RAM-величина #238" SBYTE CM_RAW 0 0 -128 127 ECU_ADDRESS 0x20001375 /end MEASUREMENT
/begin MEASUREMENT RAM_239 "RAM-величина #239" SBYTE CM_RAW 0 0 -128 127 ECU_ADDRESS 0x20001393 /end MEASUREMENT
/begin MEASUREMENT RAM_23A "RAM-величина #23A" SBYTE CM_RAW 0 0 -128 127 ECU_ADDRESS 0x20001394 /end MEASUREMENT
/begin MEASUREMENT RAM_23B "RAM-величина #23B" SBYTE CM_RAW 0 0 -128 127 ECU_ADDRESS 0x2000137A /end MEASUREMENT
/begin MEASUREMENT RAM_23C "RAM-величина #23C" SBYTE CM_RAW 0 0 -128 127 ECU_ADDRESS 0x20001395 /end MEASUREMENT
/begin MEASUREMENT RAM_23D "RAM-величина #23D" SBYTE CM_RAW 0 0 -128 127 ECU_ADDRESS 0x200013D9 /end MEASUREMENT
/begin MEASUREMENT RAM_23E "RAM-величина #23E" SWORD CM_RAW 0 0 -32768 32767 ECU_ADDRESS 0x20001422 /end MEASUREMENT
/begin MEASUREMENT RAM_23F "RAM-величина #23F" SWORD CM_RAW 0 0 -32768 32767 ECU_ADDRESS 0x2000142E /end MEASUREMENT
/begin MEASUREMENT RAM_240 "RAM-величина #240" SBYTE CM_RAW 0 0 -128 127 ECU_ADDRESS 0x2000146E /end MEASUREMENT
/begin MEASUREMENT RAM_241 "RAM-величина #241" SWORD CM_RAW 0 0 -32768 32767 ECU_ADDRESS 0x2000139A /end MEASUREMENT
/begin MEASUREMENT RAM_242 "RAM-величина #242" SWORD CM_RAW 0 0 -32768 32767 ECU_ADDRESS 0x20001400 /end MEASUREMENT
/begin MEASUREMENT RAM_243 "RAM-величина #243" SWORD CM_RAW 0 0 -32768 32767 ECU_ADDRESS 0x200013CE /end MEASUREMENT
/begin MEASUREMENT RAM_244 "RAM-величина #244" SWORD CM_RAW 0 0 -32768 32767 ECU_ADDRESS 0x20001468 /end MEASUREMENT
/begin MEASUREMENT RAM_245 "RAM-величина #245" SBYTE CM_RAW 0 0 -128 127 ECU_ADDRESS 0x200012E4 /end MEASUREMENT
/begin MEASUREMENT RAM_246 "RAM-величина #246" SBYTE CM_RAW 0 0 -128 127 ECU_ADDRESS 0x200012E7 /end MEASUREMENT
/begin MEASUREMENT RAM_247 "RAM-величина #247" SBYTE CM_RAW 0 0 -128 127 ECU_ADDRESS 0x20001344 /end MEASUREMENT
/begin MEASUREMENT RAM_248 "RAM-величина #248" SBYTE CM_RAW 0 0 -128 127 ECU_ADDRESS 0x20001345 /end MEASUREMENT
/begin MEASUREMENT RAM_249 "RAM-величина #249" SBYTE CM_RAW 0 0 -128 127 ECU_ADDRESS 0x200013AD /end MEASUREMENT
/begin MEASUREMENT RAM_24A "RAM-величина #24A" SBYTE CM_RAW 0 0 -128 127 ECU_ADDRESS 0x200013BD /end MEASUREMENT
/begin MEASUREMENT RAM_24B "RAM-величина #24B" SBYTE CM_RAW 0 0 -128 127 ECU_ADDRESS 0x200013BF /end MEASUREMENT
/begin MEASUREMENT RAM_24C "RAM-величина #24C" SBYTE CM_RAW 0 0 -128 127 ECU_ADDRESS 0x200013BB /end MEASUREMENT
/begin MEASUREMENT RAM_24D "RAM-величина #24D" SBYTE CM_RAW 0 0 -128 127 ECU_ADDRESS 0x200013E5 /end MEASUREMENT
/begin MEASUREMENT RAM_24E "RAM-величина #24E" SBYTE CM_RAW 0 0 -128 127 ECU_ADDRESS 0x200013E2 /end MEASUREMENT
/begin MEASUREMENT RAM_24F "RAM-величина #24F" SBYTE CM_RAW 0 0 -128 127 ECU_ADDRESS 0x200013E3 /end MEASUREMENT
/begin MEASUREMENT RAM_250 "RAM-величина #250" SBYTE CM_RAW 0 0 -128 127 ECU_ADDRESS 0x200013E4 /end MEASUREMENT
/begin MEASUREMENT RAM_26D "RAM-величина #26D" ULONG CM_RAW 0 0 0 4.29497e+09 ECU_ADDRESS 0x2000287C /end MEASUREMENT
/begin MEASUREMENT RAM_28D "RAM-величина #28D" SBYTE CM_RAW 0 0 -128 127 ECU_ADDRESS 0x2000286C /end MEASUREMENT
/begin MEASUREMENT RAM_28E "RAM-величина #28E" SBYTE CM_RAW 0 0 -128 127 ECU_ADDRESS 0x200028A8 /end MEASUREMENT
/begin MEASUREMENT RAM_2A2 "RAM-величина #2A2" SLONG CM_RAW 0 0 -2.14748e+09 2.14748e+09 ECU_ADDRESS 0x20001DA8 /end MEASUREMENT
/begin MEASUREMENT RAM_2A3 "RAM-величина #2A3" UWORD CM_RAW 0 0 0 65535 ECU_ADDRESS 0x20001DAE /end MEASUREMENT
/begin MEASUREMENT RAM_2A8 "RAM-величина #2A8" SBYTE CM_RAW 0 0 -128 127 ECU_ADDRESS 0x20002BCF /end MEASUREMENT
/begin MEASUREMENT RAM_2A9 "RAM-величина #2A9" SBYTE CM_RAW 0 0 -128 127 ECU_ADDRESS 0x20002BA3 /end MEASUREMENT
/begin MEASUREMENT RAM_2AA "RAM-величина #2AA" SBYTE CM_RAW 0 0 -128 127 ECU_ADDRESS 0x20002BA4 /end MEASUREMENT
/begin MEASUREMENT RAM_2AB "RAM-величина #2AB" SBYTE CM_RAW 0 0 -128 127 ECU_ADDRESS 0x20002BB1 /end MEASUREMENT
/begin MEASUREMENT RAM_2AC "RAM-величина #2AC" SBYTE CM_RAW 0 0 -128 127 ECU_ADDRESS 0x20002BB2 /end MEASUREMENT
/begin MEASUREMENT RAM_2AD "RAM-величина #2AD" SBYTE CM_RAW 0 0 -128 127 ECU_ADDRESS 0x20002BA1 /end MEASUREMENT
/begin MEASUREMENT RAM_2AE "RAM-величина #2AE" SBYTE CM_RAW 0 0 -128 127 ECU_ADDRESS 0x20002BB3 /end MEASUREMENT
/begin MEASUREMENT RAM_2AF "RAM-величина #2AF" SBYTE CM_RAW 0 0 -128 127 ECU_ADDRESS 0x20002BB7 /end MEASUREMENT
/begin MEASUREMENT RAM_2B0 "RAM-величина #2B0" SBYTE CM_RAW 0 0 -128 127 ECU_ADDRESS 0x20002BB8 /end MEASUREMENT
/begin MEASUREMENT RAM_2B1 "RAM-величина #2B1" SBYTE CM_RAW 0 0 -128 127 ECU_ADDRESS 0x20002BB9 /end MEASUREMENT
/begin MEASUREMENT RAM_2B2 "RAM-величина #2B2" SBYTE CM_RAW 0 0 -128 127 ECU_ADDRESS 0x20002BBA /end MEASUREMENT
/begin MEASUREMENT RAM_2B3 "RAM-величина #2B3" SBYTE CM_RAW 0 0 -128 127 ECU_ADDRESS 0x20002BBB /end MEASUREMENT
/begin MEASUREMENT RAM_2B4 "RAM-величина #2B4" SBYTE CM_RAW 0 0 -128 127 ECU_ADDRESS 0x20002BCB /end MEASUREMENT
/begin MEASUREMENT RAM_2B5 "RAM-величина #2B5" SBYTE CM_RAW 0 0 -128 127 ECU_ADDRESS 0x20002BD7 /end MEASUREMENT
/begin MEASUREMENT RAM_2B6 "RAM-величина #2B6" SBYTE CM_RAW 0 0 -128 127 ECU_ADDRESS 0x20002BA7 /end MEASUREMENT
/begin MEASUREMENT RAM_2B7 "RAM-величина #2B7" SBYTE CM_RAW 0 0 -128 127 ECU_ADDRESS 0x20002BAC /end MEASUREMENT
/begin MEASUREMENT RAM_2B8 "RAM-величина #2B8" SBYTE CM_RAW 0 0 -128 127 ECU_ADDRESS 0x20002BA9 /end MEASUREMENT
/begin MEASUREMENT RAM_2B9 "RAM-величина #2B9" SBYTE CM_RAW 0 0 -128 127 ECU_ADDRESS 0x20002BAB /end MEASUREMENT
/begin MEASUREMENT RAM_2BA "RAM-величина #2BA" SBYTE CM_RAW 0 0 -128 127 ECU_ADDRESS 0x20002B9F /end MEASUREMENT
/begin MEASUREMENT RAM_2BB "RAM-величина #2BB" SBYTE CM_RAW 0 0 -128 127 ECU_ADDRESS 0x20002BA0 /end MEASUREMENT
/begin MEASUREMENT RAM_2BC "RAM-величина #2BC" SBYTE CM_RAW 0 0 -128 127 ECU_ADDRESS 0x20002BA2 /end MEASUREMENT
/begin MEASUREMENT RAM_2BD "RAM-величина #2BD" SBYTE CM_RAW 0 0 -128 127 ECU_ADDRESS 0x20002BA5 /end MEASUREMENT
/begin MEASUREMENT RAM_2BE "RAM-величина #2BE" SBYTE CM_RAW 0 0 -128 127 ECU_ADDRESS 0x20002BAD /end MEASUREMENT
/begin MEASUREMENT RAM_2BF "RAM-величина #2BF" SBYTE CM_RAW 0 0 -128 127 ECU_ADDRESS 0x20002BAF /end MEASUREMENT
/begin MEASUREMENT RAM_2C0 "RAM-величина #2C0" SBYTE CM_RAW 0 0 -128 127 ECU_ADDRESS 0x20002BB4 /end MEASUREMENT
/begin MEASUREMENT RAM_2C1 "RAM-величина #2C1" SBYTE CM_RAW 0 0 -128 127 ECU_ADDRESS 0x20002BB5 /end MEASUREMENT
/begin MEASUREMENT RAM_2C2 "RAM-величина #2C2" SBYTE CM_RAW 0 0 -128 127 ECU_ADDRESS 0x20002BBD /end MEASUREMENT
/begin MEASUREMENT RAM_2C3 "RAM-величина #2C3" SBYTE CM_RAW 0 0 -128 127 ECU_ADDRESS 0x20002BBC /end MEASUREMENT
/begin MEASUREMENT RAM_2C4 "RAM-величина #2C4" SBYTE CM_RAW 0 0 -128 127 ECU_ADDRESS 0x20002BBE /end MEASUREMENT
/begin MEASUREMENT RAM_2C5 "RAM-величина #2C5" SBYTE CM_RAW 0 0 -128 127 ECU_ADDRESS 0x20002BBF /end MEASUREMENT
/begin MEASUREMENT RAM_2C6 "RAM-величина #2C6" SBYTE CM_RAW 0 0 -128 127 ECU_ADDRESS 0x20002BC2 /end MEASUREMENT
/begin MEASUREMENT RAM_2C7 "RAM-величина #2C7" SBYTE CM_RAW 0 0 -128 127 ECU_ADDRESS 0x20002BC3 /end MEASUREMENT
/begin MEASUREMENT RAM_2C8 "RAM-величина #2C8" SBYTE CM_RAW 0 0 -128 127 ECU_ADDRESS 0x20002BC4 /end MEASUREMENT
/begin MEASUREMENT RAM_2C9 "RAM-величина #2C9" SBYTE CM_RAW 0 0 -128 127 ECU_ADDRESS 0x20002BC8 /end MEASUREMENT
/begin MEASUREMENT RAM_2CA "RAM-величина #2CA" SBYTE CM_RAW 0 0 -128 127 ECU_ADDRESS 0x20002BC9 /end MEASUREMENT
/begin MEASUREMENT RAM_2CB "RAM-величина #2CB" SBYTE CM_RAW 0 0 -128 127 ECU_ADDRESS 0x20002BCC /end MEASUREMENT
/begin MEASUREMENT RAM_2CC "RAM-величина #2CC" SBYTE CM_RAW 0 0 -128 127 ECU_ADDRESS 0x20002BCD /end MEASUREMENT
/begin MEASUREMENT RAM_2CD "RAM-величина #2CD" SBYTE CM_RAW 0 0 -128 127 ECU_ADDRESS 0x20002BD1 /end MEASUREMENT
/begin MEASUREMENT RAM_2CE "RAM-величина #2CE" SBYTE CM_RAW 0 0 -128 127 ECU_ADDRESS 0x20002BD3 /end MEASUREMENT
/begin MEASUREMENT RAM_2CF "RAM-величина #2CF" SBYTE CM_RAW 0 0 -128 127 ECU_ADDRESS 0x20002BD4 /end MEASUREMENT
/begin MEASUREMENT RAM_2D0 "RAM-величина #2D0" SBYTE CM_RAW 0 0 -128 127 ECU_ADDRESS 0x20002BD5 /end MEASUREMENT
/begin MEASUREMENT RAM_2D1 "RAM-величина #2D1" SBYTE CM_RAW 0 0 -128 127 ECU_ADDRESS 0x20002BDA /end MEASUREMENT
/begin MEASUREMENT RAM_2D2 "RAM-величина #2D2" SBYTE CM_RAW 0 0 -128 127 ECU_ADDRESS 0x20002BDC /end MEASUREMENT
/begin MEASUREMENT RAM_2D3 "RAM-величина #2D3" SBYTE CM_RAW 0 0 -128 127 ECU_ADDRESS 0x20002BDE /end MEASUREMENT
/begin MEASUREMENT RAM_2D4 "RAM-величина #2D4" SBYTE CM_RAW 0 0 -128 127 ECU_ADDRESS 0x20002BE0 /end MEASUREMENT
/begin MEASUREMENT RAM_2D5 "RAM-величина #2D5" SBYTE CM_RAW 0 0 -128 127 ECU_ADDRESS 0x20002BE2 /end MEASUREMENT
/begin MEASUREMENT RAM_2D6 "RAM-величина #2D6" SBYTE CM_RAW 0 0 -128 127 ECU_ADDRESS 0x20002BE4 /end MEASUREMENT
/begin MEASUREMENT RAM_2D7 "RAM-величина #2D7" SBYTE CM_RAW 0 0 -128 127 ECU_ADDRESS 0x20002BE6 /end MEASUREMENT
/begin MEASUREMENT RAM_2D8 "RAM-величина #2D8" SBYTE CM_RAW 0 0 -128 127 ECU_ADDRESS 0x20002BE8 /end MEASUREMENT
/begin MEASUREMENT RAM_2D9 "RAM-величина #2D9" SBYTE CM_RAW 0 0 -128 127 ECU_ADDRESS 0x20002BEA /end MEASUREMENT
/begin MEASUREMENT RAM_2DA "RAM-величина #2DA" SBYTE CM_RAW 0 0 -128 127 ECU_ADDRESS 0x20002BEC /end MEASUREMENT
/begin MEASUREMENT RAM_2DB "RAM-величина #2DB" SBYTE CM_RAW 0 0 -128 127 ECU_ADDRESS 0x20002BDB /end MEASUREMENT
/begin MEASUREMENT RAM_2DC "RAM-величина #2DC" SBYTE CM_RAW 0 0 -128 127 ECU_ADDRESS 0x20002BDD /end MEASUREMENT
/begin MEASUREMENT RAM_2DD "RAM-величина #2DD" SBYTE CM_RAW 0 0 -128 127 ECU_ADDRESS 0x20002BDF /end MEASUREMENT
/begin MEASUREMENT RAM_2DE "RAM-величина #2DE" SBYTE CM_RAW 0 0 -128 127 ECU_ADDRESS 0x20002BE1 /end MEASUREMENT
/begin MEASUREMENT RAM_2DF "RAM-величина #2DF" SBYTE CM_RAW 0 0 -128 127 ECU_ADDRESS 0x20002BE3 /end MEASUREMENT
/begin MEASUREMENT RAM_2E0 "RAM-величина #2E0" SBYTE CM_RAW 0 0 -128 127 ECU_ADDRESS 0x20002BE5 /end MEASUREMENT
/begin MEASUREMENT RAM_2E1 "RAM-величина #2E1" SBYTE CM_RAW 0 0 -128 127 ECU_ADDRESS 0x20002BE7 /end MEASUREMENT
/begin MEASUREMENT RAM_2E2 "RAM-величина #2E2" SBYTE CM_RAW 0 0 -128 127 ECU_ADDRESS 0x20002BE9 /end MEASUREMENT
/begin MEASUREMENT RAM_2E3 "RAM-величина #2E3" SBYTE CM_RAW 0 0 -128 127 ECU_ADDRESS 0x20002BEB /end MEASUREMENT
/begin MEASUREMENT RAM_2E4 "RAM-величина #2E4" SBYTE CM_RAW 0 0 -128 127 ECU_ADDRESS 0x20002BAE /end MEASUREMENT
/begin MEASUREMENT RAM_2E5 "RAM-величина #2E5" SBYTE CM_RAW 0 0 -128 127 ECU_ADDRESS 0x20002BB0 /end MEASUREMENT
/begin MEASUREMENT RAM_2E6 "RAM-величина #2E6" SBYTE CM_RAW 0 0 -128 127 ECU_ADDRESS 0x20002BB6 /end MEASUREMENT
/begin MEASUREMENT RAM_2E7 "RAM-величина #2E7" SBYTE CM_RAW 0 0 -128 127 ECU_ADDRESS 0x20002BC0 /end MEASUREMENT
/begin MEASUREMENT RAM_2E8 "RAM-величина #2E8" SBYTE CM_RAW 0 0 -128 127 ECU_ADDRESS 0x20002BC7 /end MEASUREMENT
/begin MEASUREMENT RAM_2E9 "RAM-величина #2E9" SBYTE CM_RAW 0 0 -128 127 ECU_ADDRESS 0x20002BCE /end MEASUREMENT
/begin MEASUREMENT RAM_2EA "RAM-величина #2EA" SBYTE CM_RAW 0 0 -128 127 ECU_ADDRESS 0x20002BD0 /end MEASUREMENT
/begin MEASUREMENT RAM_2EB "RAM-величина #2EB" SBYTE CM_RAW 0 0 -128 127 ECU_ADDRESS 0x20002BA8 /end MEASUREMENT
/begin MEASUREMENT RAM_2EC "RAM-величина #2EC" SBYTE CM_RAW 0 0 -128 127 ECU_ADDRESS 0x20002BAA /end MEASUREMENT
/begin MEASUREMENT RAM_2EE "RAM-величина #2EE" SBYTE CM_RAW 0 0 -128 127 ECU_ADDRESS 0x20002BA6 /end MEASUREMENT
/begin MEASUREMENT RAM_2EF "RAM-величина #2EF" SBYTE CM_RAW 0 0 -128 127 ECU_ADDRESS 0x20002BC1 /end MEASUREMENT
/begin MEASUREMENT RAM_2F0 "RAM-величина #2F0" SBYTE CM_RAW 0 0 -128 127 ECU_ADDRESS 0x20002BC5 /end MEASUREMENT
/begin MEASUREMENT RAM_2F1 "RAM-величина #2F1" SBYTE CM_RAW 0 0 -128 127 ECU_ADDRESS 0x20002BC6 /end MEASUREMENT
/begin MEASUREMENT RAM_2F2 "RAM-величина #2F2" SBYTE CM_RAW 0 0 -128 127 ECU_ADDRESS 0x20002BD6 /end MEASUREMENT
/begin MEASUREMENT RAM_2F3 "RAM-величина #2F3" SBYTE CM_RAW 0 0 -128 127 ECU_ADDRESS 0x20002BED /end MEASUREMENT
/begin MEASUREMENT RAM_2F4 "RAM-величина #2F4" SBYTE CM_RAW 0 0 -128 127 ECU_ADDRESS 0x20002BEE /end MEASUREMENT
/begin MEASUREMENT RAM_2FC "RAM-величина #2FC" UWORD CM_RAW 0 0 0 65535 ECU_ADDRESS 0x20002EE4 /end MEASUREMENT
/begin MEASUREMENT RAM_31C "RAM-величина #31C" UWORD CM_RAW 0 0 0 65535 ECU_ADDRESS 0x200035BC /end MEASUREMENT
/begin MEASUREMENT RAM_31F "RAM-величина #31F" SBYTE CM_RAW 0 0 -128 127 ECU_ADDRESS 0x20003235 /end MEASUREMENT
/begin MEASUREMENT RAM_329 "RAM-величина #329" SBYTE CM_RAW 0 0 -128 127 ECU_ADDRESS 0x2000360F /end MEASUREMENT
/begin MEASUREMENT RAM_331 "RAM-величина #331" SBYTE CM_RAW 0 0 -128 127 ECU_ADDRESS 0x20002BD8 /end MEASUREMENT
/begin MEASUREMENT RAM_332 "RAM-величина #332" SBYTE CM_RAW 0 0 -128 127 ECU_ADDRESS 0x20002BCA /end MEASUREMENT
/begin MEASUREMENT RAM_333 "RAM-величина #333" SBYTE CM_RAW 0 0 -128 127 ECU_ADDRESS 0x20002BD9 /end MEASUREMENT
/begin MEASUREMENT RAM_334 "RAM-величина #334" SBYTE CM_RAW 0 0 -128 127 ECU_ADDRESS 0x20002BD2 /end MEASUREMENT
/begin MEASUREMENT RAM_33A "RAM-величина #33A" SBYTE CM_RAW 0 0 -128 127 ECU_ADDRESS 0x20001094 /end MEASUREMENT
/begin MEASUREMENT RAM_33B "RAM-величина #33B" SBYTE CM_RAW 0 0 -128 127 ECU_ADDRESS 0x200010A0 /end MEASUREMENT
/begin MEASUREMENT RAM_35B "RAM-величина #35B" UWORD CM_RAW 0 0 0 65535 ECU_ADDRESS 0x2000107E /end MEASUREMENT
/begin MEASUREMENT RAM_36A "RAM-величина #36A" UWORD CM_RAW 0 0 0 65535 ECU_ADDRESS 0x200010DE /end MEASUREMENT
/begin MEASUREMENT RAM_37A "RAM-величина #37A" UWORD CM_RAW 0 0 0 65535 ECU_ADDRESS 0x20001264 /end MEASUREMENT
/begin MEASUREMENT RAM_40D "RAM-величина #40D" ULONG CM_RAW 0 0 0 4.29497e+09 ECU_ADDRESS 0x2000104C MATRIX_DIM 6 1 1 /end MEASUREMENT
/begin MEASUREMENT RAM_40E "RAM-величина #40E" SWORD CM_RAW 0 0 -32768 32767 ECU_ADDRESS 0x20001068 MATRIX_DIM 6 1 1 /end MEASUREMENT
/begin MEASUREMENT RAM_42F "RAM-величина #42F" UWORD CM_RAW 0 0 0 65535 ECU_ADDRESS 0x20002F68 /end MEASUREMENT
/begin MEASUREMENT RAM_472 "RAM-величина #472" UWORD CM_RAW 0 0 0 65535 ECU_ADDRESS 0x20001136 /end MEASUREMENT
/begin MEASUREMENT RAM_473 "RAM-величина #473" UWORD CM_RAW 0 0 0 65535 ECU_ADDRESS 0x20001122 /end MEASUREMENT
/begin MEASUREMENT RAM_474 "RAM-величина #474" UWORD CM_RAW 0 0 0 65535 ECU_ADDRESS 0x20001174 /end MEASUREMENT
/begin MEASUREMENT RAM_475 "RAM-величина #475" UWORD CM_RAW 0 0 0 65535 ECU_ADDRESS 0x20001178 /end MEASUREMENT
/begin MEASUREMENT RAM_4D0 "RAM-величина #4D0" SBYTE CM_RAW 0 0 -128 127 ECU_ADDRESS 0x2000185A /end MEASUREMENT
/begin MEASUREMENT RAM_4D7 "RAM-величина #4D7" SLONG CM_RAW 0 0 -2.14748e+09 2.14748e+09 ECU_ADDRESS 0x200016D8 /end MEASUREMENT
/begin MEASUREMENT RAM_4D8 "RAM-величина #4D8" SLONG CM_RAW 0 0 -2.14748e+09 2.14748e+09 ECU_ADDRESS 0x200016DC /end MEASUREMENT
/begin MEASUREMENT RAM_4D9 "RAM-величина #4D9" SBYTE CM_RAW 0 0 -128 127 ECU_ADDRESS 0x200016F8 MATRIX_DIM 2 1 1 /end MEASUREMENT
/begin MEASUREMENT RAM_4DA "RAM-величина #4DA" SBYTE CM_RAW 0 0 -128 127 ECU_ADDRESS 0x200016F4 MATRIX_DIM 2 1 1 /end MEASUREMENT
/begin MEASUREMENT RAM_4DB "RAM-величина #4DB" SBYTE CM_RAW 0 0 -128 127 ECU_ADDRESS 0x20001724 MATRIX_DIM 2 1 1 /end MEASUREMENT
/begin MEASUREMENT RAM_50D "RAM-величина #50D" SBYTE CM_RAW 0 0 -128 127 ECU_ADDRESS 0x20003877 /end MEASUREMENT
/begin MEASUREMENT RAM_53D "RAM-величина #53D" UWORD CM_RAW 0 0 0 65535 ECU_ADDRESS 0x20001EFC /end MEASUREMENT
/begin MEASUREMENT RAM_5AD "RAM-величина #5AD" UBYTE CM_RAW 0 0 0 255 ECU_ADDRESS 0x20001E70 /end MEASUREMENT
/begin MEASUREMENT RAM_5AE "RAM-величина #5AE" SBYTE CM_RAW 0 0 -128 127 ECU_ADDRESS 0x20001E6B /end MEASUREMENT
/begin MEASUREMENT RAM_5EC "RAM-величина #5EC" SBYTE CM_RAW 0 0 -128 127 ECU_ADDRESS 0x2000224A /end MEASUREMENT
/begin MEASUREMENT RAM_5ED "RAM-величина #5ED" SBYTE CM_RAW 0 0 -128 127 ECU_ADDRESS 0x20002280 /end MEASUREMENT
/begin MEASUREMENT RAM_5EE "RAM-величина #5EE" SBYTE CM_RAW 0 0 -128 127 ECU_ADDRESS 0x20002283 /end MEASUREMENT
/begin MEASUREMENT RAM_5EF "RAM-величина #5EF" SBYTE CM_RAW 0 0 -128 127 ECU_ADDRESS 0x20002286 /end MEASUREMENT
/begin MEASUREMENT RAM_5F0 "RAM-величина #5F0" SWORD CM_RAW 0 0 -32768 32767 ECU_ADDRESS 0x20002292 /end MEASUREMENT
/begin MEASUREMENT RAM_61D "RAM-величина #61D" SWORD CM_RAW 0 0 -32768 32767 ECU_ADDRESS 0x20002294 /end MEASUREMENT
/begin MEASUREMENT RAM_61E "RAM-величина #61E" SWORD CM_RAW 0 0 -32768 32767 ECU_ADDRESS 0x20002296 /end MEASUREMENT
/begin MEASUREMENT RAM_622 "RAM-величина #622" SBYTE CM_RAW 0 0 -128 127 ECU_ADDRESS 0x200032C0 /end MEASUREMENT
/begin MEASUREMENT RAM_623 "RAM-величина #623" UWORD CM_RAW 0 0 0 65535 ECU_ADDRESS 0x200032CE /end MEASUREMENT
/begin MEASUREMENT RAM_624 "RAM-величина #624" ULONG CM_RAW 0 0 0 4.29497e+09 ECU_ADDRESS 0x20003290 /end MEASUREMENT
/begin MEASUREMENT RAM_651 "RAM-величина #651" SBYTE CM_RAW 0 0 -128 127 ECU_ADDRESS 0x2000327A /end MEASUREMENT
/begin MEASUREMENT RAM_652 "RAM-величина #652" SBYTE CM_RAW 0 0 -128 127 ECU_ADDRESS 0x2000327B /end MEASUREMENT
/begin MEASUREMENT RAM_653 "RAM-величина #653" SBYTE CM_RAW 0 0 -128 127 ECU_ADDRESS 0x2000327C /end MEASUREMENT
/begin MEASUREMENT RAM_669 "RAM-величина #669" SBYTE CM_RAW 0 0 -128 127 ECU_ADDRESS 0x200034D4 /end MEASUREMENT
/begin MEASUREMENT RAM_66A "RAM-величина #66A" SBYTE CM_RAW 0 0 -128 127 ECU_ADDRESS 0x200034E0 /end MEASUREMENT
/begin MEASUREMENT RAM_66C "RAM-величина #66C" SBYTE CM_RAW 0 0 -128 127 ECU_ADDRESS 0x200034D3 /end MEASUREMENT
/begin MEASUREMENT RAM_66D "RAM-величина #66D" SBYTE CM_RAW 0 0 -128 127 ECU_ADDRESS 0x200034E3 /end MEASUREMENT
/begin MEASUREMENT RAM_66F "RAM-величина #66F" SBYTE CM_RAW 0 0 -128 127 ECU_ADDRESS 0x200034EC /end MEASUREMENT
/begin MEASUREMENT RAM_675 "RAM-величина #675" UWORD CM_RAW 0 0 0 65535 ECU_ADDRESS 0x200034DE /end MEASUREMENT
/begin MEASUREMENT RAM_6B0 "RAM-величина #6B0" SBYTE CM_RAW 0 0 -128 127 ECU_ADDRESS 0x200036CD /end MEASUREMENT
/begin MEASUREMENT RAM_764 "RAM-величина #764" SBYTE CM_RAW 0 0 -128 127 ECU_ADDRESS 0x2000394A /end MEASUREMENT
/begin MEASUREMENT RAM_765 "RAM-величина #765" SBYTE CM_RAW 0 0 -128 127 ECU_ADDRESS 0x2000395C /end MEASUREMENT
/begin MEASUREMENT RAM_768 "RAM-величина #768" UWORD CM_RAW 0 0 0 65535 ECU_ADDRESS 0x2000395E /end MEASUREMENT
/begin MEASUREMENT RAM_769 "RAM-величина #769" SBYTE CM_RAW 0 0 -128 127 ECU_ADDRESS 0x2000394F /end MEASUREMENT
/begin MEASUREMENT RAM_76B "RAM-величина #76B" SBYTE CM_RAW 0 0 -128 127 ECU_ADDRESS 0x20003950 /end MEASUREMENT
/begin MEASUREMENT RAM_76D "RAM-величина #76D" SBYTE CM_RAW 0 0 -128 127 ECU_ADDRESS 0x20003951 /end MEASUREMENT
/begin MEASUREMENT RAM_76F "RAM-величина #76F" SBYTE CM_RAW 0 0 -128 127 ECU_ADDRESS 0x20003952 /end MEASUREMENT
/begin MEASUREMENT RAM_774 "RAM-величина #774" SBYTE CM_RAW 0 0 -128 127 ECU_ADDRESS 0x20002B98 /end MEASUREMENT
/begin MEASUREMENT RAM_77D "RAM-величина #77D" SLONG CM_RAW 0 0 -2.14748e+09 2.14748e+09 ECU_ADDRESS 0x200016E4 /end MEASUREMENT
/begin MEASUREMENT RAM_781 "RAM-величина #781" SBYTE CM_RAW 0 0 -128 127 ECU_ADDRESS 0x20003503 /end MEASUREMENT
/begin MEASUREMENT RAM_78C "RAM-величина #78C" SBYTE CM_RAW 0 0 -128 127 ECU_ADDRESS 0x2000144A /end MEASUREMENT
/begin MEASUREMENT RAM_78D "RAM-величина #78D" SBYTE CM_RAW 0 0 -128 127 ECU_ADDRESS 0x20001379 /end MEASUREMENT
/begin MEASUREMENT RAM_795 "RAM-величина #795" SBYTE CM_RAW 0 0 -128 127 ECU_ADDRESS 0x20001E21 /end MEASUREMENT
/begin MEASUREMENT RAM_796 "RAM-величина #796" SBYTE CM_RAW 0 0 -128 127 ECU_ADDRESS 0x20001E24 /end MEASUREMENT
/begin MEASUREMENT RAM_797 "RAM-величина #797" SBYTE CM_RAW 0 0 -128 127 ECU_ADDRESS 0x20001E26 /end MEASUREMENT
/begin MEASUREMENT RAM_798 "RAM-величина #798" SBYTE CM_RAW 0 0 -128 127 ECU_ADDRESS 0x20001E28 /end MEASUREMENT
/begin MEASUREMENT RAM_7DB "RAM-величина #7DB" SBYTE CM_RAW 0 0 -128 127 ECU_ADDRESS 0x20002F34 MATRIX_DIM 4 1 1 /end MEASUREMENT
/begin MEASUREMENT RAM_802 "RAM-величина #802" SBYTE CM_RAW 0 0 -128 127 ECU_ADDRESS 0x20003E64 MATRIX_DIM 4 1 1 /end MEASUREMENT
/begin MEASUREMENT RAM_86F "RAM-величина #86F" SBYTE CM_RAW 0 0 -128 127 ECU_ADDRESS 0x200022D8 MATRIX_DIM 10 1 1 /end MEASUREMENT
/begin MEASUREMENT RAM_870 "RAM-величина #870" SBYTE CM_RAW 0 0 -128 127 ECU_ADDRESS 0x2000236C MATRIX_DIM 7 1 1 /end MEASUREMENT
/begin MEASUREMENT RAM_871 "RAM-величина #871" SBYTE CM_RAW 0 0 -128 127 ECU_ADDRESS 0x20002378 MATRIX_DIM 7 1 1 /end MEASUREMENT
/begin MEASUREMENT RAM_872 "RAM-величина #872" SBYTE CM_RAW 0 0 -128 127 ECU_ADDRESS 0x20002380 MATRIX_DIM 7 1 1 /end MEASUREMENT
/begin MEASUREMENT RAM_873 "RAM-величина #873" SBYTE CM_RAW 0 0 -128 127 ECU_ADDRESS 0x200023A8 MATRIX_DIM 17 1 1 /end MEASUREMENT
/begin MEASUREMENT RAM_892 "RAM-величина #892" SBYTE CM_RAW 0 0 -128 127 ECU_ADDRESS 0x20001E1C MATRIX_DIM 2 1 1 /end MEASUREMENT
/begin MEASUREMENT RAM_8B9 "RAM-величина #8B9" SBYTE CM_RAW 0 0 -128 127 ECU_ADDRESS 0x20003918 MATRIX_DIM 10 1 1 /end MEASUREMENT
/begin MEASUREMENT RAM_8BA "RAM-величина #8BA" SBYTE CM_RAW 0 0 -128 127 ECU_ADDRESS 0x200038B0 MATRIX_DIM 7 1 1 /end MEASUREMENT
/begin MEASUREMENT RAM_8BB "RAM-величина #8BB" SBYTE CM_RAW 0 0 -128 127 ECU_ADDRESS 0x2000388C MATRIX_DIM 7 1 1 /end MEASUREMENT
/begin MEASUREMENT RAM_8CF "RAM-величина #8CF" SBYTE CM_RAW 0 0 -128 127 ECU_ADDRESS 0x20002C54 MATRIX_DIM 2 1 1 /end MEASUREMENT
/begin MEASUREMENT RAM_8E3 "RAM-величина #8E3" SBYTE CM_RAW 0 0 -128 127 ECU_ADDRESS 0x20002F0C /end MEASUREMENT
/begin MEASUREMENT RAM_8E5 "RAM-величина #8E5" SWORD CM_RAW 0 0 -32768 32767 ECU_ADDRESS 0x20001F6C MATRIX_DIM 8 1 1 /end MEASUREMENT
/begin MEASUREMENT RAM_8E9 "RAM-величина #8E9" SWORD CM_RAW 0 0 -32768 32767 ECU_ADDRESS 0x20002310 MATRIX_DIM 11 1 1 /end MEASUREMENT
/begin MEASUREMENT RAM_8EA "RAM-величина #8EA" SLONG CM_RAW 0 0 -2.14748e+09 2.14748e+09 ECU_ADDRESS 0x20003958 /end MEASUREMENT
/begin MEASUREMENT RAM_8F4 "RAM-величина #8F4" SBYTE CM_RAW 0 0 -128 127 ECU_ADDRESS 0x20001E20 /end MEASUREMENT
/begin MEASUREMENT RAM_8F5 "RAM-величина #8F5" SBYTE CM_RAW 0 0 -128 127 ECU_ADDRESS 0x20001E23 /end MEASUREMENT
/begin MEASUREMENT RAM_8F6 "RAM-величина #8F6" SBYTE CM_RAW 0 0 -128 127 ECU_ADDRESS 0x20001E25 /end MEASUREMENT
/begin MEASUREMENT RAM_8F7 "RAM-величина #8F7" SBYTE CM_RAW 0 0 -128 127 ECU_ADDRESS 0x20001E27 /end MEASUREMENT
/begin MEASUREMENT RAM_8FD "RAM-величина #8FD" SBYTE CM_RAW 0 0 -128 127 ECU_ADDRESS 0x20002387 /end MEASUREMENT
/begin MEASUREMENT RAM_8FE "RAM-величина #8FE" SWORD CM_RAW 0 0 -32768 32767 ECU_ADDRESS 0x2000238A /end MEASUREMENT
/begin MEASUREMENT RAM_8FF "RAM-величина #8FF" SLONG CM_RAW 0 0 -2.14748e+09 2.14748e+09 ECU_ADDRESS 0x200023C0 /end MEASUREMENT
/begin MEASUREMENT RAM_900 "RAM-величина #900" SWORD CM_RAW 0 0 -32768 32767 ECU_ADDRESS 0x200023BA /end MEASUREMENT
/begin MEASUREMENT RAM_901 "RAM-величина #901" SWORD CM_RAW 0 0 -32768 32767 ECU_ADDRESS 0x200023BC /end MEASUREMENT
/begin MEASUREMENT RAM_917 "RAM-величина #917" UWORD CM_RAW 0 0 0 65535 ECU_ADDRESS 0x20001E06 /end MEASUREMENT
/begin MEASUREMENT RAM_944 "RAM-величина #944" UWORD CM_RAW 0 0 0 65535 ECU_ADDRESS 0x20001BFA /end MEASUREMENT
/begin MEASUREMENT RAM_945 "RAM-величина #945" UWORD CM_RAW 0 0 0 65535 ECU_ADDRESS 0x20001C0A /end MEASUREMENT
/begin MEASUREMENT RAM_94C "RAM-величина #94C" SBYTE CM_RAW 0 0 -128 127 ECU_ADDRESS 0x20003544 MATRIX_DIM 16 1 1 /end MEASUREMENT
/begin MEASUREMENT RAM_94D "RAM-величина #94D" ULONG CM_RAW 0 0 0 4.29497e+09 ECU_ADDRESS 0x2000356C MATRIX_DIM 16 1 1 /end MEASUREMENT
/begin MEASUREMENT RAM_950 "RAM-величина #950" SBYTE CM_RAW 0 0 -128 127 ECU_ADDRESS 0x200034F1 /end MEASUREMENT
/begin MEASUREMENT RAM_981 "RAM-величина #981" SLONG CM_RAW 0 0 -2.14748e+09 2.14748e+09 ECU_ADDRESS 0x200016E0 /end MEASUREMENT
/begin MEASUREMENT RAM_995 "RAM-величина #995" SBYTE CM_RAW 0 0 -128 127 ECU_ADDRESS 0x20001E7C /end MEASUREMENT
/begin MEASUREMENT RAM_999 "RAM-величина #999" UWORD CM_RAW 0 0 0 65535 ECU_ADDRESS 0x20001E44 /end MEASUREMENT
/begin MEASUREMENT RAM_99F "RAM-величина #99F" SBYTE CM_RAW 0 0 -128 127 ECU_ADDRESS 0x20001E8C /end MEASUREMENT
/begin MEASUREMENT RAM_9AE "RAM-величина #9AE" SBYTE CM_RAW 0 0 -128 127 ECU_ADDRESS 0x20003234 /end MEASUREMENT
/begin MEASUREMENT RAM_9B2 "RAM-величина #9B2" SBYTE CM_RAW 0 0 -128 127 ECU_ADDRESS 0x20003B92 /end MEASUREMENT
/begin MEASUREMENT RAM_9B4 "RAM-величина #9B4" SBYTE CM_RAW 0 0 -128 127 ECU_ADDRESS 0x200014F4 /end MEASUREMENT
/begin MEASUREMENT RAM_9BB "RAM-величина #9BB" SLONG CM_RAW 0 0 -2.14748e+09 2.14748e+09 ECU_ADDRESS 0x20001DA4 /end MEASUREMENT
/begin MEASUREMENT RAM_9BC "RAM-величина #9BC" UWORD CM_RAW 0 0 0 65535 ECU_ADDRESS 0x20003D6E /end MEASUREMENT
/begin MEASUREMENT RAM_9BF "RAM-величина #9BF" SBYTE CM_RAW 0 0 -128 127 ECU_ADDRESS 0x2000329D /end MEASUREMENT
/begin MEASUREMENT RAM_9C5 "RAM-величина #9C5" SBYTE CM_RAW 0 0 -128 127 ECU_ADDRESS 0x20004038 /end MEASUREMENT
/begin MEASUREMENT RAM_9C6 "RAM-величина #9C6" UWORD CM_RAW 0 0 0 65535 ECU_ADDRESS 0x20001CC6 /end MEASUREMENT
/begin MEASUREMENT N_ENG "обороты двигателя" SWORD CM_RPM2 0 0 -16384 16383.5 ECU_ADDRESS 0x20003D30 /end MEASUREMENT
/begin MEASUREMENT T_COOL "температура двигателя (ОЖ), вероятно" SWORD CM_C128 0 0 -256 255.992 ECU_ADDRESS 0x20003BEE /end MEASUREMENT
/begin MEASUREMENT PEDAL_POS "положение педали газа" SWORD CM_P128 0 0 -256 255.992 ECU_ADDRESS 0x2000112C /end MEASUREMENT
/begin AXIS_PTS AX_000 "ось #000" 0x08060508 AXIN_000 RL_AX_UWORD_17 0 CM_RAW 17 0 65535 /end AXIS_PTS
/begin AXIS_PTS AX_001_N "ось #001, обороты двигателя [да (60e6/период в 0x1FD40; единица 0,5 об/мин — вероятно)]" 0x080614B4 AXIN_001_N RL_AX_UWORD_17 0 CM_RPM2 17 0 32767.5 /end AXIS_PTS
/begin AXIS_PTS AX_002_TAIR "ось #002, температура воздуха на впуске, АЦП канал 8 [вероятно]" 0x08061580 AXIN_002_TAIR RL_AX_SWORD_16 0 CM_C128 16 -256 255.992 /end AXIS_PTS
/begin AXIS_PTS AX_003_UBAT "ось #003, напряжение бортсети? (масштаб не установлен) [вероятно]" 0x08061108 AXIN_003_UBAT RL_AX_UWORD_14 0 CM_RAW 14 0 65535 /end AXIS_PTS
/begin AXIS_PTS AX_004_TCOOL "ось #004, температура двигателя (ОЖ), АЦП канал 9 [вероятно]" 0x08061220 AXIN_004_TCOOL RL_AX_SWORD_16 0 CM_C128 16 -256 255.992 /end AXIS_PTS
/begin AXIS_PTS AX_005_N "ось #005, обороты двигателя [да (60e6/период в 0x1FD40; единица 0,5 об/мин — вероятно)]" 0x080613EC AXIN_005_N RL_AX_UWORD_24 0 CM_RPM2 24 0 32767.5 /end AXIS_PTS
/begin AXIS_PTS AX_007 "ось #007" 0x0806036C AXIN_007 RL_AX_SBYTE_4 0 CM_RAW 4 -128 127 /end AXIS_PTS
/begin AXIS_PTS AX_008 "ось #008" 0x08060370 AXIN_008 RL_AX_SBYTE_3 0 CM_RAW 3 -128 127 /end AXIS_PTS
/begin AXIS_PTS AX_009 "ось #009" 0x08061100 AXIN_009 RL_AX_UWORD_3 0 CM_RAW 3 0 65535 /end AXIS_PTS
/begin AXIS_PTS AX_00A_TCOOL "ось #00A, температура двигателя (ОЖ), АЦП канал 9 [вероятно]" 0x0806120C AXIN_00A_TCOOL RL_AX_SWORD_9 0 CM_C128 9 -256 255.992 /end AXIS_PTS
/begin AXIS_PTS AX_00B "ось #00B" 0x080612B0 AXIN_00B RL_AX_UWORD_9 0 CM_RAW 9 0 65535 /end AXIS_PTS
/begin AXIS_PTS AX_00C_N "ось #00C, обороты двигателя [да (60e6/период в 0x1FD40; единица 0,5 об/мин — вероятно)]" 0x08061454 AXIN_00C_N RL_AX_UWORD_10 0 CM_RPM2 10 0 32767.5 /end AXIS_PTS
/begin AXIS_PTS AX_00D "ось #00D" 0x08060238 AXIN_00D RL_AX_UWORD_17 0 CM_RAW 17 0 65535 /end AXIS_PTS
/begin AXIS_PTS AX_00E "ось #00E" 0x08060A78 AXIN_00E RL_AX_UWORD_21 0 CM_RAW 21 0 65535 /end AXIS_PTS
/begin AXIS_PTS AX_00F "ось #00F" 0x08060270 AXIN_00F RL_AX_UWORD_16 0 CM_RAW 16 0 65535 /end AXIS_PTS
/begin AXIS_PTS AX_011 "ось #011" 0x080614E8 AXIN_011 RL_AX_UWORD_6 0 CM_RAW 6 0 65535 /end AXIS_PTS
/begin AXIS_PTS AX_012 "ось #012" 0x08061354 AXIN_012 RL_AX_UWORD_16 0 CM_RAW 16 0 65535 /end AXIS_PTS
/begin AXIS_PTS AX_014 "ось #014" 0x080602E0 AXIN_014 RL_AX_UWORD_12 0 CM_RAW 12 0 65535 /end AXIS_PTS
/begin AXIS_PTS AX_015 "ось #015" 0x080602F8 AXIN_015 RL_AX_UWORD_12 0 CM_RAW 12 0 65535 /end AXIS_PTS
/begin AXIS_PTS AX_016 "ось #016" 0x08060310 AXIN_016 RL_AX_UWORD_16 0 CM_RAW 16 0 65535 /end AXIS_PTS
/begin AXIS_PTS AX_017 "ось #017" 0x08060350 AXIN_017 RL_AX_UWORD_10 0 CM_RAW 10 0 65535 /end AXIS_PTS
/begin AXIS_PTS AX_018 "ось #018" 0x08060330 AXIN_018 RL_AX_UWORD_4 0 CM_RAW 4 0 65535 /end AXIS_PTS
/begin AXIS_PTS AX_019 "ось #019" 0x08060338 AXIN_019 RL_AX_UWORD_12 0 CM_RAW 12 0 65535 /end AXIS_PTS
/begin AXIS_PTS AX_01A_TCOOL "ось #01A, температура двигателя (ОЖ), АЦП канал 9 [вероятно]" 0x0806119C AXIN_01A_TCOOL RL_AX_SWORD_32 0 CM_C128 32 -256 255.992 /end AXIS_PTS
/begin AXIS_PTS AX_01B_PEDAL "ось #01B, положение педали газа [да]" 0x080610D4 AXIN_01B_PEDAL RL_AX_UWORD_16 0 CM_P128 16 0 511.992 /end AXIS_PTS
/begin AXIS_PTS AX_01C "ось #01C" 0x080604D4 AXIN_01C RL_AX_SBYTE_7 0 CM_RAW 7 -128 127 /end AXIS_PTS
/begin AXIS_PTS AX_01D "ось #01D" 0x080604DC AXIN_01D RL_AX_SBYTE_3 0 CM_RAW 3 -128 127 /end AXIS_PTS
/begin AXIS_PTS AX_01E_LOAD "ось #01E, нагрузка / наполнение (0x3C28 / 0x3C30 / 0x3C34), масштаб не установлен [вероятно]" 0x08061264 AXIN_01E_LOAD RL_AX_UWORD_10 0 CM_RAW 10 0 65535 /end AXIS_PTS
/begin AXIS_PTS AX_01F "ось #01F" 0x080604CC AXIN_01F RL_AX_UWORD_3 0 CM_RAW 3 0 65535 /end AXIS_PTS
/begin AXIS_PTS AX_020 "ось #020" 0x08060AA4 AXIN_020 RL_AX_UWORD_3 0 CM_RAW 3 0 65535 /end AXIS_PTS
/begin AXIS_PTS AX_021 "ось #021" 0x08060AE0 AXIN_021 RL_AX_UWORD_31 0 CM_RAW 31 0 65535 /end AXIS_PTS
/begin AXIS_PTS AX_022 "ось #022" 0x08060B40 AXIN_022 RL_AX_UWORD_16 0 CM_RAW 16 0 65535 /end AXIS_PTS
/begin AXIS_PTS AX_023 "ось #023" 0x0806063C AXIN_023 RL_AX_UWORD_12 0 CM_RAW 12 0 65535 /end AXIS_PTS
/begin AXIS_PTS AX_025_N "ось #025, обороты двигателя [да (60e6/период в 0x1FD40; единица 0,5 об/мин — вероятно)]" 0x08060654 AXIN_025_N RL_AX_UWORD_24 0 CM_RPM2 24 0 32767.5 /end AXIS_PTS
/begin AXIS_PTS AX_027_N "ось #027, обороты двигателя [да (60e6/период в 0x1FD40; единица 0,5 об/мин — вероятно)]" 0x080606EC AXIN_027_N RL_AX_UWORD_14 0 CM_RPM2 14 0 32767.5 /end AXIS_PTS
/begin AXIS_PTS AX_02A "ось #02A" 0x08060398 AXIN_02A RL_AX_UWORD_6 0 CM_RAW 6 0 65535 /end AXIS_PTS
/begin AXIS_PTS AX_02B "ось #02B" 0x080603B0 AXIN_02B RL_AX_UWORD_6 0 CM_RAW 6 0 65535 /end AXIS_PTS
/begin AXIS_PTS AX_02C "ось #02C" 0x080603A4 AXIN_02C RL_AX_UWORD_5 0 CM_RAW 5 0 65535 /end AXIS_PTS
/begin AXIS_PTS AX_02D "ось #02D" 0x080603D8 AXIN_02D RL_AX_UWORD_7 0 CM_RAW 7 0 65535 /end AXIS_PTS
/begin AXIS_PTS AX_02E "ось #02E" 0x080603CC AXIN_02E RL_AX_UWORD_5 0 CM_RAW 5 0 65535 /end AXIS_PTS
/begin AXIS_PTS AX_02F "ось #02F" 0x080603BC AXIN_02F RL_AX_UWORD_7 0 CM_RAW 7 0 65535 /end AXIS_PTS
/begin AXIS_PTS AX_030_N "ось #030, обороты двигателя [да (60e6/период в 0x1FD40; единица 0,5 об/мин — вероятно)]" 0x080603E8 AXIN_030_N RL_AX_UWORD_8 0 CM_RPM2 8 0 32767.5 /end AXIS_PTS
/begin AXIS_PTS AX_031_TAIR "ось #031, температура воздуха на впуске, АЦП канал 8 [вероятно]" 0x080603F8 AXIN_031_TAIR RL_AX_SWORD_3 0 CM_C128 3 -256 255.992 /end AXIS_PTS
/begin AXIS_PTS AX_032 "ось #032" 0x08060400 AXIN_032 RL_AX_UWORD_6 0 CM_RAW 6 0 65535 /end AXIS_PTS
/begin AXIS_PTS AX_034_LOAD "ось #034, нагрузка / наполнение (0x3C28 / 0x3C30 / 0x3C34), масштаб не установлен [вероятно]" 0x0806053C AXIN_034_LOAD RL_AX_UWORD_17 0 CM_RAW 17 0 65535 /end AXIS_PTS
/begin AXIS_PTS AX_035_LOAD "ось #035, нагрузка / наполнение (0x3C28 / 0x3C30 / 0x3C34), масштаб не установлен [вероятно]" 0x08060560 AXIN_035_LOAD RL_AX_UWORD_8 0 CM_RAW 8 0 65535 /end AXIS_PTS
/begin AXIS_PTS AX_037 "ось #037" 0x08060590 AXIN_037 RL_AX_UWORD_31 0 CM_RAW 31 0 65535 /end AXIS_PTS
/begin AXIS_PTS AX_038_N "ось #038, обороты двигателя [да (60e6/период в 0x1FD40; единица 0,5 об/мин — вероятно)]" 0x080605D0 AXIN_038_N RL_AX_UWORD_17 0 CM_RPM2 17 0 32767.5 /end AXIS_PTS
/begin AXIS_PTS AX_039_LOAD "ось #039, нагрузка / наполнение (0x3C28 / 0x3C30 / 0x3C34), масштаб не установлен [вероятно]" 0x08060714 AXIN_039_LOAD RL_AX_UWORD_9 0 CM_RAW 9 0 65535 /end AXIS_PTS
/begin AXIS_PTS AX_03A_N "ось #03A, обороты двигателя [да (60e6/период в 0x1FD40; единица 0,5 об/мин — вероятно)]" 0x08060728 AXIN_03A_N RL_AX_UWORD_24 0 CM_RPM2 24 0 32767.5 /end AXIS_PTS
/begin AXIS_PTS AX_03B_N "ось #03B, обороты двигателя [да (60e6/период в 0x1FD40; единица 0,5 об/мин — вероятно)]" 0x08060758 AXIN_03B_N RL_AX_UWORD_60 0 CM_RPM2 60 0 32767.5 /end AXIS_PTS
/begin AXIS_PTS AX_03C_N "ось #03C, обороты двигателя [да (60e6/период в 0x1FD40; единица 0,5 об/мин — вероятно)]" 0x08061078 AXIN_03C_N RL_AX_UWORD_17 0 CM_RPM2 17 0 32767.5 /end AXIS_PTS
/begin AXIS_PTS AX_03D_LOAD "ось #03D, нагрузка / наполнение (0x3C28 / 0x3C30 / 0x3C34), масштаб не установлен [вероятно]" 0x08061054 AXIN_03D_LOAD RL_AX_UWORD_17 0 CM_RAW 17 0 65535 /end AXIS_PTS
/begin AXIS_PTS AX_03E_N "ось #03E, обороты двигателя [да (60e6/период в 0x1FD40; единица 0,5 об/мин — вероятно)]" 0x08060FCC AXIN_03E_N RL_AX_UWORD_17 0 CM_RPM2 17 0 32767.5 /end AXIS_PTS
/begin AXIS_PTS AX_03F_LOAD "ось #03F, нагрузка / наполнение (0x3C28 / 0x3C30 / 0x3C34), масштаб не установлен [вероятно]" 0x08060FA8 AXIN_03F_LOAD RL_AX_UWORD_17 0 CM_RAW 17 0 65535 /end AXIS_PTS
/begin AXIS_PTS AX_040 "ось #040" 0x08060FF0 AXIN_040 RL_AX_UWORD_27 0 CM_RAW 27 0 65535 /end AXIS_PTS
/begin AXIS_PTS AX_041 "ось #041" 0x08060F94 AXIN_041 RL_AX_UWORD_10 0 CM_RAW 10 0 65535 /end AXIS_PTS
/begin AXIS_PTS AX_042_TAIR "ось #042, температура воздуха на впуске, АЦП канал 8 [вероятно]" 0x08060424 AXIN_042_TAIR RL_AX_SWORD_17 0 CM_C128 17 -256 255.992 /end AXIS_PTS
/begin AXIS_PTS AX_043 "ось #043, педаль 0…100 %" 0x08060BD8 AXIN_043 RL_AX_UWORD_30 0 CM_P128 30 0 511.992 /end AXIS_PTS
/begin AXIS_PTS AX_045_TCOOL "ось #045, температура двигателя (ОЖ), АЦП канал 9 [вероятно]" 0x08061188 AXIN_045_TCOOL RL_AX_SWORD_9 0 CM_C128 9 -256 255.992 /end AXIS_PTS
/begin AXIS_PTS AX_048 "ось #048" 0x08061128 AXIN_048 RL_AX_UWORD_6 0 CM_RAW 6 0 65535 /end AXIS_PTS
/begin AXIS_PTS AX_049_TAIR "ось #049, температура воздуха на впуске, АЦП канал 8 [вероятно]" 0x08061570 AXIN_049_TAIR RL_AX_SWORD_8 0 CM_C128 8 -256 255.992 /end AXIS_PTS
/begin AXIS_PTS AX_04A "ось #04A" 0x08060690 AXIN_04A RL_AX_UBYTE_26 0 CM_RAW 26 0 255 /end AXIS_PTS
/begin AXIS_PTS AX_04B_N "ось #04B, обороты двигателя [да (60e6/период в 0x1FD40; единица 0,5 об/мин — вероятно)]" 0x080607D8 AXIN_04B_N RL_AX_UWORD_8 0 CM_RPM2 8 0 32767.5 /end AXIS_PTS
/begin AXIS_PTS AX_04C_LOAD "ось #04C, нагрузка / наполнение (0x3C28 / 0x3C30 / 0x3C34), масштаб не установлен [вероятно]" 0x080607E8 AXIN_04C_LOAD RL_AX_UWORD_10 0 CM_RAW 10 0 65535 /end AXIS_PTS
/begin AXIS_PTS AX_04F "ось #04F" 0x0806046C AXIN_04F RL_AX_UWORD_3 0 CM_RAW 3 0 65535 /end AXIS_PTS
/begin AXIS_PTS AX_050_N "ось #050, обороты двигателя [да (60e6/период в 0x1FD40; единица 0,5 об/мин — вероятно)]" 0x0806141C AXIN_050_N RL_AX_UWORD_8 0 CM_RPM2 8 0 32767.5 /end AXIS_PTS
/begin AXIS_PTS AX_054 "ось #054" 0x08060260 AXIN_054 RL_AX_UWORD_8 0 CM_RAW 8 0 65535 /end AXIS_PTS
/begin AXIS_PTS AX_056_VSPEED "ось #056, скорость автомобиля [вероятно (ось 0…9600 = 0…150 км/ч при /64)]" 0x08060B6C AXIN_056_VSPEED RL_AX_UWORD_16 0 CM_KMH64 16 0 1023.98 /end AXIS_PTS
/begin AXIS_PTS AX_057_TAIR "ось #057, температура воздуха на впуске, АЦП канал 8 [вероятно]" 0x08060B8C AXIN_057_TAIR RL_AX_SWORD_9 0 CM_C128 9 -256 255.992 /end AXIS_PTS
/begin AXIS_PTS AX_058 "ось #058" 0x08060BA0 AXIN_058 RL_AX_UWORD_16 0 CM_RAW 16 0 65535 /end AXIS_PTS
/begin AXIS_PTS AX_059 "ось #059" 0x08060BC0 AXIN_059 RL_AX_UWORD_11 0 CM_RAW 11 0 65535 /end AXIS_PTS
/begin AXIS_PTS AX_05A "ось #05A" 0x08060C14 AXIN_05A RL_AX_UWORD_31 0 CM_RAW 31 0 65535 /end AXIS_PTS
/begin AXIS_PTS AX_05B "ось #05B" 0x080610BC AXIN_05B RL_AX_UWORD_12 0 CM_RAW 12 0 65535 /end AXIS_PTS
/begin AXIS_PTS AX_05E_GEAR "ось #05E, номер передачи 0…7 [вероятно]" 0x08061548 AXIN_05E_GEAR RL_AX_SBYTE_8 0 CM_RAW 8 -128 127 /end AXIS_PTS
/begin AXIS_PTS AX_05F_N "ось #05F, обороты двигателя [да (60e6/период в 0x1FD40; единица 0,5 об/мин — вероятно)]" 0x08061374 AXIN_05F_N RL_AX_UWORD_17 0 CM_RPM2 17 0 32767.5 /end AXIS_PTS
/begin AXIS_PTS AX_064 "ось #064" 0x080610F4 AXIN_064 RL_AX_UWORD_6 0 CM_RAW 6 0 65535 /end AXIS_PTS
/begin AXIS_PTS AX_06E "ось #06E" 0x080615C4 AXIN_06E RL_AX_UWORD_5 0 CM_RAW 5 0 65535 /end AXIS_PTS
/begin AXIS_PTS AX_076 "ось #076" 0x080612F4 AXIN_076 RL_AX_UWORD_18 0 CM_RAW 18 0 65535 /end AXIS_PTS
/begin AXIS_PTS AX_07D "ось #07D" 0x080615B8 AXIN_07D RL_AX_UWORD_6 0 CM_RAW 6 0 65535 /end AXIS_PTS
/begin AXIS_PTS AX_07F_LOAD "ось #07F, нагрузка / наполнение (0x3C28 / 0x3C30 / 0x3C34), масштаб не установлен [вероятно]" 0x08060494 AXIN_07F_LOAD RL_AX_UWORD_12 0 CM_RAW 12 0 65535 /end AXIS_PTS
/begin AXIS_PTS AX_080_N "ось #080, обороты двигателя [да (60e6/период в 0x1FD40; единица 0,5 об/мин — вероятно)]" 0x080604AC AXIN_080_N RL_AX_UWORD_16 0 CM_RPM2 16 0 32767.5 /end AXIS_PTS
/begin AXIS_PTS AX_08C_TCOOL "ось #08C, температура двигателя (ОЖ), АЦП канал 9 [вероятно]" 0x080611F4 AXIN_08C_TCOOL RL_AX_SWORD_11 0 CM_C128 11 -256 255.992 /end AXIS_PTS
/begin AXIS_PTS AX_08E "ось #08E" 0x080612DC AXIN_08E RL_AX_UWORD_11 0 CM_RAW 11 0 65535 /end AXIS_PTS
/begin AXIS_PTS AX_08F_TCOOL "ось #08F, температура двигателя (ОЖ), АЦП канал 9 [вероятно]" 0x080611DC AXIN_08F_TCOOL RL_AX_SWORD_11 0 CM_C128 11 -256 255.992 /end AXIS_PTS
/begin AXIS_PTS AX_090_TAIR "ось #090, температура воздуха на впуске, АЦП канал 8 [вероятно]" 0x08061550 AXIN_090_TAIR RL_AX_SWORD_16 0 CM_C128 16 -256 255.992 /end AXIS_PTS
/begin AXIS_PTS AX_093 "ось #093" 0x08060EC0 AXIN_093 RL_AX_UWORD_17 0 CM_RAW 17 0 65535 /end AXIS_PTS
/begin AXIS_PTS AX_0CD_N "ось #0CD, обороты двигателя [да (60e6/период в 0x1FD40; единица 0,5 об/мин — вероятно)]" 0x080613BC AXIN_0CD_N RL_AX_UWORD_24 0 CM_RPM2 24 0 32767.5 /end AXIS_PTS
/begin CHARACTERISTIC CAL_105 "кривая #105 17: ? [знак по значениям]" CURVE 0x08066D9C RL_FNC_SWORD 0 CM_RAW -32768 32767 /begin AXIS_DESCR COM_AXIS AXIN_000 CM_RAW 17 0 65535 AXIS_PTS_REF AX_000 /end AXIS_DESCR /end CHARACTERISTIC
/begin CHARACTERISTIC CAL_106 "массив #106" VAL_BLK 0x08066DC0 RL_FNC_UWORD 0 CM_RAW 0 65535 MATRIX_DIM 2 1 1 /end CHARACTERISTIC
/begin CHARACTERISTIC CAL_107 "значение #107" VALUE 0x08066DC6 RL_FNC_UWORD 0 CM_RAW 0 65535 /end CHARACTERISTIC
/begin CHARACTERISTIC CAL_108 "массив #108" VAL_BLK 0x08066DC8 RL_FNC_SWORD 0 CM_RAW -32768 32767 MATRIX_DIM 2 1 1 /end CHARACTERISTIC
/begin CHARACTERISTIC CAL_10A "значение #10A" VALUE 0x0806CFB4 RL_FNC_UWORD 0 CM_RAW 0 65535 /end CHARACTERISTIC
/begin CHARACTERISTIC CAL_10B "значение #10B" VALUE 0x0806CFB6 RL_FNC_UWORD 0 CM_RAW 0 65535 /end CHARACTERISTIC
/begin CHARACTERISTIC CAL_10C "значение #10C" VALUE 0x0806CFD8 RL_FNC_UWORD 0 CM_RAW 0 65535 /end CHARACTERISTIC
/begin CHARACTERISTIC CAL_10D "значение #10D" VALUE 0x0806CFDC RL_FNC_UWORD 0 CM_RAW 0 65535 /end CHARACTERISTIC
/begin CHARACTERISTIC CAL_10F "значение #10F" VALUE 0x08065A1A RL_FNC_UBYTE 0 CM_RAW 0 255 /end CHARACTERISTIC
/begin CHARACTERISTIC CAL_110 "значение #110" VALUE 0x08068F9C RL_FNC_UWORD 0 CM_RAW 0 65535 /end CHARACTERISTIC
/begin CHARACTERISTIC CAL_111 "массив #111" VAL_BLK 0x08064524 RL_FNC_UWORD 0 CM_RAW 0 65535 MATRIX_DIM 2 1 1 /end CHARACTERISTIC
/begin CHARACTERISTIC CAL_112 "значение #112" VALUE 0x080659DC RL_FNC_UWORD 0 CM_RAW 0 65535 /end CHARACTERISTIC
/begin CHARACTERISTIC CAL_113 "кривая #113 9: TCOOL" CURVE 0x080659C8 RL_FNC_UWORD 0 CM_RAW 0 65535
 /begin AXIS_DESCR COM_AXIS AXIN_00A_TCOOL CM_C128 9 -256 255.992 AXIS_PTS_REF AX_00A_TCOOL /end AXIS_DESCR
/end CHARACTERISTIC
/begin CHARACTERISTIC CAL_114 "значение #114" VALUE 0x080659DA RL_FNC_UWORD 0 CM_RAW 0 65535 /end CHARACTERISTIC
/begin CHARACTERISTIC CAL_115 "значение #115" VALUE 0x080659E0 RL_FNC_UWORD 0 CM_RAW 0 65535 /end CHARACTERISTIC
/begin CHARACTERISTIC CAL_116 "кривая #116 9: TCOOL" CURVE 0x08065960 RL_FNC_UWORD 0 CM_RAW 0 65535
 /begin AXIS_DESCR COM_AXIS AXIN_00A_TCOOL CM_C128 9 -256 255.992 AXIS_PTS_REF AX_00A_TCOOL /end AXIS_DESCR
/end CHARACTERISTIC
/begin CHARACTERISTIC CAL_117 "значение #117" VALUE 0x08065986 RL_FNC_UWORD 0 CM_RAW 0 65535 /end CHARACTERISTIC
/begin CHARACTERISTIC CAL_118_0 "кривая #118 9: TCOOL [1/2] [знак по значениям]" CURVE 0x0806585C RL_FNC_SWORD 0 CM_RAW -32768 32767
 /begin AXIS_DESCR COM_AXIS AXIN_00A_TCOOL CM_C128 9 -256 255.992 AXIS_PTS_REF AX_00A_TCOOL /end AXIS_DESCR
/end CHARACTERISTIC
/begin CHARACTERISTIC CAL_118_1 "кривая #118 9: TCOOL [2/2] [знак по значениям]" CURVE 0x0806586E RL_FNC_SWORD 0 CM_RAW -32768 32767
 /begin AXIS_DESCR COM_AXIS AXIN_00A_TCOOL CM_C128 9 -256 255.992 AXIS_PTS_REF AX_00A_TCOOL /end AXIS_DESCR
/end CHARACTERISTIC
/begin CHARACTERISTIC CAL_119 "значение #119" VALUE 0x080659B2 RL_FNC_SWORD 0 CM_RAW -32768 32767 /end CHARACTERISTIC
/begin CHARACTERISTIC CAL_11A "кривая #11A 9: TCOOL" CURVE 0x080659B4 RL_FNC_UWORD 0 CM_RAW 0 65535
 /begin AXIS_DESCR COM_AXIS AXIN_00A_TCOOL CM_C128 9 -256 255.992 AXIS_PTS_REF AX_00A_TCOOL /end AXIS_DESCR
/end CHARACTERISTIC
/begin CHARACTERISTIC CAL_11B "массив #11B [знак по значениям]" VAL_BLK 0x080657E4 RL_FNC_SWORD 0 CM_RAW -32768 32767 MATRIX_DIM 2 1 1 /end CHARACTERISTIC
/begin CHARACTERISTIC CAL_11C "значение #11C" VALUE 0x080659A8 RL_FNC_UWORD 0 CM_RAW 0 65535 /end CHARACTERISTIC
/begin CHARACTERISTIC CAL_11D "значение #11D" VALUE 0x080659DE RL_FNC_UWORD 0 CM_RAW 0 65535 /end CHARACTERISTIC
/begin CHARACTERISTIC CAL_11E "кривая #11E 9: TCOOL" CURVE 0x080659E4 RL_FNC_UWORD 0 CM_RAW 0 65535
 /begin AXIS_DESCR COM_AXIS AXIN_00A_TCOOL CM_C128 9 -256 255.992 AXIS_PTS_REF AX_00A_TCOOL /end AXIS_DESCR
/end CHARACTERISTIC
/begin CHARACTERISTIC CAL_11F "кривая #11F 9: TCOOL" CURVE 0x08065974 RL_FNC_UWORD 0 CM_RAW 0 65535
 /begin AXIS_DESCR COM_AXIS AXIN_00A_TCOOL CM_C128 9 -256 255.992 AXIS_PTS_REF AX_00A_TCOOL /end AXIS_DESCR
/end CHARACTERISTIC
/begin CHARACTERISTIC CAL_121 "карта #121 3x4: ? × ?" MAP 0x08065880 RL_FNC_SBYTE 0 CM_RAW -128 127 /begin AXIS_DESCR COM_AXIS AXIN_007 CM_RAW 4 -128 127 AXIS_PTS_REF AX_007 /end AXIS_DESCR /begin AXIS_DESCR COM_AXIS AXIN_008 CM_RAW 3 -128 127 AXIS_PTS_REF AX_008 /end AXIS_DESCR /end CHARACTERISTIC
/begin CHARACTERISTIC CAL_122 "кривая #122 16: TCOOL" CURVE 0x08065988 RL_FNC_UWORD 0 CM_RAW 0 65535
 /begin AXIS_DESCR COM_AXIS AXIN_004_TCOOL CM_C128 16 -256 255.992 AXIS_PTS_REF AX_004_TCOOL /end AXIS_DESCR
/end CHARACTERISTIC
/begin CHARACTERISTIC CAL_123_0 "кривая #123 17: N [1/2]" CURVE 0x08065814 RL_FNC_UWORD 0 CM_RAW 0 65535
 /begin AXIS_DESCR COM_AXIS AXIN_001_N CM_RPM2 17 0 32767.5 AXIS_PTS_REF AX_001_N /end AXIS_DESCR
/end CHARACTERISTIC
/begin CHARACTERISTIC CAL_123_1 "кривая #123 17: N [2/2]" CURVE 0x08065836 RL_FNC_UWORD 0 CM_RAW 0 65535
 /begin AXIS_DESCR COM_AXIS AXIN_001_N CM_RPM2 17 0 32767.5 AXIS_PTS_REF AX_001_N /end AXIS_DESCR
/end CHARACTERISTIC
/begin CHARACTERISTIC CAL_124_0 "кривая #124 17: N [1/2]" CURVE 0x0806588C RL_FNC_UWORD 0 CM_RAW 0 65535
 /begin AXIS_DESCR COM_AXIS AXIN_001_N CM_RPM2 17 0 32767.5 AXIS_PTS_REF AX_001_N /end AXIS_DESCR
/end CHARACTERISTIC
/begin CHARACTERISTIC CAL_124_1 "кривая #124 17: N [2/2]" CURVE 0x080658AE RL_FNC_UWORD 0 CM_RAW 0 65535
 /begin AXIS_DESCR COM_AXIS AXIN_001_N CM_RPM2 17 0 32767.5 AXIS_PTS_REF AX_001_N /end AXIS_DESCR
/end CHARACTERISTIC
/begin CHARACTERISTIC CAL_125_0 "кривая #125 17: N [1/2]" CURVE 0x0806591C RL_FNC_UWORD 0 CM_RAW 0 65535
 /begin AXIS_DESCR COM_AXIS AXIN_001_N CM_RPM2 17 0 32767.5 AXIS_PTS_REF AX_001_N /end AXIS_DESCR
/end CHARACTERISTIC
/begin CHARACTERISTIC CAL_125_1 "кривая #125 17: N [2/2]" CURVE 0x0806593E RL_FNC_UWORD 0 CM_RAW 0 65535
 /begin AXIS_DESCR COM_AXIS AXIN_001_N CM_RPM2 17 0 32767.5 AXIS_PTS_REF AX_001_N /end AXIS_DESCR
/end CHARACTERISTIC
/begin CHARACTERISTIC CAL_126_0 "кривая #126 17: N [1/2]" CURVE 0x080658D8 RL_FNC_UWORD 0 CM_RAW 0 65535
 /begin AXIS_DESCR COM_AXIS AXIN_001_N CM_RPM2 17 0 32767.5 AXIS_PTS_REF AX_001_N /end AXIS_DESCR
/end CHARACTERISTIC
/begin CHARACTERISTIC CAL_126_1 "кривая #126 17: N [2/2]" CURVE 0x080658FA RL_FNC_UWORD 0 CM_RAW 0 65535
 /begin AXIS_DESCR COM_AXIS AXIN_001_N CM_RPM2 17 0 32767.5 AXIS_PTS_REF AX_001_N /end AXIS_DESCR
/end CHARACTERISTIC
/begin CHARACTERISTIC CAL_127 "кривая #127 3: ?" CURVE 0x080658D0 RL_FNC_UWORD 0 CM_RAW 0 65535 /begin AXIS_DESCR COM_AXIS AXIN_009 CM_RAW 3 0 65535 AXIS_PTS_REF AX_009 /end AXIS_DESCR /end CHARACTERISTIC
/begin CHARACTERISTIC CAL_129 "кривая #129 17: ? [знак по значениям]" CURVE 0x08064430 RL_FNC_SWORD 0 CM_RAW -32768 32767 /begin AXIS_DESCR COM_AXIS AXIN_00D CM_RAW 17 0 65535 AXIS_PTS_REF AX_00D /end AXIS_DESCR /end CHARACTERISTIC
/begin CHARACTERISTIC CAL_12A "массив #12A" VAL_BLK 0x08064468 RL_FNC_SWORD 0 CM_RAW -32768 32767 MATRIX_DIM 2 1 1 /end CHARACTERISTIC
/begin CHARACTERISTIC CAL_12B "кривая #12B 6: ?" CURVE 0x0806445C RL_FNC_SWORD 0 CM_RAW -32768 32767 /begin AXIS_DESCR COM_AXIS AXIN_064 CM_RAW 6 0 65535 AXIS_PTS_REF AX_064 /end AXIS_DESCR /end CHARACTERISTIC
/begin CHARACTERISTIC CAL_12D "массив #12D" VAL_BLK 0x080649F0 RL_FNC_UWORD 0 CM_RAW 0 65535 MATRIX_DIM 2 1 1 /end CHARACTERISTIC
/begin CHARACTERISTIC CAL_12E "карта #12E 9x24: N × ?" MAP 0x08064BA4 RL_FNC_UWORD 0 CM_RAW 0 65535
 /begin AXIS_DESCR COM_AXIS AXIN_0CD_N CM_RPM2 24 0 32767.5 AXIS_PTS_REF AX_0CD_N /end AXIS_DESCR
 /begin AXIS_DESCR COM_AXIS AXIN_00B CM_RAW 9 0 65535 AXIS_PTS_REF AX_00B /end AXIS_DESCR
/end CHARACTERISTIC
/begin CHARACTERISTIC CAL_12F "значение #12F" VALUE 0x0806914A RL_FNC_UWORD 0 CM_RAW 0 65535 /end CHARACTERISTIC
/begin CHARACTERISTIC CAL_130 "массив #130" VAL_BLK 0x08069150 RL_FNC_UWORD 0 CM_RAW 0 65535 MATRIX_DIM 2 1 1 /end CHARACTERISTIC
/begin CHARACTERISTIC CAL_131 "значение #131" VALUE 0x0806914C RL_FNC_UWORD 0 CM_RAW 0 65535 /end CHARACTERISTIC
/begin CHARACTERISTIC CAL_132 "массив #132 [знак по значениям]" VAL_BLK 0x080654BC RL_FNC_SWORD 0 CM_RAW -32768 32767 MATRIX_DIM 2 1 1 /end CHARACTERISTIC
/begin CHARACTERISTIC CAL_133 "значение #133" VALUE 0x0806555C RL_FNC_UWORD 0 CM_RAW 0 65535 /end CHARACTERISTIC
/begin CHARACTERISTIC CAL_134 "значение #134" VALUE 0x08065698 RL_FNC_UWORD 0 CM_RAW 0 65535 /end CHARACTERISTIC
/begin CHARACTERISTIC CAL_135 "значение #135" VALUE 0x0806569A RL_FNC_UWORD 0 CM_RAW 0 65535 /end CHARACTERISTIC
/begin CHARACTERISTIC CAL_138 "кривая #138 16: ? [знак по значениям]" CURVE 0x08065608 RL_FNC_SWORD 0 CM_RAW -32768 32767 /begin AXIS_DESCR COM_AXIS AXIN_016 CM_RAW 16 0 65535 AXIS_PTS_REF AX_016 /end AXIS_DESCR /end CHARACTERISTIC
/begin CHARACTERISTIC CAL_139 "значение #139" VALUE 0x08065604 RL_FNC_UWORD 0 CM_RAW 0 65535 /end CHARACTERISTIC
/begin CHARACTERISTIC CAL_13A "кривая #13A 10: ? [знак по значениям]" CURVE 0x08065670 RL_FNC_SWORD 0 CM_RAW -32768 32767 /begin AXIS_DESCR COM_AXIS AXIN_017 CM_RAW 10 0 65535 AXIS_PTS_REF AX_017 /end AXIS_DESCR /end CHARACTERISTIC
/begin CHARACTERISTIC CAL_13B_0 "кривая #13B 16: ? [1/2]" CURVE 0x08065630 RL_FNC_UWORD 0 CM_RAW 0 65535 /begin AXIS_DESCR COM_AXIS AXIN_016 CM_RAW 16 0 65535 AXIS_PTS_REF AX_016 /end AXIS_DESCR /end CHARACTERISTIC
/begin CHARACTERISTIC CAL_13B_1 "кривая #13B 16: ? [2/2]" CURVE 0x08065650 RL_FNC_UWORD 0 CM_RAW 0 65535 /begin AXIS_DESCR COM_AXIS AXIN_016 CM_RAW 16 0 65535 AXIS_PTS_REF AX_016 /end AXIS_DESCR /end CHARACTERISTIC
/begin CHARACTERISTIC CAL_13C "кривая #13C 4: ? [знак по значениям]" CURVE 0x08065628 RL_FNC_SWORD 0 CM_RAW -32768 32767 /begin AXIS_DESCR COM_AXIS AXIN_018 CM_RAW 4 0 65535 AXIS_PTS_REF AX_018 /end AXIS_DESCR /end CHARACTERISTIC
/begin CHARACTERISTIC CAL_13D "кривая #13D 12: ? [знак по значениям]" CURVE 0x0806559C RL_FNC_SWORD 0 CM_RAW -32768 32767 /begin AXIS_DESCR COM_AXIS AXIN_014 CM_RAW 12 0 65535 AXIS_PTS_REF AX_014 /end AXIS_DESCR /end CHARACTERISTIC
/begin CHARACTERISTIC CAL_13E "кривая #13E 12: ?" CURVE 0x0806557C RL_FNC_UWORD 0 CM_RAW 0 65535 /begin AXIS_DESCR COM_AXIS AXIN_015 CM_RAW 12 0 65535 AXIS_PTS_REF AX_015 /end AXIS_DESCR /end CHARACTERISTIC
/begin CHARACTERISTIC CAL_13F "массив #13F" VAL_BLK 0x08065594 RL_FNC_ULONG 0 CM_RAW 0 4.29497e+09 MATRIX_DIM 2 1 1 /end CHARACTERISTIC
/begin CHARACTERISTIC CAL_140 "кривая #140 12: ? [знак по значениям]" CURVE 0x08065564 RL_FNC_SWORD 0 CM_RAW -32768 32767 /begin AXIS_DESCR COM_AXIS AXIN_019 CM_RAW 12 0 65535 AXIS_PTS_REF AX_019 /end AXIS_DESCR /end CHARACTERISTIC
/begin CHARACTERISTIC CAL_141 "кривая #141 12: ?" CURVE 0x080655D0 RL_FNC_UWORD 0 CM_RAW 0 65535 /begin AXIS_DESCR COM_AXIS AXIN_014 CM_RAW 12 0 65535 AXIS_PTS_REF AX_014 /end AXIS_DESCR /end CHARACTERISTIC
/begin CHARACTERISTIC CAL_142 "кривая #142 12: ?" CURVE 0x080655B4 RL_FNC_UWORD 0 CM_RAW 0 65535 /begin AXIS_DESCR COM_AXIS AXIN_015 CM_RAW 12 0 65535 AXIS_PTS_REF AX_015 /end AXIS_DESCR /end CHARACTERISTIC
/begin CHARACTERISTIC CAL_143 "массив #143" VAL_BLK 0x080655CC RL_FNC_UWORD 0 CM_RAW 0 65535 MATRIX_DIM 2 1 1 /end CHARACTERISTIC
/begin CHARACTERISTIC CAL_144 "кривая #144 14: UBAT" CURVE 0x080655E8 RL_FNC_UWORD 0 CM_RAW 0 65535
 /begin AXIS_DESCR COM_AXIS AXIN_003_UBAT CM_RAW 14 0 65535 AXIS_PTS_REF AX_003_UBAT /end AXIS_DESCR
/end CHARACTERISTIC
/begin CHARACTERISTIC CAL_145 "массив #145" VAL_BLK 0x08065684 RL_FNC_SBYTE 0 CM_RAW -128 127 MATRIX_DIM 2 1 1 /end CHARACTERISTIC
/begin CHARACTERISTIC CAL_146 "значение #146" VALUE 0x08065690 RL_FNC_SWORD 0 CM_RAW -32768 32767 /end CHARACTERISTIC
/begin CHARACTERISTIC CAL_147 "массив #147" VAL_BLK 0x08065694 RL_FNC_UWORD 0 CM_RAW 0 65535 MATRIX_DIM 2 1 1 /end CHARACTERISTIC
/begin CHARACTERISTIC CAL_148 "массив #148" VAL_BLK 0x0806569C RL_FNC_UWORD 0 CM_RAW 0 65535 MATRIX_DIM 2 1 1 /end CHARACTERISTIC
/begin CHARACTERISTIC CAL_149 "массив #149" VAL_BLK 0x080656A0 RL_FNC_UWORD 0 CM_RAW 0 65535 MATRIX_DIM 2 1 1 /end CHARACTERISTIC
/begin CHARACTERISTIC CAL_14A "значение #14A" VALUE 0x080657E0 RL_FNC_UWORD 0 CM_RAW 0 65535 /end CHARACTERISTIC
/begin CHARACTERISTIC CAL_14B "карта #14B 3x7: ? × ?" MAP 0x08066B1C RL_FNC_SBYTE 0 CM_RAW -128 127 /begin AXIS_DESCR COM_AXIS AXIN_01C CM_RAW 7 -128 127 AXIS_PTS_REF AX_01C /end AXIS_DESCR /begin AXIS_DESCR COM_AXIS AXIN_01D CM_RAW 3 -128 127 AXIS_PTS_REF AX_01D /end AXIS_DESCR /end CHARACTERISTIC
/begin CHARACTERISTIC CAL_14F "кривая #14F 9: TCOOL" CURVE 0x08066B34 RL_FNC_UWORD 0 CM_RAW 0 65535
 /begin AXIS_DESCR COM_AXIS AXIN_00A_TCOOL CM_C128 9 -256 255.992 AXIS_PTS_REF AX_00A_TCOOL /end AXIS_DESCR
/end CHARACTERISTIC
/begin CHARACTERISTIC CAL_150 "кривая #150 9: TCOOL" CURVE 0x08066B48 RL_FNC_UWORD 0 CM_RAW 0 65535
 /begin AXIS_DESCR COM_AXIS AXIN_00A_TCOOL CM_C128 9 -256 255.992 AXIS_PTS_REF AX_00A_TCOOL /end AXIS_DESCR
/end CHARACTERISTIC
/begin CHARACTERISTIC CAL_151 "значение #151" VALUE 0x08061C48 RL_FNC_UWORD 0 CM_RAW 0 65535 /end CHARACTERISTIC
/begin CHARACTERISTIC CAL_152_0 "кривая #152 10: N [1/2]" CURVE 0x08062480 RL_FNC_UWORD 0 CM_RAW 0 65535
 /begin AXIS_DESCR COM_AXIS AXIN_00C_N CM_RPM2 10 0 32767.5 AXIS_PTS_REF AX_00C_N /end AXIS_DESCR
/end CHARACTERISTIC
/begin CHARACTERISTIC CAL_152_1 "кривая #152 10: N [2/2]" CURVE 0x08062494 RL_FNC_UWORD 0 CM_RAW 0 65535
 /begin AXIS_DESCR COM_AXIS AXIN_00C_N CM_RPM2 10 0 32767.5 AXIS_PTS_REF AX_00C_N /end AXIS_DESCR
/end CHARACTERISTIC
/begin CHARACTERISTIC CAL_153_0 "карта #153 10x17: N × LOAD [1/2]" MAP 0x080621B0 RL_FNC_UWORD 0 CM_RAW 0 65535
 /begin AXIS_DESCR COM_AXIS AXIN_05F_N CM_RPM2 17 0 32767.5 AXIS_PTS_REF AX_05F_N /end AXIS_DESCR
 /begin AXIS_DESCR COM_AXIS AXIN_01E_LOAD CM_RAW 10 0 65535 AXIS_PTS_REF AX_01E_LOAD /end AXIS_DESCR
/end CHARACTERISTIC
/begin CHARACTERISTIC CAL_153_1 "карта #153 10x17: N × LOAD [2/2]" MAP 0x08062304 RL_FNC_UWORD 0 CM_RAW 0 65535
 /begin AXIS_DESCR COM_AXIS AXIN_05F_N CM_RPM2 17 0 32767.5 AXIS_PTS_REF AX_05F_N /end AXIS_DESCR
 /begin AXIS_DESCR COM_AXIS AXIN_01E_LOAD CM_RAW 10 0 65535 AXIS_PTS_REF AX_01E_LOAD /end AXIS_DESCR
/end CHARACTERISTIC
/begin CHARACTERISTIC CAL_154 "кривая #154 16: TCOOL" CURVE 0x08061C24 RL_FNC_UWORD 0 CM_RAW 0 65535
 /begin AXIS_DESCR COM_AXIS AXIN_004_TCOOL CM_C128 16 -256 255.992 AXIS_PTS_REF AX_004_TCOOL /end AXIS_DESCR
/end CHARACTERISTIC
/begin CHARACTERISTIC CAL_155 "кривая #155 16: TCOOL" CURVE 0x08061C04 RL_FNC_UWORD 0 CM_RAW 0 65535
 /begin AXIS_DESCR COM_AXIS AXIN_004_TCOOL CM_C128 16 -256 255.992 AXIS_PTS_REF AX_004_TCOOL /end AXIS_DESCR
/end CHARACTERISTIC
/begin CHARACTERISTIC CAL_156 "значение #156" VALUE 0x080624A8 RL_FNC_SLONG 0 CM_RAW -2.14748e+09 2.14748e+09 /end CHARACTERISTIC
/begin CHARACTERISTIC CAL_157 "карта #157 10x17: N × LOAD" MAP 0x08061A90 RL_FNC_UWORD 0 CM_RAW 0 65535
 /begin AXIS_DESCR COM_AXIS AXIN_001_N CM_RPM2 17 0 32767.5 AXIS_PTS_REF AX_001_N /end AXIS_DESCR
 /begin AXIS_DESCR COM_AXIS AXIN_01E_LOAD CM_RAW 10 0 65535 AXIS_PTS_REF AX_01E_LOAD /end AXIS_DESCR
/end CHARACTERISTIC
/begin CHARACTERISTIC CAL_158 "значение #158" VALUE 0x08061C44 RL_FNC_UWORD 0 CM_RAW 0 65535 /end CHARACTERISTIC
/begin CHARACTERISTIC CAL_159 "значение #159" VALUE 0x08061C46 RL_FNC_UWORD 0 CM_RAW 0 65535 /end CHARACTERISTIC
/begin CHARACTERISTIC CAL_15A "кривая #15A 10: N" CURVE 0x08061C4C RL_FNC_UWORD 0 CM_RAW 0 65535
 /begin AXIS_DESCR COM_AXIS AXIN_00C_N CM_RPM2 10 0 32767.5 AXIS_PTS_REF AX_00C_N /end AXIS_DESCR
/end CHARACTERISTIC
/begin CHARACTERISTIC CAL_15B_0 "карта #15B 10x17: N × LOAD [1/2]" MAP 0x08061C60 RL_FNC_UWORD 0 CM_RAW 0 65535
 /begin AXIS_DESCR COM_AXIS AXIN_05F_N CM_RPM2 17 0 32767.5 AXIS_PTS_REF AX_05F_N /end AXIS_DESCR
 /begin AXIS_DESCR COM_AXIS AXIN_01E_LOAD CM_RAW 10 0 65535 AXIS_PTS_REF AX_01E_LOAD /end AXIS_DESCR
/end CHARACTERISTIC
/begin CHARACTERISTIC CAL_15B_1 "карта #15B 10x17: N × LOAD [2/2]" MAP 0x08061DB4 RL_FNC_UWORD 0 CM_RAW 0 65535
 /begin AXIS_DESCR COM_AXIS AXIN_05F_N CM_RPM2 17 0 32767.5 AXIS_PTS_REF AX_05F_N /end AXIS_DESCR
 /begin AXIS_DESCR COM_AXIS AXIN_01E_LOAD CM_RAW 10 0 65535 AXIS_PTS_REF AX_01E_LOAD /end AXIS_DESCR
/end CHARACTERISTIC
/begin CHARACTERISTIC CAL_15C_0 "карта #15C 10x17: N × LOAD [1/2]" MAP 0x08061F08 RL_FNC_UWORD 0 CM_RAW 0 65535
 /begin AXIS_DESCR COM_AXIS AXIN_05F_N CM_RPM2 17 0 32767.5 AXIS_PTS_REF AX_05F_N /end AXIS_DESCR
 /begin AXIS_DESCR COM_AXIS AXIN_01E_LOAD CM_RAW 10 0 65535 AXIS_PTS_REF AX_01E_LOAD /end AXIS_DESCR
/end CHARACTERISTIC
/begin CHARACTERISTIC CAL_15C_1 "карта #15C 10x17: N × LOAD [2/2]" MAP 0x0806205C RL_FNC_UWORD 0 CM_RAW 0 65535
 /begin AXIS_DESCR COM_AXIS AXIN_05F_N CM_RPM2 17 0 32767.5 AXIS_PTS_REF AX_05F_N /end AXIS_DESCR
 /begin AXIS_DESCR COM_AXIS AXIN_01E_LOAD CM_RAW 10 0 65535 AXIS_PTS_REF AX_01E_LOAD /end AXIS_DESCR
/end CHARACTERISTIC
/begin CHARACTERISTIC CAL_15D "кривая #15D 3: ?" CURVE 0x08066B14 RL_FNC_UWORD 0 CM_RAW 0 65535 /begin AXIS_DESCR COM_AXIS AXIN_01F CM_RAW 3 0 65535 AXIS_PTS_REF AX_01F /end AXIS_DESCR /end CHARACTERISTIC
/begin CHARACTERISTIC CAL_15F "кривая #15F 3: ?" CURVE 0x0806EAD4 RL_FNC_UWORD 0 CM_RAW 0 65535 /begin AXIS_DESCR COM_AXIS AXIN_020 CM_RAW 3 0 65535 AXIS_PTS_REF AX_020 /end AXIS_DESCR /end CHARACTERISTIC
/begin CHARACTERISTIC CAL_160_0 "карта #160 9x6: ? × TCOOL [1/2]" MAP 0x0806EAF0 RL_FNC_UWORD 0 CM_RAW 0 65535 /begin AXIS_DESCR COM_AXIS AXIN_011 CM_RAW 6 0 65535 AXIS_PTS_REF AX_011 /end AXIS_DESCR
 /begin AXIS_DESCR COM_AXIS AXIN_00A_TCOOL CM_C128 9 -256 255.992 AXIS_PTS_REF AX_00A_TCOOL /end AXIS_DESCR
/end CHARACTERISTIC
/begin CHARACTERISTIC CAL_160_1 "карта #160 9x6: ? × TCOOL [2/2]" MAP 0x0806EB5C RL_FNC_UWORD 0 CM_RAW 0 65535 /begin AXIS_DESCR COM_AXIS AXIN_011 CM_RAW 6 0 65535 AXIS_PTS_REF AX_011 /end AXIS_DESCR
 /begin AXIS_DESCR COM_AXIS AXIN_00A_TCOOL CM_C128 9 -256 255.992 AXIS_PTS_REF AX_00A_TCOOL /end AXIS_DESCR
/end CHARACTERISTIC
/begin CHARACTERISTIC CAL_162 "карта #162 9x6: ? × TCOOL" MAP 0x0806F720 RL_FNC_UBYTE 0 CM_RAW 0 255 /begin AXIS_DESCR COM_AXIS AXIN_011 CM_RAW 6 0 65535 AXIS_PTS_REF AX_011 /end AXIS_DESCR
 /begin AXIS_DESCR COM_AXIS AXIN_00A_TCOOL CM_C128 9 -256 255.992 AXIS_PTS_REF AX_00A_TCOOL /end AXIS_DESCR
/end CHARACTERISTIC
/begin CHARACTERISTIC CAL_163 "кривая #163 16: TCOOL" CURVE 0x0806F758 RL_FNC_UWORD 0 CM_RAW 0 65535
 /begin AXIS_DESCR COM_AXIS AXIN_004_TCOOL CM_C128 16 -256 255.992 AXIS_PTS_REF AX_004_TCOOL /end AXIS_DESCR
/end CHARACTERISTIC
/begin CHARACTERISTIC CAL_164 "кривая #164 31: ?" CURVE 0x0806EBC8 RL_FNC_UWORD 0 CM_RAW 0 65535 /begin AXIS_DESCR COM_AXIS AXIN_021 CM_RAW 31 0 65535 AXIS_PTS_REF AX_021 /end AXIS_DESCR /end CHARACTERISTIC
/begin CHARACTERISTIC CAL_165 "карта #165 11x16: ? × TCOOL" MAP 0x0806EC08 RL_FNC_UWORD 0 CM_RAW 0 65535 /begin AXIS_DESCR COM_AXIS AXIN_022 CM_RAW 16 0 65535 AXIS_PTS_REF AX_022 /end AXIS_DESCR
 /begin AXIS_DESCR COM_AXIS AXIN_08C_TCOOL CM_C128 11 -256 255.992 AXIS_PTS_REF AX_08C_TCOOL /end AXIS_DESCR
/end CHARACTERISTIC
/begin CHARACTERISTIC CAL_166 "кривая #166 16: PEDAL" CURVE 0x0806ED68 RL_FNC_UWORD 0 CM_RAW 0 65535
 /begin AXIS_DESCR COM_AXIS AXIN_01B_PEDAL CM_P128 16 0 511.992 AXIS_PTS_REF AX_01B_PEDAL /end AXIS_DESCR
/end CHARACTERISTIC
/begin CHARACTERISTIC CAL_167 "кривая #167 31: ?" CURVE 0x0806ED88 RL_FNC_UWORD 0 CM_RAW 0 65535 /begin AXIS_DESCR COM_AXIS AXIN_021 CM_RAW 31 0 65535 AXIS_PTS_REF AX_021 /end AXIS_DESCR /end CHARACTERISTIC
/begin CHARACTERISTIC CAL_168 "значение #168" VALUE 0x0806F5CA RL_FNC_SBYTE 0 CM_RAW -128 127 /end CHARACTERISTIC
/begin CHARACTERISTIC CAL_169 "кривая #169 32: TCOOL" CURVE 0x0806F5CC RL_FNC_ULONG 0 CM_RAW 0 4.29497e+09
 /begin AXIS_DESCR COM_AXIS AXIN_01A_TCOOL CM_C128 32 -256 255.992 AXIS_PTS_REF AX_01A_TCOOL /end AXIS_DESCR
/end CHARACTERISTIC
/begin CHARACTERISTIC CAL_16A "кривая #16A 31: ?" CURVE 0x0806F64C RL_FNC_SBYTE 0 CM_RAW -128 127 /begin AXIS_DESCR COM_AXIS AXIN_021 CM_RAW 31 0 65535 AXIS_PTS_REF AX_021 /end AXIS_DESCR /end CHARACTERISTIC
/begin CHARACTERISTIC CAL_16B "значение #16B" VALUE 0x0806F756 RL_FNC_UWORD 0 CM_RAW 0 65535 /end CHARACTERISTIC
/begin CHARACTERISTIC CAL_16C_0 "кривая #16C 32: TCOOL [1/3]" CURVE 0x0806F778 RL_FNC_ULONG 0 CM_RAW 0 4.29497e+09
 /begin AXIS_DESCR COM_AXIS AXIN_01A_TCOOL CM_C128 32 -256 255.992 AXIS_PTS_REF AX_01A_TCOOL /end AXIS_DESCR
/end CHARACTERISTIC
/begin CHARACTERISTIC CAL_16C_1 "кривая #16C 32: TCOOL [2/3]" CURVE 0x0806F7F8 RL_FNC_ULONG 0 CM_RAW 0 4.29497e+09
 /begin AXIS_DESCR COM_AXIS AXIN_01A_TCOOL CM_C128 32 -256 255.992 AXIS_PTS_REF AX_01A_TCOOL /end AXIS_DESCR
/end CHARACTERISTIC
/begin CHARACTERISTIC CAL_16C_2 "кривая #16C 32: TCOOL [3/3]" CURVE 0x0806F878 RL_FNC_ULONG 0 CM_RAW 0 4.29497e+09
 /begin AXIS_DESCR COM_AXIS AXIN_01A_TCOOL CM_C128 32 -256 255.992 AXIS_PTS_REF AX_01A_TCOOL /end AXIS_DESCR
/end CHARACTERISTIC
/begin CHARACTERISTIC CAL_16F "кривая #16F 14: UBAT [знак по значениям]" CURVE 0x08068A88 RL_FNC_SWORD 0 CM_RAW -32768 32767
 /begin AXIS_DESCR COM_AXIS AXIN_003_UBAT CM_RAW 14 0 65535 AXIS_PTS_REF AX_003_UBAT /end AXIS_DESCR
/end CHARACTERISTIC
/begin CHARACTERISTIC CAL_170 "массив #170" VAL_BLK 0x08068AA4 RL_FNC_UWORD 0 CM_RAW 0 65535 MATRIX_DIM 4 1 1 /end CHARACTERISTIC
/begin CHARACTERISTIC CAL_171_0 "карта #171 12x24: N × ? [1/2]" MAP 0x08068AD8 RL_FNC_UWORD 0 CM_RAW 0 65535
 /begin AXIS_DESCR COM_AXIS AXIN_025_N CM_RPM2 24 0 32767.5 AXIS_PTS_REF AX_025_N /end AXIS_DESCR
 /begin AXIS_DESCR COM_AXIS AXIN_023 CM_RAW 12 0 65535 AXIS_PTS_REF AX_023 /end AXIS_DESCR
/end CHARACTERISTIC
/begin CHARACTERISTIC CAL_171_1 "карта #171 12x24: N × ? [2/2]" MAP 0x08068D18 RL_FNC_UWORD 0 CM_RAW 0 65535
 /begin AXIS_DESCR COM_AXIS AXIN_025_N CM_RPM2 24 0 32767.5 AXIS_PTS_REF AX_025_N /end AXIS_DESCR
 /begin AXIS_DESCR COM_AXIS AXIN_023 CM_RAW 12 0 65535 AXIS_PTS_REF AX_023 /end AXIS_DESCR
/end CHARACTERISTIC
/begin CHARACTERISTIC CAL_172 "кривая #172 21: ?" CURVE 0x08068AAC RL_FNC_UWORD 0 CM_RAW 0 65535 /begin AXIS_DESCR COM_AXIS AXIN_00E CM_RAW 21 0 65535 AXIS_PTS_REF AX_00E /end AXIS_DESCR /end CHARACTERISTIC
/begin CHARACTERISTIC CAL_173 "значение #173" VALUE 0x0806F5C8 RL_FNC_UWORD 0 CM_RAW 0 65535 /end CHARACTERISTIC
/begin CHARACTERISTIC CAL_174 "значение #174" VALUE 0x08068F58 RL_FNC_UWORD 0 CM_RAW 0 65535 /end CHARACTERISTIC
/begin CHARACTERISTIC CAL_178 "значение #178" VALUE 0x0807465A RL_FNC_SBYTE 0 CM_RAW -128 127 /end CHARACTERISTIC
/begin CHARACTERISTIC CAL_179 "карта #179 16x24: N × ?" MAP 0x08064D54 RL_FNC_UWORD 0 CM_RAW 0 65535
 /begin AXIS_DESCR COM_AXIS AXIN_005_N CM_RPM2 24 0 32767.5 AXIS_PTS_REF AX_005_N /end AXIS_DESCR
 /begin AXIS_DESCR COM_AXIS AXIN_00F CM_RAW 16 0 65535 AXIS_PTS_REF AX_00F /end AXIS_DESCR
/end CHARACTERISTIC
/begin CHARACTERISTIC CAL_17A "значение #17A" VALUE 0x080697AE RL_FNC_SBYTE 0 CM_RAW -128 127 /end CHARACTERISTIC
/begin CHARACTERISTIC CAL_17B "массив #17B [знак по значениям]" VAL_BLK 0x080697B0 RL_FNC_SWORD 0 CM_RAW -32768 32767 MATRIX_DIM 2 1 1 /end CHARACTERISTIC
/begin CHARACTERISTIC CAL_17C "массив #17C [знак по значениям]" VAL_BLK 0x08069714 RL_FNC_SWORD 0 CM_RAW -32768 32767 MATRIX_DIM 25 1 1 /end CHARACTERISTIC
/begin CHARACTERISTIC CAL_17D "значение #17D" VALUE 0x080697BE RL_FNC_UWORD 0 CM_RAW 0 65535 /end CHARACTERISTIC
/begin CHARACTERISTIC CAL_17E "значение #17E" VALUE 0x080697BC RL_FNC_UWORD 0 CM_RAW 0 65535 /end CHARACTERISTIC
/begin CHARACTERISTIC CAL_17F "кривая #17F 14: N" CURVE 0x080697C0 RL_FNC_SWORD 0 CM_RAW -32768 32767
 /begin AXIS_DESCR COM_AXIS AXIN_027_N CM_RPM2 14 0 32767.5 AXIS_PTS_REF AX_027_N /end AXIS_DESCR
/end CHARACTERISTIC
/begin CHARACTERISTIC CAL_180 "карта #180 6x14: N × ?" MAP 0x0806987C RL_FNC_UWORD 0 CM_RAW 0 65535
 /begin AXIS_DESCR COM_AXIS AXIN_027_N CM_RPM2 14 0 32767.5 AXIS_PTS_REF AX_027_N /end AXIS_DESCR
 /begin AXIS_DESCR COM_AXIS AXIN_07D CM_RAW 6 0 65535 AXIS_PTS_REF AX_07D /end AXIS_DESCR
/end CHARACTERISTIC
/begin CHARACTERISTIC CAL_181 "кривая #181 7: ?" CURVE 0x08065C50 RL_FNC_UWORD 0 CM_RAW 0 65535 /begin AXIS_DESCR COM_AXIS AXIN_02F CM_RAW 7 0 65535 AXIS_PTS_REF AX_02F /end AXIS_DESCR /end CHARACTERISTIC
/begin CHARACTERISTIC CAL_182 "значение #182" VALUE 0x08065C5E RL_FNC_UWORD 0 CM_RAW 0 65535 /end CHARACTERISTIC
/begin CHARACTERISTIC CAL_183 "карта #183 10x8: N × LOAD" MAP 0x08065C60 RL_FNC_UWORD 0 CM_RAW 0 65535
 /begin AXIS_DESCR COM_AXIS AXIN_030_N CM_RPM2 8 0 32767.5 AXIS_PTS_REF AX_030_N /end AXIS_DESCR
 /begin AXIS_DESCR COM_AXIS AXIN_01E_LOAD CM_RAW 10 0 65535 AXIS_PTS_REF AX_01E_LOAD /end AXIS_DESCR
/end CHARACTERISTIC
/begin CHARACTERISTIC CAL_184 "кривая #184 7: ?" CURVE 0x08065D68 RL_FNC_UWORD 0 CM_RAW 0 65535 /begin AXIS_DESCR COM_AXIS AXIN_02F CM_RAW 7 0 65535 AXIS_PTS_REF AX_02F /end AXIS_DESCR /end CHARACTERISTIC
/begin CHARACTERISTIC CAL_185 "массив #185" VAL_BLK 0x08065D54 RL_FNC_ULONG 0 CM_RAW 0 4.29497e+09 MATRIX_DIM 5 1 1 /end CHARACTERISTIC
/begin CHARACTERISTIC CAL_186 "кривая #186 3: TAIR [знак по значениям]" CURVE 0x08065D78 RL_FNC_SWORD 0 CM_RAW -32768 32767
 /begin AXIS_DESCR COM_AXIS AXIN_031_TAIR CM_C128 3 -256 255.992 AXIS_PTS_REF AX_031_TAIR /end AXIS_DESCR
/end CHARACTERISTIC
/begin CHARACTERISTIC CAL_187 "карта #187 7x6: ? × ? [знак по значениям]" MAP 0x08065D00 RL_FNC_SWORD 0 CM_RAW -32768 32767 /begin AXIS_DESCR COM_AXIS AXIN_02A CM_RAW 6 0 65535 AXIS_PTS_REF AX_02A /end AXIS_DESCR /begin AXIS_DESCR COM_AXIS AXIN_02D CM_RAW 7 0 65535 AXIS_PTS_REF AX_02D /end AXIS_DESCR /end CHARACTERISTIC
/begin CHARACTERISTIC CAL_188 "карта #188 7x6: ? × ?" MAP 0x08065DB8 RL_FNC_UWORD 0 CM_RAW 0 65535 /begin AXIS_DESCR COM_AXIS AXIN_02B CM_RAW 6 0 65535 AXIS_PTS_REF AX_02B /end AXIS_DESCR /begin AXIS_DESCR COM_AXIS AXIN_02D CM_RAW 7 0 65535 AXIS_PTS_REF AX_02D /end AXIS_DESCR /end CHARACTERISTIC
/begin CHARACTERISTIC CAL_189 "значение #189" VALUE 0x08065D90 RL_FNC_UWORD 0 CM_RAW 0 65535 /end CHARACTERISTIC
/begin CHARACTERISTIC CAL_18A "кривая #18A 6: ?" CURVE 0x08065D84 RL_FNC_UWORD 0 CM_RAW 0 65535 /begin AXIS_DESCR COM_AXIS AXIN_032 CM_RAW 6 0 65535 AXIS_PTS_REF AX_032 /end AXIS_DESCR /end CHARACTERISTIC
/begin CHARACTERISTIC CAL_18B "значение #18B" VALUE 0x08065D7E RL_FNC_UWORD 0 CM_RAW 0 65535 /end CHARACTERISTIC
/begin CHARACTERISTIC CAL_18C "значение #18C" VALUE 0x08065D80 RL_FNC_UWORD 0 CM_RAW 0 65535 /end CHARACTERISTIC
/begin CHARACTERISTIC CAL_18D "значение #18D" VALUE 0x08065D82 RL_FNC_UWORD 0 CM_RAW 0 65535 /end CHARACTERISTIC
/begin CHARACTERISTIC CAL_18E "кривая #18E 6: ?" CURVE 0x08065D94 RL_FNC_UWORD 0 CM_RAW 0 65535 /begin AXIS_DESCR COM_AXIS AXIN_032 CM_RAW 6 0 65535 AXIS_PTS_REF AX_032 /end AXIS_DESCR /end CHARACTERISTIC
/begin CHARACTERISTIC CAL_18F "кривая #18F 5: ?" CURVE 0x08065DAC RL_FNC_UWORD 0 CM_RAW 0 65535 /begin AXIS_DESCR COM_AXIS AXIN_02C CM_RAW 5 0 65535 AXIS_PTS_REF AX_02C /end AXIS_DESCR /end CHARACTERISTIC
/begin CHARACTERISTIC CAL_190 "кривая #190 6: ?" CURVE 0x08065DA0 RL_FNC_UWORD 0 CM_RAW 0 65535 /begin AXIS_DESCR COM_AXIS AXIN_02A CM_RAW 6 0 65535 AXIS_PTS_REF AX_02A /end AXIS_DESCR /end CHARACTERISTIC
/begin CHARACTERISTIC CAL_191 "кривая #191 7: ?" CURVE 0x08065E0C RL_FNC_UWORD 0 CM_RAW 0 65535 /begin AXIS_DESCR COM_AXIS AXIN_02F CM_RAW 7 0 65535 AXIS_PTS_REF AX_02F /end AXIS_DESCR /end CHARACTERISTIC
/begin CHARACTERISTIC CAL_192 "значение #192" VALUE 0x08065E1A RL_FNC_UWORD 0 CM_RAW 0 65535 /end CHARACTERISTIC
/begin CHARACTERISTIC CAL_193 "кривая #193 5: ?" CURVE 0x08065E1C RL_FNC_UWORD 0 CM_RAW 0 65535 /begin AXIS_DESCR COM_AXIS AXIN_02E CM_RAW 5 0 65535 AXIS_PTS_REF AX_02E /end AXIS_DESCR /end CHARACTERISTIC
/begin CHARACTERISTIC CAL_194 "значение #194" VALUE 0x08065E26 RL_FNC_UWORD 0 CM_RAW 0 65535 /end CHARACTERISTIC
/begin CHARACTERISTIC CAL_195 "кривая #195 9: TCOOL" CURVE 0x08065E28 RL_FNC_UWORD 0 CM_RAW 0 65535
 /begin AXIS_DESCR COM_AXIS AXIN_00A_TCOOL CM_C128 9 -256 255.992 AXIS_PTS_REF AX_00A_TCOOL /end AXIS_DESCR
/end CHARACTERISTIC
/begin CHARACTERISTIC CAL_196 "кривая #196 7: ?" CURVE 0x08065E5C RL_FNC_UWORD 0 CM_RAW 0 65535 /begin AXIS_DESCR COM_AXIS AXIN_02F CM_RAW 7 0 65535 AXIS_PTS_REF AX_02F /end AXIS_DESCR /end CHARACTERISTIC
/begin CHARACTERISTIC CAL_197 "кривая #197 7: ?" CURVE 0x08065E3C RL_FNC_UWORD 0 CM_RAW 0 65535 /begin AXIS_DESCR COM_AXIS AXIN_02F CM_RAW 7 0 65535 AXIS_PTS_REF AX_02F /end AXIS_DESCR /end CHARACTERISTIC
/begin CHARACTERISTIC CAL_198 "кривая #198 7: ?" CURVE 0x08065E4C RL_FNC_UWORD 0 CM_RAW 0 65535 /begin AXIS_DESCR COM_AXIS AXIN_02F CM_RAW 7 0 65535 AXIS_PTS_REF AX_02F /end AXIS_DESCR /end CHARACTERISTIC
/begin CHARACTERISTIC CAL_199 "карта #199 17x17: N × LOAD [знак по значениям]" MAP 0x08067628 RL_FNC_SWORD 0 CM_RAW -32768 32767
 /begin AXIS_DESCR COM_AXIS AXIN_038_N CM_RPM2 17 0 32767.5 AXIS_PTS_REF AX_038_N /end AXIS_DESCR
 /begin AXIS_DESCR COM_AXIS AXIN_034_LOAD CM_RAW 17 0 65535 AXIS_PTS_REF AX_034_LOAD /end AXIS_DESCR
/end CHARACTERISTIC
/begin CHARACTERISTIC CAL_19A "значение #19A" VALUE 0x080675EE RL_FNC_UWORD 0 CM_RAW 0 65535 /end CHARACTERISTIC
/begin CHARACTERISTIC CAL_19B "значение #19B" VALUE 0x080675F0 RL_FNC_UWORD 0 CM_RAW 0 65535 /end CHARACTERISTIC
/begin CHARACTERISTIC CAL_19C "массив #19C" VAL_BLK 0x08067624 RL_FNC_UWORD 0 CM_RAW 0 65535 MATRIX_DIM 2 1 1 /end CHARACTERISTIC
/begin CHARACTERISTIC CAL_19D "карта #19D 17x17: N × LOAD [знак по значениям]" MAP 0x08067BD0 RL_FNC_SWORD 0 CM_RAW -32768 32767
 /begin AXIS_DESCR COM_AXIS AXIN_038_N CM_RPM2 17 0 32767.5 AXIS_PTS_REF AX_038_N /end AXIS_DESCR
 /begin AXIS_DESCR COM_AXIS AXIN_034_LOAD CM_RAW 17 0 65535 AXIS_PTS_REF AX_034_LOAD /end AXIS_DESCR
/end CHARACTERISTIC
/begin CHARACTERISTIC CAL_19E "карта #19E 16x9: TCOOL × ?" MAP 0x0806786C RL_FNC_UWORD 0 CM_RAW 0 65535
 /begin AXIS_DESCR COM_AXIS AXIN_00A_TCOOL CM_C128 9 -256 255.992 AXIS_PTS_REF AX_00A_TCOOL /end AXIS_DESCR
 /begin AXIS_DESCR COM_AXIS AXIN_012 CM_RAW 16 0 65535 AXIS_PTS_REF AX_012 /end AXIS_DESCR
/end CHARACTERISTIC
/begin CHARACTERISTIC CAL_19F "карта #19F 17x17: N × LOAD [знак по значениям]" MAP 0x0806798C RL_FNC_SWORD 0 CM_RAW -32768 32767
 /begin AXIS_DESCR COM_AXIS AXIN_038_N CM_RPM2 17 0 32767.5 AXIS_PTS_REF AX_038_N /end AXIS_DESCR
 /begin AXIS_DESCR COM_AXIS AXIN_034_LOAD CM_RAW 17 0 65535 AXIS_PTS_REF AX_034_LOAD /end AXIS_DESCR
/end CHARACTERISTIC
/begin CHARACTERISTIC CAL_1A2 "значение #1A2" VALUE 0x0806752A RL_FNC_UWORD 0 CM_RAW 0 65535 /end CHARACTERISTIC
/begin CHARACTERISTIC CAL_1A3 "кривая #1A3 17: N" CURVE 0x080675C0 RL_FNC_UWORD 0 CM_RAW 0 65535
 /begin AXIS_DESCR COM_AXIS AXIN_001_N CM_RPM2 17 0 32767.5 AXIS_PTS_REF AX_001_N /end AXIS_DESCR
/end CHARACTERISTIC
/begin CHARACTERISTIC CAL_1A4 "массив #1A4" VAL_BLK 0x080675E4 RL_FNC_UWORD 0 CM_RAW 0 65535 MATRIX_DIM 4 1 1 /end CHARACTERISTIC
/begin CHARACTERISTIC CAL_1A5 "карта #1A5 8x17: N × LOAD" MAP 0x08066E74 RL_FNC_UWORD 0 CM_RAW 0 65535
 /begin AXIS_DESCR COM_AXIS AXIN_001_N CM_RPM2 17 0 32767.5 AXIS_PTS_REF AX_001_N /end AXIS_DESCR
 /begin AXIS_DESCR COM_AXIS AXIN_035_LOAD CM_RAW 8 0 65535 AXIS_PTS_REF AX_035_LOAD /end AXIS_DESCR
/end CHARACTERISTIC
/begin CHARACTERISTIC CAL_1A6 "карта #1A6 9x16: TAIR × TCOOL" MAP 0x08066F84 RL_FNC_UWORD 0 CM_RAW 0 65535
 /begin AXIS_DESCR COM_AXIS AXIN_002_TAIR CM_C128 16 -256 255.992 AXIS_PTS_REF AX_002_TAIR /end AXIS_DESCR
 /begin AXIS_DESCR COM_AXIS AXIN_00A_TCOOL CM_C128 9 -256 255.992 AXIS_PTS_REF AX_00A_TCOOL /end AXIS_DESCR
/end CHARACTERISTIC
/begin CHARACTERISTIC CAL_1A7 "карта #1A7 17x17: N × LOAD [знак по значениям]" MAP 0x080670A4 RL_FNC_SWORD 0 CM_RAW -32768 32767
 /begin AXIS_DESCR COM_AXIS AXIN_038_N CM_RPM2 17 0 32767.5 AXIS_PTS_REF AX_038_N /end AXIS_DESCR
 /begin AXIS_DESCR COM_AXIS AXIN_034_LOAD CM_RAW 17 0 65535 AXIS_PTS_REF AX_034_LOAD /end AXIS_DESCR
/end CHARACTERISTIC
/begin CHARACTERISTIC CAL_1A8 "карта #1A8 17x17: N × LOAD [знак по значениям]" MAP 0x080672E8 RL_FNC_SWORD 0 CM_RAW -32768 32767
 /begin AXIS_DESCR COM_AXIS AXIN_038_N CM_RPM2 17 0 32767.5 AXIS_PTS_REF AX_038_N /end AXIS_DESCR
 /begin AXIS_DESCR COM_AXIS AXIN_034_LOAD CM_RAW 17 0 65535 AXIS_PTS_REF AX_034_LOAD /end AXIS_DESCR
/end CHARACTERISTIC
/begin CHARACTERISTIC CAL_1A9 "карта #1A9 9x31: ? × TCOOL [знак по значениям]" MAP 0x08067E14 RL_FNC_SWORD 0 CM_RAW -32768 32767 /begin AXIS_DESCR COM_AXIS AXIN_037 CM_RAW 31 0 65535 AXIS_PTS_REF AX_037 /end AXIS_DESCR
 /begin AXIS_DESCR COM_AXIS AXIN_00A_TCOOL CM_C128 9 -256 255.992 AXIS_PTS_REF AX_00A_TCOOL /end AXIS_DESCR
/end CHARACTERISTIC
/begin CHARACTERISTIC CAL_1AA "кривая #1AA 9: TCOOL" CURVE 0x080675F4 RL_FNC_UWORD 0 CM_RAW 0 65535
 /begin AXIS_DESCR COM_AXIS AXIN_00A_TCOOL CM_C128 9 -256 255.992 AXIS_PTS_REF AX_00A_TCOOL /end AXIS_DESCR
/end CHARACTERISTIC
/begin CHARACTERISTIC CAL_1AB "кривая #1AB 8: LOAD" CURVE 0x08067608 RL_FNC_UWORD 0 CM_RAW 0 65535
 /begin AXIS_DESCR COM_AXIS AXIN_035_LOAD CM_RAW 8 0 65535 AXIS_PTS_REF AX_035_LOAD /end AXIS_DESCR
/end CHARACTERISTIC
/begin CHARACTERISTIC CAL_1AC "значение #1AC" VALUE 0x08067618 RL_FNC_UWORD 0 CM_RAW 0 65535 /end CHARACTERISTIC
/begin CHARACTERISTIC CAL_1AD "значение #1AD" VALUE 0x0806761A RL_FNC_UWORD 0 CM_RAW 0 65535 /end CHARACTERISTIC
/begin CHARACTERISTIC CAL_1AE "значение #1AE" VALUE 0x0806761C RL_FNC_UWORD 0 CM_RAW 0 65535 /end CHARACTERISTIC
/begin CHARACTERISTIC CAL_1AF "значение #1AF" VALUE 0x0806761E RL_FNC_UWORD 0 CM_RAW 0 65535 /end CHARACTERISTIC
/begin CHARACTERISTIC CAL_1B0 "значение #1B0" VALUE 0x08067620 RL_FNC_UWORD 0 CM_RAW 0 65535 /end CHARACTERISTIC
/begin CHARACTERISTIC CAL_1B1 "значение #1B1" VALUE 0x08067622 RL_FNC_UWORD 0 CM_RAW 0 65535 /end CHARACTERISTIC
/begin CHARACTERISTIC CAL_1B2 "значение #1B2" VALUE 0x0806D2E6 RL_FNC_UWORD 0 CM_RAW 0 65535 /end CHARACTERISTIC
/begin CHARACTERISTIC CAL_1B4_0 "карта #1B4 9x24: N × LOAD [1/2]" MAP 0x080699EC RL_FNC_UWORD 0 CM_RAW 0 65535
 /begin AXIS_DESCR COM_AXIS AXIN_03A_N CM_RPM2 24 0 32767.5 AXIS_PTS_REF AX_03A_N /end AXIS_DESCR
 /begin AXIS_DESCR COM_AXIS AXIN_039_LOAD CM_RAW 9 0 65535 AXIS_PTS_REF AX_039_LOAD /end AXIS_DESCR
/end CHARACTERISTIC
/begin CHARACTERISTIC CAL_1B4_1 "карта #1B4 9x24: N × LOAD [2/2]" MAP 0x08069B9C RL_FNC_UWORD 0 CM_RAW 0 65535
 /begin AXIS_DESCR COM_AXIS AXIN_03A_N CM_RPM2 24 0 32767.5 AXIS_PTS_REF AX_03A_N /end AXIS_DESCR
 /begin AXIS_DESCR COM_AXIS AXIN_039_LOAD CM_RAW 9 0 65535 AXIS_PTS_REF AX_039_LOAD /end AXIS_DESCR
/end CHARACTERISTIC
/begin CHARACTERISTIC CAL_1B5 "кривая #1B5 60: N" CURVE 0x08069974 RL_FNC_UWORD 0 CM_RAW 0 65535
 /begin AXIS_DESCR COM_AXIS AXIN_03B_N CM_RPM2 60 0 32767.5 AXIS_PTS_REF AX_03B_N /end AXIS_DESCR
/end CHARACTERISTIC
/begin CHARACTERISTIC CAL_1B6_0 "карта #1B6 9x24: N × LOAD [1/2]" MAP 0x08069F28 RL_FNC_UWORD 0 CM_RAW 0 65535
 /begin AXIS_DESCR COM_AXIS AXIN_03A_N CM_RPM2 24 0 32767.5 AXIS_PTS_REF AX_03A_N /end AXIS_DESCR
 /begin AXIS_DESCR COM_AXIS AXIN_039_LOAD CM_RAW 9 0 65535 AXIS_PTS_REF AX_039_LOAD /end AXIS_DESCR
/end CHARACTERISTIC
/begin CHARACTERISTIC CAL_1B6_1 "карта #1B6 9x24: N × LOAD [2/2]" MAP 0x0806A0D8 RL_FNC_UWORD 0 CM_RAW 0 65535
 /begin AXIS_DESCR COM_AXIS AXIN_03A_N CM_RPM2 24 0 32767.5 AXIS_PTS_REF AX_03A_N /end AXIS_DESCR
 /begin AXIS_DESCR COM_AXIS AXIN_039_LOAD CM_RAW 9 0 65535 AXIS_PTS_REF AX_039_LOAD /end AXIS_DESCR
/end CHARACTERISTIC
/begin CHARACTERISTIC CAL_1B7 "значение #1B7" VALUE 0x0806A488 RL_FNC_UWORD 0 CM_RAW 0 65535 /end CHARACTERISTIC
/begin CHARACTERISTIC CAL_1B8 "карта #1B8 17x17: N × LOAD" MAP 0x08073FFC RL_FNC_UWORD 0 CM_RAW 0 65535
 /begin AXIS_DESCR COM_AXIS AXIN_03C_N CM_RPM2 17 0 32767.5 AXIS_PTS_REF AX_03C_N /end AXIS_DESCR
 /begin AXIS_DESCR COM_AXIS AXIN_03D_LOAD CM_RAW 17 0 65535 AXIS_PTS_REF AX_03D_LOAD /end AXIS_DESCR
/end CHARACTERISTIC
/begin CHARACTERISTIC CAL_1B9 "кривая #1B9 16: TCOOL" CURVE 0x080743A4 RL_FNC_UWORD 0 CM_RAW 0 65535
 /begin AXIS_DESCR COM_AXIS AXIN_004_TCOOL CM_C128 16 -256 255.992 AXIS_PTS_REF AX_004_TCOOL /end AXIS_DESCR
/end CHARACTERISTIC
/begin CHARACTERISTIC CAL_1BA "карта #1BA 11x16: ? × TCOOL" MAP 0x08074244 RL_FNC_UWORD 0 CM_RAW 0 65535 /begin AXIS_DESCR COM_AXIS AXIN_012 CM_RAW 16 0 65535 AXIS_PTS_REF AX_012 /end AXIS_DESCR
 /begin AXIS_DESCR COM_AXIS AXIN_08C_TCOOL CM_C128 11 -256 255.992 AXIS_PTS_REF AX_08C_TCOOL /end AXIS_DESCR
/end CHARACTERISTIC
/begin CHARACTERISTIC CAL_1BB "кривая #1BB 17: N" CURVE 0x080743E4 RL_FNC_UWORD 0 CM_RAW 0 65535
 /begin AXIS_DESCR COM_AXIS AXIN_03C_N CM_RPM2 17 0 32767.5 AXIS_PTS_REF AX_03C_N /end AXIS_DESCR
/end CHARACTERISTIC
/begin CHARACTERISTIC CAL_1BC "значение #1BC" VALUE 0x08073EB6 RL_FNC_UWORD 0 CM_RAW 0 65535 /end CHARACTERISTIC
/begin CHARACTERISTIC CAL_1BD "карта #1BD 17x17: N × LOAD" MAP 0x08073C74 RL_FNC_UWORD 0 CM_RAW 0 65535
 /begin AXIS_DESCR COM_AXIS AXIN_03E_N CM_RPM2 17 0 32767.5 AXIS_PTS_REF AX_03E_N /end AXIS_DESCR
 /begin AXIS_DESCR COM_AXIS AXIN_03F_LOAD CM_RAW 17 0 65535 AXIS_PTS_REF AX_03F_LOAD /end AXIS_DESCR
/end CHARACTERISTIC
/begin CHARACTERISTIC CAL_1BE "кривая #1BE 27: ?" CURVE 0x08073C3C RL_FNC_UWORD 0 CM_RAW 0 65535 /begin AXIS_DESCR COM_AXIS AXIN_040 CM_RAW 27 0 65535 AXIS_PTS_REF AX_040 /end AXIS_DESCR /end CHARACTERISTIC
/begin CHARACTERISTIC CAL_1BF "кривая #1BF 10: ?" CURVE 0x08073C28 RL_FNC_UWORD 0 CM_RAW 0 65535 /begin AXIS_DESCR COM_AXIS AXIN_041 CM_RAW 10 0 65535 AXIS_PTS_REF AX_041 /end AXIS_DESCR /end CHARACTERISTIC
/begin CHARACTERISTIC CAL_1C0 "массив #1C0" VAL_BLK 0x080653C4 RL_FNC_UWORD 0 CM_RAW 0 65535 MATRIX_DIM 2 1 1 /end CHARACTERISTIC
/begin CHARACTERISTIC CAL_1C1 "массив #1C1" VAL_BLK 0x080653C8 RL_FNC_UWORD 0 CM_RAW 0 65535 MATRIX_DIM 2 1 1 /end CHARACTERISTIC
/begin CHARACTERISTIC CAL_1C2 "массив #1C2" VAL_BLK 0x080653D0 RL_FNC_UWORD 0 CM_RAW 0 65535 MATRIX_DIM 2 1 1 /end CHARACTERISTIC
/begin CHARACTERISTIC CAL_1C3 "массив #1C3" VAL_BLK 0x080653CC RL_FNC_UWORD 0 CM_RAW 0 65535 MATRIX_DIM 2 1 1 /end CHARACTERISTIC
/begin CHARACTERISTIC CAL_1C4 "массив #1C4" VAL_BLK 0x080653D4 RL_FNC_UWORD 0 CM_RAW 0 65535 MATRIX_DIM 2 1 1 /end CHARACTERISTIC
/begin CHARACTERISTIC CAL_1C5 "массив #1C5" VAL_BLK 0x080653E8 RL_FNC_UWORD 0 CM_RAW 0 65535 MATRIX_DIM 2 1 1 /end CHARACTERISTIC
/begin CHARACTERISTIC CAL_1C6 "массив #1C6" VAL_BLK 0x080653F0 RL_FNC_UWORD 0 CM_RAW 0 65535 MATRIX_DIM 2 1 1 /end CHARACTERISTIC
/begin CHARACTERISTIC CAL_1C7 "массив #1C7" VAL_BLK 0x080653D8 RL_FNC_UWORD 0 CM_RAW 0 65535 MATRIX_DIM 2 1 1 /end CHARACTERISTIC
/begin CHARACTERISTIC CAL_1C8 "массив #1C8" VAL_BLK 0x080653E4 RL_FNC_UWORD 0 CM_RAW 0 65535 MATRIX_DIM 2 1 1 /end CHARACTERISTIC
/begin CHARACTERISTIC CAL_1C9 "массив #1C9" VAL_BLK 0x080653F8 RL_FNC_UWORD 0 CM_RAW 0 65535 MATRIX_DIM 2 1 1 /end CHARACTERISTIC
/begin CHARACTERISTIC CAL_1CA "массив #1CA" VAL_BLK 0x080653F4 RL_FNC_UWORD 0 CM_RAW 0 65535 MATRIX_DIM 2 1 1 /end CHARACTERISTIC
/begin CHARACTERISTIC CAL_1CB "массив #1CB" VAL_BLK 0x080653FC RL_FNC_UWORD 0 CM_RAW 0 65535 MATRIX_DIM 2 1 1 /end CHARACTERISTIC
/begin CHARACTERISTIC CAL_1CC "массив #1CC" VAL_BLK 0x08065400 RL_FNC_UWORD 0 CM_RAW 0 65535 MATRIX_DIM 2 1 1 /end CHARACTERISTIC
/begin CHARACTERISTIC CAL_1CD "значение #1CD" VALUE 0x08065404 RL_FNC_SBYTE 0 CM_RAW -128 127 /end CHARACTERISTIC
/begin CHARACTERISTIC CAL_1CE "значение #1CE" VALUE 0x08065408 RL_FNC_UWORD 0 CM_RAW 0 65535 /end CHARACTERISTIC
/begin CHARACTERISTIC CAL_1CF "массив #1CF" VAL_BLK 0x0806540C RL_FNC_UWORD 0 CM_RAW 0 65535 MATRIX_DIM 3 1 1 /end CHARACTERISTIC
/begin CHARACTERISTIC CAL_1D0 "значение #1D0" VALUE 0x08065412 RL_FNC_UWORD 0 CM_RAW 0 65535 /end CHARACTERISTIC
/begin CHARACTERISTIC CAL_1D1 "значение #1D1" VALUE 0x08065414 RL_FNC_UWORD 0 CM_RAW 0 65535 /end CHARACTERISTIC
/begin CHARACTERISTIC CAL_1D2 "массив #1D2" VAL_BLK 0x080653AC RL_FNC_UWORD 0 CM_RAW 0 65535 MATRIX_DIM 2 1 1 /end CHARACTERISTIC
/begin CHARACTERISTIC CAL_1D3 "массив #1D3" VAL_BLK 0x080653B0 RL_FNC_UWORD 0 CM_RAW 0 65535 MATRIX_DIM 2 1 1 /end CHARACTERISTIC
/begin CHARACTERISTIC CAL_1D4 "массив #1D4" VAL_BLK 0x080653B4 RL_FNC_UWORD 0 CM_RAW 0 65535 MATRIX_DIM 2 1 1 /end CHARACTERISTIC
/begin CHARACTERISTIC CAL_1D5 "массив #1D5" VAL_BLK 0x080653B8 RL_FNC_UWORD 0 CM_RAW 0 65535 MATRIX_DIM 2 1 1 /end CHARACTERISTIC
/begin CHARACTERISTIC CAL_1D6 "массив #1D6" VAL_BLK 0x080653BC RL_FNC_UWORD 0 CM_RAW 0 65535 MATRIX_DIM 2 1 1 /end CHARACTERISTIC
/begin CHARACTERISTIC CAL_1D7 "массив #1D7" VAL_BLK 0x080653C0 RL_FNC_UWORD 0 CM_RAW 0 65535 MATRIX_DIM 2 1 1 /end CHARACTERISTIC
/begin CHARACTERISTIC CAL_1D8 "массив #1D8" VAL_BLK 0x080653EC RL_FNC_UWORD 0 CM_RAW 0 65535 MATRIX_DIM 2 1 1 /end CHARACTERISTIC
/begin CHARACTERISTIC CAL_1D9 "массив #1D9" VAL_BLK 0x080653DC RL_FNC_UWORD 0 CM_RAW 0 65535 MATRIX_DIM 2 1 1 /end CHARACTERISTIC
/begin CHARACTERISTIC CAL_1DA "кривая #1DA 17: TAIR" CURVE 0x080662DC RL_FNC_UWORD 0 CM_RAW 0 65535
 /begin AXIS_DESCR COM_AXIS AXIN_042_TAIR CM_C128 17 -256 255.992 AXIS_PTS_REF AX_042_TAIR /end AXIS_DESCR
/end CHARACTERISTIC
/begin CHARACTERISTIC CAL_1DB "кривая #1DB 30: ?" CURVE 0x08070638 RL_FNC_UWORD 0 CM_RAW 0 65535 /begin AXIS_DESCR COM_AXIS AXIN_043 CM_P128 30 0 511.992 AXIS_PTS_REF AX_043 /end AXIS_DESCR /end CHARACTERISTIC
/begin CHARACTERISTIC CAL_1DC "значение #1DC" VALUE 0x080705A0 RL_FNC_UWORD 0 CM_RAW 0 65535 /end CHARACTERISTIC
/begin CHARACTERISTIC CAL_1DE "кривая #1DE 17: N" CURVE 0x08065358 RL_FNC_UWORD 0 CM_RAW 0 65535
 /begin AXIS_DESCR COM_AXIS AXIN_001_N CM_RPM2 17 0 32767.5 AXIS_PTS_REF AX_001_N /end AXIS_DESCR
/end CHARACTERISTIC
/begin CHARACTERISTIC CAL_1DF "значение #1DF" VALUE 0x0806537A RL_FNC_SBYTE 0 CM_RAW -128 127 /end CHARACTERISTIC
/begin CHARACTERISTIC CAL_1E0 "значение #1E0" VALUE 0x08065416 RL_FNC_UWORD 0 CM_RAW 0 65535 /end CHARACTERISTIC
/begin CHARACTERISTIC CAL_1E1 "кривая #1E1 17: N" CURVE 0x08065418 RL_FNC_UWORD 0 CM_RAW 0 65535
 /begin AXIS_DESCR COM_AXIS AXIN_001_N CM_RPM2 17 0 32767.5 AXIS_PTS_REF AX_001_N /end AXIS_DESCR
/end CHARACTERISTIC
/begin CHARACTERISTIC CAL_1E2 "значение #1E2" VALUE 0x08065444 RL_FNC_UWORD 0 CM_RAW 0 65535 /end CHARACTERISTIC
/begin CHARACTERISTIC CAL_1E3 "значение #1E3" VALUE 0x080656A4 RL_FNC_UWORD 0 CM_RAW 0 65535 /end CHARACTERISTIC
/begin CHARACTERISTIC CAL_1E4 "кривая #1E4 17: N" CURVE 0x080656A8 RL_FNC_UWORD 0 CM_RAW 0 65535
 /begin AXIS_DESCR COM_AXIS AXIN_05F_N CM_RPM2 17 0 32767.5 AXIS_PTS_REF AX_05F_N /end AXIS_DESCR
/end CHARACTERISTIC
/begin CHARACTERISTIC CAL_1E5 "карта #1E5 16x3: ? × TCOOL" MAP 0x080656E0 RL_FNC_UWORD 0 CM_RAW 0 65535 /begin AXIS_DESCR COM_AXIS AXIN_009 CM_RAW 3 0 65535 AXIS_PTS_REF AX_009 /end AXIS_DESCR
 /begin AXIS_DESCR COM_AXIS AXIN_004_TCOOL CM_C128 16 -256 255.992 AXIS_PTS_REF AX_004_TCOOL /end AXIS_DESCR
/end CHARACTERISTIC
/begin CHARACTERISTIC CAL_1E6 "кривая #1E6 9: TCOOL" CURVE 0x080656CC RL_FNC_UWORD 0 CM_RAW 0 65535
 /begin AXIS_DESCR COM_AXIS AXIN_045_TCOOL CM_C128 9 -256 255.992 AXIS_PTS_REF AX_045_TCOOL /end AXIS_DESCR
/end CHARACTERISTIC
/begin CHARACTERISTIC CAL_1E7 "массив #1E7 [знак по значениям]" VAL_BLK 0x08065740 RL_FNC_SWORD 0 CM_RAW -32768 32767 MATRIX_DIM 2 1 1 /end CHARACTERISTIC
/begin CHARACTERISTIC CAL_1E8 "кривая #1E8 10: N" CURVE 0x08065744 RL_FNC_UWORD 0 CM_RAW 0 65535
 /begin AXIS_DESCR COM_AXIS AXIN_00C_N CM_RPM2 10 0 32767.5 AXIS_PTS_REF AX_00C_N /end AXIS_DESCR
/end CHARACTERISTIC
/begin CHARACTERISTIC CAL_1E9 "значение #1E9" VALUE 0x0806992A RL_FNC_UWORD 0 CM_RAW 0 65535 /end CHARACTERISTIC
/begin CHARACTERISTIC CAL_1EA "значение #1EA" VALUE 0x08069930 RL_FNC_UWORD 0 CM_RAW 0 65535 /end CHARACTERISTIC
/begin CHARACTERISTIC CAL_1EB "значение #1EB" VALUE 0x0806992E RL_FNC_UWORD 0 CM_RAW 0 65535 /end CHARACTERISTIC
/begin CHARACTERISTIC CAL_1EC "карта #1EC 9x24: N × LOAD" MAP 0x08069D58 RL_FNC_UWORD 0 CM_RAW 0 65535
 /begin AXIS_DESCR COM_AXIS AXIN_03A_N CM_RPM2 24 0 32767.5 AXIS_PTS_REF AX_03A_N /end AXIS_DESCR
 /begin AXIS_DESCR COM_AXIS AXIN_039_LOAD CM_RAW 9 0 65535 AXIS_PTS_REF AX_039_LOAD /end AXIS_DESCR
/end CHARACTERISTIC
/begin CHARACTERISTIC CAL_1ED "значение #1ED" VALUE 0x08069F0A RL_FNC_UWORD 0 CM_RAW 0 65535 /end CHARACTERISTIC
/begin CHARACTERISTIC CAL_1EE "значение #1EE" VALUE 0x08069F08 RL_FNC_UWORD 0 CM_RAW 0 65535 /end CHARACTERISTIC
/begin CHARACTERISTIC CAL_1EF "карта #1EF 9x24: N × LOAD" MAP 0x0806A57C RL_FNC_SBYTE 0 CM_RAW -128 127
 /begin AXIS_DESCR COM_AXIS AXIN_03A_N CM_RPM2 24 0 32767.5 AXIS_PTS_REF AX_03A_N /end AXIS_DESCR
 /begin AXIS_DESCR COM_AXIS AXIN_039_LOAD CM_RAW 9 0 65535 AXIS_PTS_REF AX_039_LOAD /end AXIS_DESCR
/end CHARACTERISTIC
/begin CHARACTERISTIC CAL_1F0 "массив #1F0" VAL_BLK 0x08069934 RL_FNC_SBYTE 0 CM_RAW -128 127 MATRIX_DIM 2 1 1 /end CHARACTERISTIC
/begin CHARACTERISTIC CAL_1F1 "значение #1F1" VALUE 0x0806992C RL_FNC_SBYTE 0 CM_RAW -128 127 /end CHARACTERISTIC
/begin CHARACTERISTIC CAL_1F2 "кривая #1F2 24: N" CURVE 0x0806A564 RL_FNC_SBYTE 0 CM_RAW -128 127
 /begin AXIS_DESCR COM_AXIS AXIN_03A_N CM_RPM2 24 0 32767.5 AXIS_PTS_REF AX_03A_N /end AXIS_DESCR
/end CHARACTERISTIC
/begin CHARACTERISTIC CAL_1F3 "значение #1F3" VALUE 0x08069928 RL_FNC_UWORD 0 CM_RAW 0 65535 /end CHARACTERISTIC
/begin CHARACTERISTIC CAL_1F4 "кривая #1F4 14: N" CURVE 0x08069F0C RL_FNC_UWORD 0 CM_RAW 0 65535
 /begin AXIS_DESCR COM_AXIS AXIN_027_N CM_RPM2 14 0 32767.5 AXIS_PTS_REF AX_027_N /end AXIS_DESCR
/end CHARACTERISTIC
/begin CHARACTERISTIC CAL_1F5 "значение #1F5" VALUE 0x0806996B RL_FNC_SBYTE 0 CM_RAW -128 127 /end CHARACTERISTIC
/begin CHARACTERISTIC CAL_1F6 "значение #1F6" VALUE 0x08069969 RL_FNC_SBYTE 0 CM_RAW -128 127 /end CHARACTERISTIC
/begin CHARACTERISTIC CAL_1F7 "значение #1F7" VALUE 0x08069968 RL_FNC_SBYTE 0 CM_RAW -128 127 /end CHARACTERISTIC
/begin CHARACTERISTIC CAL_1F9 "значение #1F9" VALUE 0x0807458C RL_FNC_SWORD 0 CM_RAW -32768 32767 /end CHARACTERISTIC
/begin CHARACTERISTIC CAL_1FA "значение #1FA" VALUE 0x0806A288 RL_FNC_UWORD 0 CM_RAW 0 65535 /end CHARACTERISTIC
/begin CHARACTERISTIC CAL_1FB_0 "кривая #1FB 16: TCOOL [1/2]" CURVE 0x0806BB40 RL_FNC_SWORD 0 CM_RAW -32768 32767
 /begin AXIS_DESCR COM_AXIS AXIN_004_TCOOL CM_C128 16 -256 255.992 AXIS_PTS_REF AX_004_TCOOL /end AXIS_DESCR
/end CHARACTERISTIC
/begin CHARACTERISTIC CAL_1FB_1 "кривая #1FB 16: TCOOL [2/2]" CURVE 0x0806BB60 RL_FNC_SWORD 0 CM_RAW -32768 32767
 /begin AXIS_DESCR COM_AXIS AXIN_004_TCOOL CM_C128 16 -256 255.992 AXIS_PTS_REF AX_004_TCOOL /end AXIS_DESCR
/end CHARACTERISTIC
/begin CHARACTERISTIC CAL_1FC "массив #1FC" VAL_BLK 0x0806BB3C RL_FNC_UWORD 0 CM_RAW 0 65535 MATRIX_DIM 2 1 1 /end CHARACTERISTIC
/begin CHARACTERISTIC CAL_251_0 "кривая #251 26: ? [1/4]" CURVE 0x0806927C RL_FNC_UWORD 0 CM_RAW 0 65535 /begin AXIS_DESCR COM_AXIS AXIN_04A CM_RAW 26 0 255 AXIS_PTS_REF AX_04A /end AXIS_DESCR /end CHARACTERISTIC
/begin CHARACTERISTIC CAL_251_1 "кривая #251 26: ? [2/4]" CURVE 0x080692B0 RL_FNC_UWORD 0 CM_RAW 0 65535 /begin AXIS_DESCR COM_AXIS AXIN_04A CM_RAW 26 0 255 AXIS_PTS_REF AX_04A /end AXIS_DESCR /end CHARACTERISTIC
/begin CHARACTERISTIC CAL_251_2 "кривая #251 26: ? [3/4]" CURVE 0x080692E4 RL_FNC_UWORD 0 CM_RAW 0 65535 /begin AXIS_DESCR COM_AXIS AXIN_04A CM_RAW 26 0 255 AXIS_PTS_REF AX_04A /end AXIS_DESCR /end CHARACTERISTIC
/begin CHARACTERISTIC CAL_251_3 "кривая #251 26: ? [4/4]" CURVE 0x08069318 RL_FNC_UWORD 0 CM_RAW 0 65535 /begin AXIS_DESCR COM_AXIS AXIN_04A CM_RAW 26 0 255 AXIS_PTS_REF AX_04A /end AXIS_DESCR /end CHARACTERISTIC
/begin CHARACTERISTIC CAL_252 "кривая #252 17: N" CURVE 0x0806916C RL_FNC_UWORD 0 CM_RAW 0 65535
 /begin AXIS_DESCR COM_AXIS AXIN_001_N CM_RPM2 17 0 32767.5 AXIS_PTS_REF AX_001_N /end AXIS_DESCR
/end CHARACTERISTIC
/begin CHARACTERISTIC CAL_253 "значение #253" VALUE 0x08069168 RL_FNC_UWORD 0 CM_RAW 0 65535 /end CHARACTERISTIC
/begin CHARACTERISTIC CAL_254 "значение #254" VALUE 0x08069190 RL_FNC_UWORD 0 CM_RAW 0 65535 /end CHARACTERISTIC
/begin CHARACTERISTIC CAL_255 "кривая #255 17: N" CURVE 0x08069194 RL_FNC_UWORD 0 CM_RAW 0 65535
 /begin AXIS_DESCR COM_AXIS AXIN_001_N CM_RPM2 17 0 32767.5 AXIS_PTS_REF AX_001_N /end AXIS_DESCR
/end CHARACTERISTIC
/begin CHARACTERISTIC CAL_256 "значение #256" VALUE 0x08069192 RL_FNC_UWORD 0 CM_RAW 0 65535 /end CHARACTERISTIC
/begin CHARACTERISTIC CAL_257 "значение #257" VALUE 0x080691B6 RL_FNC_SBYTE 0 CM_RAW -128 127 /end CHARACTERISTIC
/begin CHARACTERISTIC CAL_258 "массив #258" VAL_BLK 0x08069350 RL_FNC_UWORD 0 CM_RAW 0 65535 MATRIX_DIM 2 1 1 /end CHARACTERISTIC
/begin CHARACTERISTIC CAL_259 "значение #259" VALUE 0x08069410 RL_FNC_SBYTE 0 CM_RAW -128 127 /end CHARACTERISTIC
/begin CHARACTERISTIC CAL_25A_0 "кривая #25A 17: N [1/3]" CURVE 0x080694C4 RL_FNC_UWORD 0 CM_RAW 0 65535
 /begin AXIS_DESCR COM_AXIS AXIN_001_N CM_RPM2 17 0 32767.5 AXIS_PTS_REF AX_001_N /end AXIS_DESCR
/end CHARACTERISTIC
/begin CHARACTERISTIC CAL_25A_1 "кривая #25A 17: N [2/3]" CURVE 0x080694E6 RL_FNC_UWORD 0 CM_RAW 0 65535
 /begin AXIS_DESCR COM_AXIS AXIN_001_N CM_RPM2 17 0 32767.5 AXIS_PTS_REF AX_001_N /end AXIS_DESCR
/end CHARACTERISTIC
/begin CHARACTERISTIC CAL_25A_2 "кривая #25A 17: N [3/3]" CURVE 0x08069508 RL_FNC_UWORD 0 CM_RAW 0 65535
 /begin AXIS_DESCR COM_AXIS AXIN_001_N CM_RPM2 17 0 32767.5 AXIS_PTS_REF AX_001_N /end AXIS_DESCR
/end CHARACTERISTIC
/begin CHARACTERISTIC CAL_25B "массив #25B" VAL_BLK 0x080694BC RL_FNC_UWORD 0 CM_RAW 0 65535 MATRIX_DIM 3 1 1 /end CHARACTERISTIC
/begin CHARACTERISTIC CAL_25C_0 "кривая #25C 17: N [1/3]" CURVE 0x0806952C RL_FNC_UWORD 0 CM_RAW 0 65535
 /begin AXIS_DESCR COM_AXIS AXIN_001_N CM_RPM2 17 0 32767.5 AXIS_PTS_REF AX_001_N /end AXIS_DESCR
/end CHARACTERISTIC
/begin CHARACTERISTIC CAL_25C_1 "кривая #25C 17: N [2/3]" CURVE 0x0806954E RL_FNC_UWORD 0 CM_RAW 0 65535
 /begin AXIS_DESCR COM_AXIS AXIN_001_N CM_RPM2 17 0 32767.5 AXIS_PTS_REF AX_001_N /end AXIS_DESCR
/end CHARACTERISTIC
/begin CHARACTERISTIC CAL_25C_2 "кривая #25C 17: N [3/3]" CURVE 0x08069570 RL_FNC_UWORD 0 CM_RAW 0 65535
 /begin AXIS_DESCR COM_AXIS AXIN_001_N CM_RPM2 17 0 32767.5 AXIS_PTS_REF AX_001_N /end AXIS_DESCR
/end CHARACTERISTIC
/begin CHARACTERISTIC CAL_25D "значение #25D" VALUE 0x0806918E RL_FNC_UWORD 0 CM_RAW 0 65535 /end CHARACTERISTIC
/begin CHARACTERISTIC CAL_25E "массив #25E" VAL_BLK 0x080694A8 RL_FNC_UWORD 0 CM_RAW 0 65535 MATRIX_DIM 2 1 1 /end CHARACTERISTIC
/begin CHARACTERISTIC CAL_25F "массив #25F" VAL_BLK 0x080694B0 RL_FNC_UWORD 0 CM_RAW 0 65535 MATRIX_DIM 2 1 1 /end CHARACTERISTIC
/begin CHARACTERISTIC CAL_261 "кривая #261 26: ?" CURVE 0x080691EC RL_FNC_UWORD 0 CM_RAW 0 65535 /begin AXIS_DESCR COM_AXIS AXIN_04A CM_RAW 26 0 255 AXIS_PTS_REF AX_04A /end AXIS_DESCR /end CHARACTERISTIC
/begin CHARACTERISTIC CAL_262 "кривая #262 26: ?" CURVE 0x08069220 RL_FNC_UWORD 0 CM_RAW 0 65535 /begin AXIS_DESCR COM_AXIS AXIN_04A CM_RAW 26 0 255 AXIS_PTS_REF AX_04A /end AXIS_DESCR /end CHARACTERISTIC
/begin CHARACTERISTIC CAL_263 "кривая #263 17: N" CURVE 0x08069254 RL_FNC_UWORD 0 CM_RAW 0 65535
 /begin AXIS_DESCR COM_AXIS AXIN_001_N CM_RPM2 17 0 32767.5 AXIS_PTS_REF AX_001_N /end AXIS_DESCR
/end CHARACTERISTIC
/begin CHARACTERISTIC CAL_264 "значение #264" VALUE 0x08069276 RL_FNC_UWORD 0 CM_RAW 0 65535 /end CHARACTERISTIC
/begin CHARACTERISTIC CAL_265_0 "кривая #265 17: N [1/2]" CURVE 0x080693CC RL_FNC_UWORD 0 CM_RAW 0 65535
 /begin AXIS_DESCR COM_AXIS AXIN_001_N CM_RPM2 17 0 32767.5 AXIS_PTS_REF AX_001_N /end AXIS_DESCR
/end CHARACTERISTIC
/begin CHARACTERISTIC CAL_265_1 "кривая #265 17: N [2/2]" CURVE 0x080693EE RL_FNC_UWORD 0 CM_RAW 0 65535
 /begin AXIS_DESCR COM_AXIS AXIN_001_N CM_RPM2 17 0 32767.5 AXIS_PTS_REF AX_001_N /end AXIS_DESCR
/end CHARACTERISTIC
/begin CHARACTERISTIC CAL_266 "кривая #266 26: ?" CURVE 0x08069354 RL_FNC_UWORD 0 CM_RAW 0 65535 /begin AXIS_DESCR COM_AXIS AXIN_04A CM_RAW 26 0 255 AXIS_PTS_REF AX_04A /end AXIS_DESCR /end CHARACTERISTIC
/begin CHARACTERISTIC CAL_267 "массив #267" VAL_BLK 0x080694B4 RL_FNC_UWORD 0 CM_RAW 0 65535 MATRIX_DIM 3 1 1 /end CHARACTERISTIC
/begin CHARACTERISTIC CAL_268 "кривая #268 10: N" CURVE 0x08069154 RL_FNC_UWORD 0 CM_RAW 0 65535
 /begin AXIS_DESCR COM_AXIS AXIN_00C_N CM_RPM2 10 0 32767.5 AXIS_PTS_REF AX_00C_N /end AXIS_DESCR
/end CHARACTERISTIC
/begin CHARACTERISTIC CAL_269 "значение #269" VALUE 0x080691B8 RL_FNC_UWORD 0 CM_RAW 0 65535 /end CHARACTERISTIC
/begin CHARACTERISTIC CAL_26A "значение #26A" VALUE 0x080691BA RL_FNC_UWORD 0 CM_RAW 0 65535 /end CHARACTERISTIC
/begin CHARACTERISTIC CAL_26B "карта #26B 8x9: TCOOL × TAIR" MAP 0x08069414 RL_FNC_UWORD 0 CM_RAW 0 65535
 /begin AXIS_DESCR COM_AXIS AXIN_00A_TCOOL CM_C128 9 -256 255.992 AXIS_PTS_REF AX_00A_TCOOL /end AXIS_DESCR
 /begin AXIS_DESCR COM_AXIS AXIN_049_TAIR CM_C128 8 -256 255.992 AXIS_PTS_REF AX_049_TAIR /end AXIS_DESCR
/end CHARACTERISTIC
/begin CHARACTERISTIC CAL_26C_0 "кривая #26C 8: TAIR [1/2]" CURVE 0x0806AD64 RL_FNC_SBYTE 0 CM_RAW -128 127
 /begin AXIS_DESCR COM_AXIS AXIN_049_TAIR CM_C128 8 -256 255.992 AXIS_PTS_REF AX_049_TAIR /end AXIS_DESCR
/end CHARACTERISTIC
/begin CHARACTERISTIC CAL_26C_1 "кривая #26C 8: TAIR [2/2]" CURVE 0x0806AD6C RL_FNC_SBYTE 0 CM_RAW -128 127
 /begin AXIS_DESCR COM_AXIS AXIN_049_TAIR CM_C128 8 -256 255.992 AXIS_PTS_REF AX_049_TAIR /end AXIS_DESCR
/end CHARACTERISTIC
/begin CHARACTERISTIC CAL_26E "карта #26E 10x8: N × LOAD" MAP 0x0806AD78 RL_FNC_UWORD 0 CM_RAW 0 65535
 /begin AXIS_DESCR COM_AXIS AXIN_04B_N CM_RPM2 8 0 32767.5 AXIS_PTS_REF AX_04B_N /end AXIS_DESCR
 /begin AXIS_DESCR COM_AXIS AXIN_04C_LOAD CM_RAW 10 0 65535 AXIS_PTS_REF AX_04C_LOAD /end AXIS_DESCR
/end CHARACTERISTIC
/begin CHARACTERISTIC CAL_26F "значение #26F" VALUE 0x0806AF6C RL_FNC_UWORD 0 CM_RAW 0 65535 /end CHARACTERISTIC
/begin CHARACTERISTIC CAL_270 "значение #270" VALUE 0x0806AF74 RL_FNC_SBYTE 0 CM_RAW -128 127 /end CHARACTERISTIC
/begin CHARACTERISTIC CAL_271 "значение #271" VALUE 0x0806B0BC RL_FNC_SBYTE 0 CM_RAW -128 127 /end CHARACTERISTIC
/begin CHARACTERISTIC CAL_272 "карта #272 10x8: N × LOAD" MAP 0x0806B24C RL_FNC_SWORD 0 CM_RAW -32768 32767
 /begin AXIS_DESCR COM_AXIS AXIN_04B_N CM_RPM2 8 0 32767.5 AXIS_PTS_REF AX_04B_N /end AXIS_DESCR
 /begin AXIS_DESCR COM_AXIS AXIN_04C_LOAD CM_RAW 10 0 65535 AXIS_PTS_REF AX_04C_LOAD /end AXIS_DESCR
/end CHARACTERISTIC
/begin CHARACTERISTIC CAL_273 "карта #273 10x8: N × LOAD" MAP 0x0806B2EC RL_FNC_UWORD 0 CM_RAW 0 65535
 /begin AXIS_DESCR COM_AXIS AXIN_04B_N CM_RPM2 8 0 32767.5 AXIS_PTS_REF AX_04B_N /end AXIS_DESCR
 /begin AXIS_DESCR COM_AXIS AXIN_04C_LOAD CM_RAW 10 0 65535 AXIS_PTS_REF AX_04C_LOAD /end AXIS_DESCR
/end CHARACTERISTIC
/begin CHARACTERISTIC CAL_274_0 "карта #274 10x8: N × LOAD [1/2]" MAP 0x0806B398 RL_FNC_UWORD 0 CM_RAW 0 65535
 /begin AXIS_DESCR COM_AXIS AXIN_04B_N CM_RPM2 8 0 32767.5 AXIS_PTS_REF AX_04B_N /end AXIS_DESCR
 /begin AXIS_DESCR COM_AXIS AXIN_04C_LOAD CM_RAW 10 0 65535 AXIS_PTS_REF AX_04C_LOAD /end AXIS_DESCR
/end CHARACTERISTIC
/begin CHARACTERISTIC CAL_274_1 "карта #274 10x8: N × LOAD [2/2]" MAP 0x0806B438 RL_FNC_UWORD 0 CM_RAW 0 65535
 /begin AXIS_DESCR COM_AXIS AXIN_04B_N CM_RPM2 8 0 32767.5 AXIS_PTS_REF AX_04B_N /end AXIS_DESCR
 /begin AXIS_DESCR COM_AXIS AXIN_04C_LOAD CM_RAW 10 0 65535 AXIS_PTS_REF AX_04C_LOAD /end AXIS_DESCR
/end CHARACTERISTIC
/begin CHARACTERISTIC CAL_275 "значение #275" VALUE 0x0806B396 RL_FNC_UWORD 0 CM_RAW 0 65535 /end CHARACTERISTIC
/begin CHARACTERISTIC CAL_276 "значение #276" VALUE 0x0806B0BD RL_FNC_SBYTE 0 CM_RAW -128 127 /end CHARACTERISTIC
/begin CHARACTERISTIC CAL_277 "значение #277" VALUE 0x0806B4E0 RL_FNC_UWORD 0 CM_RAW 0 65535 /end CHARACTERISTIC
/begin CHARACTERISTIC CAL_278 "значение #278" VALUE 0x0806B70E RL_FNC_UWORD 0 CM_RAW 0 65535 /end CHARACTERISTIC
/begin CHARACTERISTIC CAL_279 "кривая #279 8: TAIR" CURVE 0x0806AF5C RL_FNC_UWORD 0 CM_RAW 0 65535
 /begin AXIS_DESCR COM_AXIS AXIN_049_TAIR CM_C128 8 -256 255.992 AXIS_PTS_REF AX_049_TAIR /end AXIS_DESCR
/end CHARACTERISTIC
/begin CHARACTERISTIC CAL_27A "значение #27A" VALUE 0x0806B4D8 RL_FNC_UWORD 0 CM_RAW 0 65535 /end CHARACTERISTIC
/begin CHARACTERISTIC CAL_27B "массив #27B" VAL_BLK 0x0806B4DC RL_FNC_UWORD 0 CM_RAW 0 65535 MATRIX_DIM 2 1 1 /end CHARACTERISTIC
/begin CHARACTERISTIC CAL_27C "кривая #27C 9: TCOOL" CURVE 0x0806B6FC RL_FNC_UWORD 0 CM_RAW 0 65535
 /begin AXIS_DESCR COM_AXIS AXIN_045_TCOOL CM_C128 9 -256 255.992 AXIS_PTS_REF AX_045_TCOOL /end AXIS_DESCR
/end CHARACTERISTIC
/begin CHARACTERISTIC CAL_27D "значение #27D" VALUE 0x0806AA2A RL_FNC_UWORD 0 CM_RAW 0 65535 /end CHARACTERISTIC
/begin CHARACTERISTIC CAL_27E "значение #27E" VALUE 0x0806B248 RL_FNC_SWORD 0 CM_RAW -32768 32767 /end CHARACTERISTIC
/begin CHARACTERISTIC CAL_27F "карта #27F 10x8: N × LOAD" MAP 0x0806AE18 RL_FNC_UWORD 0 CM_RAW 0 65535
 /begin AXIS_DESCR COM_AXIS AXIN_04B_N CM_RPM2 8 0 32767.5 AXIS_PTS_REF AX_04B_N /end AXIS_DESCR
 /begin AXIS_DESCR COM_AXIS AXIN_04C_LOAD CM_RAW 10 0 65535 AXIS_PTS_REF AX_04C_LOAD /end AXIS_DESCR
/end CHARACTERISTIC
/begin CHARACTERISTIC CAL_280 "карта #280 10x8: N × LOAD" MAP 0x0806AA7C RL_FNC_UWORD 0 CM_RAW 0 65535
 /begin AXIS_DESCR COM_AXIS AXIN_04B_N CM_RPM2 8 0 32767.5 AXIS_PTS_REF AX_04B_N /end AXIS_DESCR
 /begin AXIS_DESCR COM_AXIS AXIN_04C_LOAD CM_RAW 10 0 65535 AXIS_PTS_REF AX_04C_LOAD /end AXIS_DESCR
/end CHARACTERISTIC
/begin CHARACTERISTIC CAL_281 "карта #281 10x8: N × LOAD" MAP 0x0806AB1C RL_FNC_UWORD 0 CM_RAW 0 65535
 /begin AXIS_DESCR COM_AXIS AXIN_04B_N CM_RPM2 8 0 32767.5 AXIS_PTS_REF AX_04B_N /end AXIS_DESCR
 /begin AXIS_DESCR COM_AXIS AXIN_04C_LOAD CM_RAW 10 0 65535 AXIS_PTS_REF AX_04C_LOAD /end AXIS_DESCR
/end CHARACTERISTIC
/begin CHARACTERISTIC CAL_282 "карта #282 10x8: N × LOAD" MAP 0x0806B4F0 RL_FNC_UWORD 0 CM_RAW 0 65535
 /begin AXIS_DESCR COM_AXIS AXIN_04B_N CM_RPM2 8 0 32767.5 AXIS_PTS_REF AX_04B_N /end AXIS_DESCR
 /begin AXIS_DESCR COM_AXIS AXIN_04C_LOAD CM_RAW 10 0 65535 AXIS_PTS_REF AX_04C_LOAD /end AXIS_DESCR
/end CHARACTERISTIC
/begin CHARACTERISTIC CAL_283 "кривая #283 6: ?" CURVE 0x0806B590 RL_FNC_UWORD 0 CM_RAW 0 65535 /begin AXIS_DESCR COM_AXIS AXIN_048 CM_RAW 6 0 65535 AXIS_PTS_REF AX_048 /end AXIS_DESCR /end CHARACTERISTIC
/begin CHARACTERISTIC CAL_284 "кривая #284 9: TCOOL" CURVE 0x0806B59C RL_FNC_UWORD 0 CM_RAW 0 65535
 /begin AXIS_DESCR COM_AXIS AXIN_00A_TCOOL CM_C128 9 -256 255.992 AXIS_PTS_REF AX_00A_TCOOL /end AXIS_DESCR
/end CHARACTERISTIC
/begin CHARACTERISTIC CAL_285 "карта #285 10x8: N × LOAD" MAP 0x0806B5B0 RL_FNC_UWORD 0 CM_RAW 0 65535
 /begin AXIS_DESCR COM_AXIS AXIN_04B_N CM_RPM2 8 0 32767.5 AXIS_PTS_REF AX_04B_N /end AXIS_DESCR
 /begin AXIS_DESCR COM_AXIS AXIN_04C_LOAD CM_RAW 10 0 65535 AXIS_PTS_REF AX_04C_LOAD /end AXIS_DESCR
/end CHARACTERISTIC
/begin CHARACTERISTIC CAL_286 "массив #286 [знак по значениям]" VAL_BLK 0x0806B390 RL_FNC_SWORD 0 CM_RAW -32768 32767 MATRIX_DIM 2 1 1 /end CHARACTERISTIC
/begin CHARACTERISTIC CAL_287 "массив #287 [знак по значениям]" VAL_BLK 0x0806B38C RL_FNC_SWORD 0 CM_RAW -32768 32767 MATRIX_DIM 2 1 1 /end CHARACTERISTIC
/begin CHARACTERISTIC CAL_288 "карта #288 10x8: N × LOAD" MAP 0x0806AC98 RL_FNC_UWORD 0 CM_RAW 0 65535
 /begin AXIS_DESCR COM_AXIS AXIN_04B_N CM_RPM2 8 0 32767.5 AXIS_PTS_REF AX_04B_N /end AXIS_DESCR
 /begin AXIS_DESCR COM_AXIS AXIN_04C_LOAD CM_RAW 10 0 65535 AXIS_PTS_REF AX_04C_LOAD /end AXIS_DESCR
/end CHARACTERISTIC
/begin CHARACTERISTIC CAL_289 "кривая #289 6: ?" CURVE 0x0806AD38 RL_FNC_UWORD 0 CM_RAW 0 65535 /begin AXIS_DESCR COM_AXIS AXIN_048 CM_RAW 6 0 65535 AXIS_PTS_REF AX_048 /end AXIS_DESCR /end CHARACTERISTIC
/begin CHARACTERISTIC CAL_28A "карта #28A 10x8: N × LOAD" MAP 0x0806AEB8 RL_FNC_UWORD 0 CM_RAW 0 65535
 /begin AXIS_DESCR COM_AXIS AXIN_04B_N CM_RPM2 8 0 32767.5 AXIS_PTS_REF AX_04B_N /end AXIS_DESCR
 /begin AXIS_DESCR COM_AXIS AXIN_04C_LOAD CM_RAW 10 0 65535 AXIS_PTS_REF AX_04C_LOAD /end AXIS_DESCR
/end CHARACTERISTIC
/begin CHARACTERISTIC CAL_28B "значение #28B" VALUE 0x0806AF58 RL_FNC_UWORD 0 CM_RAW 0 65535 /end CHARACTERISTIC
/begin CHARACTERISTIC CAL_28C "кривая #28C 16: TCOOL" CURVE 0x0806AD44 RL_FNC_SWORD 0 CM_RAW -32768 32767
 /begin AXIS_DESCR COM_AXIS AXIN_004_TCOOL CM_C128 16 -256 255.992 AXIS_PTS_REF AX_004_TCOOL /end AXIS_DESCR
/end CHARACTERISTIC
/begin CHARACTERISTIC CAL_28F "значение #28F" VALUE 0x0806AF6E RL_FNC_UWORD 0 CM_RAW 0 65535 /end CHARACTERISTIC
/begin CHARACTERISTIC CAL_290 "значение #290" VALUE 0x0806AF72 RL_FNC_UWORD 0 CM_RAW 0 65535 /end CHARACTERISTIC
/begin CHARACTERISTIC CAL_291_0 "кривая #291 17: N [1/2]" CURVE 0x0806B204 RL_FNC_UWORD 0 CM_RAW 0 65535
 /begin AXIS_DESCR COM_AXIS AXIN_001_N CM_RPM2 17 0 32767.5 AXIS_PTS_REF AX_001_N /end AXIS_DESCR
/end CHARACTERISTIC
/begin CHARACTERISTIC CAL_291_1 "кривая #291 17: N [2/2]" CURVE 0x0806B226 RL_FNC_UWORD 0 CM_RAW 0 65535
 /begin AXIS_DESCR COM_AXIS AXIN_001_N CM_RPM2 17 0 32767.5 AXIS_PTS_REF AX_001_N /end AXIS_DESCR
/end CHARACTERISTIC
/begin CHARACTERISTIC CAL_292 "значение #292" VALUE 0x0806B394 RL_FNC_UWORD 0 CM_RAW 0 65535 /end CHARACTERISTIC
/begin CHARACTERISTIC CAL_293 "значение #293" VALUE 0x0806B6F8 RL_FNC_UWORD 0 CM_RAW 0 65535 /end CHARACTERISTIC
/begin CHARACTERISTIC CAL_294 "значение #294" VALUE 0x0806B4DA RL_FNC_UWORD 0 CM_RAW 0 65535 /end CHARACTERISTIC
/begin CHARACTERISTIC CAL_295 "массив #295" VAL_BLK 0x0806B4E4 RL_FNC_UWORD 0 CM_RAW 0 65535 MATRIX_DIM 2 1 1 /end CHARACTERISTIC
/begin CHARACTERISTIC CAL_296 "значение #296" VALUE 0x0806B710 RL_FNC_UWORD 0 CM_RAW 0 65535 /end CHARACTERISTIC
/begin CHARACTERISTIC CAL_297 "значение #297" VALUE 0x0806B4EE RL_FNC_UWORD 0 CM_RAW 0 65535 /end CHARACTERISTIC
/begin CHARACTERISTIC CAL_298 "значение #298" VALUE 0x0806B650 RL_FNC_SBYTE 0 CM_RAW -128 127 /end CHARACTERISTIC
/begin CHARACTERISTIC CAL_299 "значение #299" VALUE 0x0806B652 RL_FNC_UWORD 0 CM_RAW 0 65535 /end CHARACTERISTIC
/begin CHARACTERISTIC CAL_29A "значение #29A" VALUE 0x0806B654 RL_FNC_UWORD 0 CM_RAW 0 65535 /end CHARACTERISTIC
/begin CHARACTERISTIC CAL_29B "карта #29B 10x8: N × LOAD" MAP 0x0806B658 RL_FNC_UWORD 0 CM_RAW 0 65535
 /begin AXIS_DESCR COM_AXIS AXIN_04B_N CM_RPM2 8 0 32767.5 AXIS_PTS_REF AX_04B_N /end AXIS_DESCR
 /begin AXIS_DESCR COM_AXIS AXIN_04C_LOAD CM_RAW 10 0 65535 AXIS_PTS_REF AX_04C_LOAD /end AXIS_DESCR
/end CHARACTERISTIC
/begin CHARACTERISTIC CAL_29C "карта #29C 16x18: ? × TCOOL" MAP 0x0806644C RL_FNC_UWORD 0 CM_RAW 0 65535 /begin AXIS_DESCR COM_AXIS AXIN_076 CM_RAW 18 0 65535 AXIS_PTS_REF AX_076 /end AXIS_DESCR
 /begin AXIS_DESCR COM_AXIS AXIN_004_TCOOL CM_C128 16 -256 255.992 AXIS_PTS_REF AX_004_TCOOL /end AXIS_DESCR
/end CHARACTERISTIC
/begin CHARACTERISTIC CAL_29D "карта #29D 11x16: TAIR × TCOOL" MAP 0x0806668C RL_FNC_UWORD 0 CM_RAW 0 65535
 /begin AXIS_DESCR COM_AXIS AXIN_090_TAIR CM_C128 16 -256 255.992 AXIS_PTS_REF AX_090_TAIR /end AXIS_DESCR
 /begin AXIS_DESCR COM_AXIS AXIN_08F_TCOOL CM_C128 11 -256 255.992 AXIS_PTS_REF AX_08F_TCOOL /end AXIS_DESCR
/end CHARACTERISTIC
/begin CHARACTERISTIC CAL_29E "кривая #29E 3: ?" CURVE 0x080667EC RL_FNC_UWORD 0 CM_RAW 0 65535 /begin AXIS_DESCR COM_AXIS AXIN_04F CM_RAW 3 0 65535 AXIS_PTS_REF AX_04F /end AXIS_DESCR /end CHARACTERISTIC
/begin CHARACTERISTIC CAL_29F "карта #29F 9x16: TCOOL × TCOOL" MAP 0x080667F4 RL_FNC_UWORD 0 CM_RAW 0 65535
 /begin AXIS_DESCR COM_AXIS AXIN_004_TCOOL CM_C128 16 -256 255.992 AXIS_PTS_REF AX_004_TCOOL /end AXIS_DESCR
 /begin AXIS_DESCR COM_AXIS AXIN_045_TCOOL CM_C128 9 -256 255.992 AXIS_PTS_REF AX_045_TCOOL /end AXIS_DESCR
/end CHARACTERISTIC
/begin CHARACTERISTIC CAL_2A0 "карта #2A0 12x16: N × LOAD" MAP 0x08066914 RL_FNC_UWORD 0 CM_RAW 0 65535
 /begin AXIS_DESCR COM_AXIS AXIN_080_N CM_RPM2 16 0 32767.5 AXIS_PTS_REF AX_080_N /end AXIS_DESCR
 /begin AXIS_DESCR COM_AXIS AXIN_07F_LOAD CM_RAW 12 0 65535 AXIS_PTS_REF AX_07F_LOAD /end AXIS_DESCR
/end CHARACTERISTIC
/begin CHARACTERISTIC CAL_2A1 "карта #2A1 10x9: TCOOL × LOAD" MAP 0x0806F66C RL_FNC_UWORD 0 CM_RAW 0 65535
 /begin AXIS_DESCR COM_AXIS AXIN_00A_TCOOL CM_C128 9 -256 255.992 AXIS_PTS_REF AX_00A_TCOOL /end AXIS_DESCR
 /begin AXIS_DESCR COM_AXIS AXIN_01E_LOAD CM_RAW 10 0 65535 AXIS_PTS_REF AX_01E_LOAD /end AXIS_DESCR
/end CHARACTERISTIC
/begin CHARACTERISTIC CAL_2A4 "кривая #2A4 8: ?" CURVE 0x080644BC RL_FNC_SBYTE 0 CM_RAW -128 127 /begin AXIS_DESCR COM_AXIS AXIN_054 CM_RAW 8 0 65535 AXIS_PTS_REF AX_054 /end AXIS_DESCR /end CHARACTERISTIC
/begin CHARACTERISTIC CAL_2A5 "значение #2A5" VALUE 0x080644C4 RL_FNC_SLONG 0 CM_RAW -2.14748e+09 2.14748e+09 /end CHARACTERISTIC
/begin CHARACTERISTIC CAL_2A6 "кривая #2A6 8: ?" CURVE 0x080644A8 RL_FNC_SWORD 0 CM_RAW -32768 32767 /begin AXIS_DESCR COM_AXIS AXIN_054 CM_RAW 8 0 65535 AXIS_PTS_REF AX_054 /end AXIS_DESCR /end CHARACTERISTIC
/begin CHARACTERISTIC CAL_2A7 "значение #2A7" VALUE 0x0806447C RL_FNC_SWORD 0 CM_RAW -32768 32767 /end CHARACTERISTIC
/begin CHARACTERISTIC CAL_2ED "значение #2ED" VALUE 0x0806B748 RL_FNC_SBYTE 0 CM_RAW -128 127 /end CHARACTERISTIC
/begin CHARACTERISTIC CAL_2F5 "значение #2F5" VALUE 0x0806B749 RL_FNC_SBYTE 0 CM_RAW -128 127 /end CHARACTERISTIC
/begin CHARACTERISTIC CAL_2F6 "значение #2F6" VALUE 0x0806B74A RL_FNC_SBYTE 0 CM_RAW -128 127 /end CHARACTERISTIC
/begin CHARACTERISTIC CAL_2F7 "значение #2F7" VALUE 0x08065A30 RL_FNC_UWORD 0 CM_RAW 0 65535 /end CHARACTERISTIC
/begin CHARACTERISTIC CAL_2F8 "кривая #2F8 10: N" CURVE 0x08065A1C RL_FNC_UWORD 0 CM_RAW 0 65535
 /begin AXIS_DESCR COM_AXIS AXIN_00C_N CM_RPM2 10 0 32767.5 AXIS_PTS_REF AX_00C_N /end AXIS_DESCR
/end CHARACTERISTIC
/begin CHARACTERISTIC CAL_2F9 "кривая #2F9 10: N" CURVE 0x08065A34 RL_FNC_UWORD 0 CM_RAW 0 65535
 /begin AXIS_DESCR COM_AXIS AXIN_00C_N CM_RPM2 10 0 32767.5 AXIS_PTS_REF AX_00C_N /end AXIS_DESCR
/end CHARACTERISTIC
/begin CHARACTERISTIC CAL_2FA "массив #2FA" VAL_BLK 0x080659F8 RL_FNC_SBYTE 0 CM_RAW -128 127 MATRIX_DIM 32 1 1 /end CHARACTERISTIC
/begin CHARACTERISTIC CAL_2FB "значение #2FB" VALUE 0x080705A4 RL_FNC_UWORD 0 CM_RAW 0 65535 /end CHARACTERISTIC
/begin CHARACTERISTIC CAL_2FD "кривая #2FD 9: TCOOL" CURVE 0x0806CFE0 RL_FNC_UWORD 0 CM_RAW 0 65535
 /begin AXIS_DESCR COM_AXIS AXIN_00A_TCOOL CM_C128 9 -256 255.992 AXIS_PTS_REF AX_00A_TCOOL /end AXIS_DESCR
/end CHARACTERISTIC
/begin CHARACTERISTIC CAL_2FE "значение #2FE" VALUE 0x0806CFF2 RL_FNC_UWORD 0 CM_RAW 0 65535 /end CHARACTERISTIC
/begin CHARACTERISTIC CAL_2FF_0 "кривая #2FF 16: PEDAL [1/2]" CURVE 0x0806CFF4 RL_FNC_UWORD 0 CM_RAW 0 65535
 /begin AXIS_DESCR COM_AXIS AXIN_01B_PEDAL CM_P128 16 0 511.992 AXIS_PTS_REF AX_01B_PEDAL /end AXIS_DESCR
/end CHARACTERISTIC
/begin CHARACTERISTIC CAL_2FF_1 "кривая #2FF 16: PEDAL [2/2]" CURVE 0x0806D014 RL_FNC_UWORD 0 CM_RAW 0 65535
 /begin AXIS_DESCR COM_AXIS AXIN_01B_PEDAL CM_P128 16 0 511.992 AXIS_PTS_REF AX_01B_PEDAL /end AXIS_DESCR
/end CHARACTERISTIC
/begin CHARACTERISTIC CAL_300 "кривая #300 9: TCOOL" CURVE 0x0806D034 RL_FNC_UWORD 0 CM_RAW 0 65535
 /begin AXIS_DESCR COM_AXIS AXIN_00A_TCOOL CM_C128 9 -256 255.992 AXIS_PTS_REF AX_00A_TCOOL /end AXIS_DESCR
/end CHARACTERISTIC
/begin CHARACTERISTIC CAL_301 "значение #301" VALUE 0x0806D046 RL_FNC_UWORD 0 CM_RAW 0 65535 /end CHARACTERISTIC
/begin CHARACTERISTIC CAL_302 "кривая #302 8: N" CURVE 0x0806D068 RL_FNC_UWORD 0 CM_RAW 0 65535
 /begin AXIS_DESCR COM_AXIS AXIN_050_N CM_RPM2 8 0 32767.5 AXIS_PTS_REF AX_050_N /end AXIS_DESCR
/end CHARACTERISTIC
/begin CHARACTERISTIC CAL_303_0 "кривая #303 9: TCOOL [1/2]" CURVE 0x0806D0A4 RL_FNC_UWORD 0 CM_RAW 0 65535
 /begin AXIS_DESCR COM_AXIS AXIN_00A_TCOOL CM_C128 9 -256 255.992 AXIS_PTS_REF AX_00A_TCOOL /end AXIS_DESCR
/end CHARACTERISTIC
/begin CHARACTERISTIC CAL_303_1 "кривая #303 9: TCOOL [2/2]" CURVE 0x0806D0B6 RL_FNC_UWORD 0 CM_RAW 0 65535
 /begin AXIS_DESCR COM_AXIS AXIN_00A_TCOOL CM_C128 9 -256 255.992 AXIS_PTS_REF AX_00A_TCOOL /end AXIS_DESCR
/end CHARACTERISTIC
/begin CHARACTERISTIC CAL_304_0 "кривая #304 9: TCOOL [1/2]" CURVE 0x0806D07C RL_FNC_UWORD 0 CM_RAW 0 65535
 /begin AXIS_DESCR COM_AXIS AXIN_00A_TCOOL CM_C128 9 -256 255.992 AXIS_PTS_REF AX_00A_TCOOL /end AXIS_DESCR
/end CHARACTERISTIC
/begin CHARACTERISTIC CAL_304_1 "кривая #304 9: TCOOL [2/2]" CURVE 0x0806D08E RL_FNC_UWORD 0 CM_RAW 0 65535
 /begin AXIS_DESCR COM_AXIS AXIN_00A_TCOOL CM_C128 9 -256 255.992 AXIS_PTS_REF AX_00A_TCOOL /end AXIS_DESCR
/end CHARACTERISTIC
/begin CHARACTERISTIC CAL_305 "значение #305" VALUE 0x0806D0A0 RL_FNC_UWORD 0 CM_RAW 0 65535 /end CHARACTERISTIC
/begin CHARACTERISTIC CAL_306 "значение #306" VALUE 0x0806D078 RL_FNC_UWORD 0 CM_RAW 0 65535 /end CHARACTERISTIC
/begin CHARACTERISTIC CAL_307 "значение #307" VALUE 0x0806D07A RL_FNC_UWORD 0 CM_RAW 0 65535 /end CHARACTERISTIC
/begin CHARACTERISTIC CAL_308 "кривая #308 16: ?" CURVE 0x0806D048 RL_FNC_UWORD 0 CM_RAW 0 65535 /begin AXIS_DESCR COM_AXIS AXIN_012 CM_RAW 16 0 65535 AXIS_PTS_REF AX_012 /end AXIS_DESCR /end CHARACTERISTIC
/begin CHARACTERISTIC CAL_309 "значение #309" VALUE 0x0806D0F8 RL_FNC_SBYTE 0 CM_RAW -128 127 /end CHARACTERISTIC
/begin CHARACTERISTIC CAL_30A "массив #30A" VAL_BLK 0x0806D0FC RL_FNC_UWORD 0 CM_RAW 0 65535 MATRIX_DIM 2 1 1 /end CHARACTERISTIC
/begin CHARACTERISTIC CAL_30B_0 "кривая #30B 9: TCOOL [1/2]" CURVE 0x0806D104 RL_FNC_UWORD 0 CM_RAW 0 65535
 /begin AXIS_DESCR COM_AXIS AXIN_00A_TCOOL CM_C128 9 -256 255.992 AXIS_PTS_REF AX_00A_TCOOL /end AXIS_DESCR
/end CHARACTERISTIC
/begin CHARACTERISTIC CAL_30B_1 "кривая #30B 9: TCOOL [2/2]" CURVE 0x0806D116 RL_FNC_UWORD 0 CM_RAW 0 65535
 /begin AXIS_DESCR COM_AXIS AXIN_00A_TCOOL CM_C128 9 -256 255.992 AXIS_PTS_REF AX_00A_TCOOL /end AXIS_DESCR
/end CHARACTERISTIC
/begin CHARACTERISTIC CAL_30C "кривая #30C 14: UBAT" CURVE 0x0806D12C RL_FNC_UWORD 0 CM_RAW 0 65535
 /begin AXIS_DESCR COM_AXIS AXIN_003_UBAT CM_RAW 14 0 65535 AXIS_PTS_REF AX_003_UBAT /end AXIS_DESCR
/end CHARACTERISTIC
/begin CHARACTERISTIC CAL_30D_0 "кривая #30D 16: TCOOL [1/3]" CURVE 0x0806D1A8 RL_FNC_UWORD 0 CM_RAW 0 65535
 /begin AXIS_DESCR COM_AXIS AXIN_004_TCOOL CM_C128 16 -256 255.992 AXIS_PTS_REF AX_004_TCOOL /end AXIS_DESCR
/end CHARACTERISTIC
/begin CHARACTERISTIC CAL_30D_1 "кривая #30D 16: TCOOL [2/3]" CURVE 0x0806D1C8 RL_FNC_UWORD 0 CM_RAW 0 65535
 /begin AXIS_DESCR COM_AXIS AXIN_004_TCOOL CM_C128 16 -256 255.992 AXIS_PTS_REF AX_004_TCOOL /end AXIS_DESCR
/end CHARACTERISTIC
/begin CHARACTERISTIC CAL_30D_2 "кривая #30D 16: TCOOL [3/3]" CURVE 0x0806D1E8 RL_FNC_UWORD 0 CM_RAW 0 65535
 /begin AXIS_DESCR COM_AXIS AXIN_004_TCOOL CM_C128 16 -256 255.992 AXIS_PTS_REF AX_004_TCOOL /end AXIS_DESCR
/end CHARACTERISTIC
/begin CHARACTERISTIC CAL_30E_0 "кривая #30E 16: TCOOL [1/3]" CURVE 0x0806D148 RL_FNC_UWORD 0 CM_RAW 0 65535
 /begin AXIS_DESCR COM_AXIS AXIN_004_TCOOL CM_C128 16 -256 255.992 AXIS_PTS_REF AX_004_TCOOL /end AXIS_DESCR
/end CHARACTERISTIC
/begin CHARACTERISTIC CAL_30E_1 "кривая #30E 16: TCOOL [2/3]" CURVE 0x0806D168 RL_FNC_UWORD 0 CM_RAW 0 65535
 /begin AXIS_DESCR COM_AXIS AXIN_004_TCOOL CM_C128 16 -256 255.992 AXIS_PTS_REF AX_004_TCOOL /end AXIS_DESCR
/end CHARACTERISTIC
/begin CHARACTERISTIC CAL_30E_2 "кривая #30E 16: TCOOL [3/3]" CURVE 0x0806D188 RL_FNC_UWORD 0 CM_RAW 0 65535
 /begin AXIS_DESCR COM_AXIS AXIN_004_TCOOL CM_C128 16 -256 255.992 AXIS_PTS_REF AX_004_TCOOL /end AXIS_DESCR
/end CHARACTERISTIC
/begin CHARACTERISTIC CAL_30F "массив #30F" VAL_BLK 0x0806D21C RL_FNC_UWORD 0 CM_RAW 0 65535 MATRIX_DIM 2 1 1 /end CHARACTERISTIC
/begin CHARACTERISTIC CAL_310 "значение #310" VALUE 0x0806D220 RL_FNC_UWORD 0 CM_RAW 0 65535 /end CHARACTERISTIC
/begin CHARACTERISTIC CAL_311 "значение #311" VALUE 0x0806D222 RL_FNC_UWORD 0 CM_RAW 0 65535 /end CHARACTERISTIC
/begin CHARACTERISTIC CAL_312_0 "кривая #312 8: TAIR [1/3]" CURVE 0x0806D224 RL_FNC_UWORD 0 CM_RAW 0 65535
 /begin AXIS_DESCR COM_AXIS AXIN_049_TAIR CM_C128 8 -256 255.992 AXIS_PTS_REF AX_049_TAIR /end AXIS_DESCR
/end CHARACTERISTIC
/begin CHARACTERISTIC CAL_312_1 "кривая #312 8: TAIR [2/3]" CURVE 0x0806D234 RL_FNC_UWORD 0 CM_RAW 0 65535
 /begin AXIS_DESCR COM_AXIS AXIN_049_TAIR CM_C128 8 -256 255.992 AXIS_PTS_REF AX_049_TAIR /end AXIS_DESCR
/end CHARACTERISTIC
/begin CHARACTERISTIC CAL_312_2 "кривая #312 8: TAIR [3/3]" CURVE 0x0806D244 RL_FNC_UWORD 0 CM_RAW 0 65535
 /begin AXIS_DESCR COM_AXIS AXIN_049_TAIR CM_C128 8 -256 255.992 AXIS_PTS_REF AX_049_TAIR /end AXIS_DESCR
/end CHARACTERISTIC
/begin CHARACTERISTIC CAL_313 "значение #313" VALUE 0x0806D266 RL_FNC_UWORD 0 CM_RAW 0 65535 /end CHARACTERISTIC
/begin CHARACTERISTIC CAL_314 "кривая #314 9: TCOOL" CURVE 0x0806D254 RL_FNC_UWORD 0 CM_RAW 0 65535
 /begin AXIS_DESCR COM_AXIS AXIN_045_TCOOL CM_C128 9 -256 255.992 AXIS_PTS_REF AX_045_TCOOL /end AXIS_DESCR
/end CHARACTERISTIC
/begin CHARACTERISTIC CAL_315 "значение #315" VALUE 0x0806D268 RL_FNC_UWORD 0 CM_RAW 0 65535 /end CHARACTERISTIC
/begin CHARACTERISTIC CAL_316 "значение #316" VALUE 0x0806D27C RL_FNC_UWORD 0 CM_RAW 0 65535 /end CHARACTERISTIC
/begin CHARACTERISTIC CAL_317 "значение #317" VALUE 0x0806D27E RL_FNC_UWORD 0 CM_RAW 0 65535 /end CHARACTERISTIC
/begin CHARACTERISTIC CAL_318_0 "кривая #318 11: ? [1/2]" CURVE 0x0806D284 RL_FNC_UWORD 0 CM_RAW 0 65535 /begin AXIS_DESCR COM_AXIS AXIN_08E CM_RAW 11 0 65535 AXIS_PTS_REF AX_08E /end AXIS_DESCR /end CHARACTERISTIC
/begin CHARACTERISTIC CAL_318_1 "кривая #318 11: ? [2/2]" CURVE 0x0806D29A RL_FNC_UWORD 0 CM_RAW 0 65535 /begin AXIS_DESCR COM_AXIS AXIN_08E CM_RAW 11 0 65535 AXIS_PTS_REF AX_08E /end AXIS_DESCR /end CHARACTERISTIC
/begin CHARACTERISTIC CAL_319 "массив #319 [знак по значениям]" VAL_BLK 0x0806D278 RL_FNC_SWORD 0 CM_RAW -32768 32767 MATRIX_DIM 2 1 1 /end CHARACTERISTIC
/begin CHARACTERISTIC CAL_31A "массив #31A [знак по значениям]" VAL_BLK 0x0806D274 RL_FNC_SWORD 0 CM_RAW -32768 32767 MATRIX_DIM 2 1 1 /end CHARACTERISTIC
/begin CHARACTERISTIC CAL_31B "значение #31B" VALUE 0x080657DE RL_FNC_SBYTE 0 CM_RAW -128 127 /end CHARACTERISTIC
/begin CHARACTERISTIC CAL_31D "значение #31D" VALUE 0x0807036E RL_FNC_UWORD 0 CM_RAW 0 65535 /end CHARACTERISTIC
/begin CHARACTERISTIC CAL_31E "значение #31E" VALUE 0x08070370 RL_FNC_UWORD 0 CM_RAW 0 65535 /end CHARACTERISTIC
/begin CHARACTERISTIC CAL_320 "значение #320" VALUE 0x0806E7CC RL_FNC_SWORD 0 CM_RAW -32768 32767 /end CHARACTERISTIC
/begin CHARACTERISTIC CAL_321_0 "кривая #321 16: ? [1/3]" CURVE 0x080703F0 RL_FNC_UWORD 0 CM_RAW 0 65535 /begin AXIS_DESCR COM_AXIS AXIN_058 CM_RAW 16 0 65535 AXIS_PTS_REF AX_058 /end AXIS_DESCR /end CHARACTERISTIC
/begin CHARACTERISTIC CAL_321_1 "кривая #321 16: ? [2/3]" CURVE 0x08070410 RL_FNC_UWORD 0 CM_RAW 0 65535 /begin AXIS_DESCR COM_AXIS AXIN_058 CM_RAW 16 0 65535 AXIS_PTS_REF AX_058 /end AXIS_DESCR /end CHARACTERISTIC
/begin CHARACTERISTIC CAL_321_2 "кривая #321 16: ? [3/3]" CURVE 0x08070430 RL_FNC_UWORD 0 CM_RAW 0 65535 /begin AXIS_DESCR COM_AXIS AXIN_058 CM_RAW 16 0 65535 AXIS_PTS_REF AX_058 /end AXIS_DESCR /end CHARACTERISTIC
/begin CHARACTERISTIC CAL_322 "значение #322" VALUE 0x0807049A RL_FNC_UWORD 0 CM_RAW 0 65535 /end CHARACTERISTIC
/begin CHARACTERISTIC CAL_323_0 "кривая #323 16: VSPEED [1/2]" CURVE 0x08070450 RL_FNC_UWORD 0 CM_RAW 0 65535
 /begin AXIS_DESCR COM_AXIS AXIN_056_VSPEED CM_KMH64 16 0 1023.98 AXIS_PTS_REF AX_056_VSPEED /end AXIS_DESCR
/end CHARACTERISTIC
/begin CHARACTERISTIC CAL_323_1 "кривая #323 16: VSPEED [2/2]" CURVE 0x08070470 RL_FNC_UWORD 0 CM_RAW 0 65535
 /begin AXIS_DESCR COM_AXIS AXIN_056_VSPEED CM_KMH64 16 0 1023.98 AXIS_PTS_REF AX_056_VSPEED /end AXIS_DESCR
/end CHARACTERISTIC
/begin CHARACTERISTIC CAL_324 "кривая #324 9: TAIR [знак по значениям]" CURVE 0x080746B4 RL_FNC_SWORD 0 CM_RAW -32768 32767
 /begin AXIS_DESCR COM_AXIS AXIN_057_TAIR CM_C128 9 -256 255.992 AXIS_PTS_REF AX_057_TAIR /end AXIS_DESCR
/end CHARACTERISTIC
/begin CHARACTERISTIC CAL_325 "массив #325" VAL_BLK 0x08070490 RL_FNC_UWORD 0 CM_RAW 0 65535 MATRIX_DIM 2 1 1 /end CHARACTERISTIC
/begin CHARACTERISTIC CAL_326 "значение #326" VALUE 0x08070494 RL_FNC_UWORD 0 CM_RAW 0 65535 /end CHARACTERISTIC
/begin CHARACTERISTIC CAL_327 "значение #327" VALUE 0x08070496 RL_FNC_UWORD 0 CM_RAW 0 65535 /end CHARACTERISTIC
/begin CHARACTERISTIC CAL_328 "значение #328" VALUE 0x08070498 RL_FNC_UWORD 0 CM_RAW 0 65535 /end CHARACTERISTIC
/begin CHARACTERISTIC CAL_32A "кривая #32A 9: TCOOL" CURVE 0x080703B4 RL_FNC_UWORD 0 CM_RAW 0 65535
 /begin AXIS_DESCR COM_AXIS AXIN_00A_TCOOL CM_C128 9 -256 255.992 AXIS_PTS_REF AX_00A_TCOOL /end AXIS_DESCR
/end CHARACTERISTIC
/begin CHARACTERISTIC CAL_32B "кривая #32B 9: TCOOL" CURVE 0x080703DC RL_FNC_UWORD 0 CM_RAW 0 65535
 /begin AXIS_DESCR COM_AXIS AXIN_00A_TCOOL CM_C128 9 -256 255.992 AXIS_PTS_REF AX_00A_TCOOL /end AXIS_DESCR
/end CHARACTERISTIC
/begin CHARACTERISTIC CAL_32C "кривая #32C 9: TCOOL" CURVE 0x080703C8 RL_FNC_UWORD 0 CM_RAW 0 65535
 /begin AXIS_DESCR COM_AXIS AXIN_00A_TCOOL CM_C128 9 -256 255.992 AXIS_PTS_REF AX_00A_TCOOL /end AXIS_DESCR
/end CHARACTERISTIC
/begin CHARACTERISTIC CAL_32D "массив #32D" VAL_BLK 0x080704B4 RL_FNC_UWORD 0 CM_RAW 0 65535 MATRIX_DIM 2 1 1 /end CHARACTERISTIC
/begin CHARACTERISTIC CAL_32E "карта #32E 5x11: ? × ? [знак по значениям]" MAP 0x080704B8 RL_FNC_SWORD 0 CM_RAW -32768 32767 /begin AXIS_DESCR COM_AXIS AXIN_059 CM_RAW 11 0 65535 AXIS_PTS_REF AX_059 /end AXIS_DESCR /begin AXIS_DESCR COM_AXIS AXIN_06E CM_RAW 5 0 65535 AXIS_PTS_REF AX_06E /end AXIS_DESCR /end CHARACTERISTIC
/begin CHARACTERISTIC CAL_32F "массив #32F [знак по значениям]" VAL_BLK 0x08070528 RL_FNC_SWORD 0 CM_RAW -32768 32767 MATRIX_DIM 2 1 1 /end CHARACTERISTIC
/begin CHARACTERISTIC CAL_330 "кривая #330 31: ?" CURVE 0x080705F8 RL_FNC_UWORD 0 CM_RAW 0 65535 /begin AXIS_DESCR COM_AXIS AXIN_05A CM_RAW 31 0 65535 AXIS_PTS_REF AX_05A /end AXIS_DESCR /end CHARACTERISTIC
/begin CHARACTERISTIC CAL_335 "значение #335" VALUE 0x08064528 RL_FNC_UWORD 0 CM_RAW 0 65535 /end CHARACTERISTIC
/begin CHARACTERISTIC CAL_336 "карта #336 8x12: ? × GEAR" MAP 0x0806452C RL_FNC_UWORD 0 CM_RAW 0 65535 /begin AXIS_DESCR COM_AXIS AXIN_05B CM_RAW 12 0 65535 AXIS_PTS_REF AX_05B /end AXIS_DESCR
 /begin AXIS_DESCR COM_AXIS AXIN_05E_GEAR CM_RAW 8 -128 127 AXIS_PTS_REF AX_05E_GEAR /end AXIS_DESCR
/end CHARACTERISTIC
/begin CHARACTERISTIC CAL_337_0 "кривая #337 17: ? [1/2]" CURVE 0x080645EC RL_FNC_UWORD 0 CM_RAW 0 65535 /begin AXIS_DESCR COM_AXIS AXIN_093 CM_RAW 17 0 65535 AXIS_PTS_REF AX_093 /end AXIS_DESCR /end CHARACTERISTIC
/begin CHARACTERISTIC CAL_337_1 "кривая #337 17: ? [2/2]" CURVE 0x0806460E RL_FNC_UWORD 0 CM_RAW 0 65535 /begin AXIS_DESCR COM_AXIS AXIN_093 CM_RAW 17 0 65535 AXIS_PTS_REF AX_093 /end AXIS_DESCR /end CHARACTERISTIC
/begin CHARACTERISTIC CAL_338 "карта #338 9x12: ? × TCOOL" MAP 0x080646D4 RL_FNC_UWORD 0 CM_RAW 0 65535 /begin AXIS_DESCR COM_AXIS AXIN_05B CM_RAW 12 0 65535 AXIS_PTS_REF AX_05B /end AXIS_DESCR
 /begin AXIS_DESCR COM_AXIS AXIN_00A_TCOOL CM_C128 9 -256 255.992 AXIS_PTS_REF AX_00A_TCOOL /end AXIS_DESCR
/end CHARACTERISTIC
/begin CHARACTERISTIC CAL_339 "карта #339 9x8: N × TCOOL" MAP 0x08064644 RL_FNC_UWORD 0 CM_RAW 0 65535
 /begin AXIS_DESCR COM_AXIS AXIN_050_N CM_RPM2 8 0 32767.5 AXIS_PTS_REF AX_050_N /end AXIS_DESCR
 /begin AXIS_DESCR COM_AXIS AXIN_00A_TCOOL CM_C128 9 -256 255.992 AXIS_PTS_REF AX_00A_TCOOL /end AXIS_DESCR
/end CHARACTERISTIC
/begin CHARACTERISTIC CAL_33C "массив #33C [знак по значениям]" VAL_BLK 0x080619B0 RL_FNC_SWORD 0 CM_RAW -32768 32767 MATRIX_DIM 2 1 1 /end CHARACTERISTIC
/begin CHARACTERISTIC CAL_33D "значение #33D" VALUE 0x080619B4 RL_FNC_UWORD 0 CM_RAW 0 65535 /end CHARACTERISTIC
/begin CHARACTERISTIC CAL_33E "значение #33E" VALUE 0x080619B6 RL_FNC_UWORD 0 CM_RAW 0 65535 /end CHARACTERISTIC
/begin CHARACTERISTIC CAL_33F "массив #33F" VAL_BLK 0x080619B8 RL_FNC_UWORD 0 CM_RAW 0 65535 MATRIX_DIM 2 1 1 /end CHARACTERISTIC
/begin CHARACTERISTIC CAL_340 "массив #340" VAL_BLK 0x080619BC RL_FNC_UWORD 0 CM_RAW 0 65535 MATRIX_DIM 2 1 1 /end CHARACTERISTIC
/begin CHARACTERISTIC CAL_341 "значение #341" VALUE 0x080619C0 RL_FNC_UWORD 0 CM_RAW 0 65535 /end CHARACTERISTIC
/begin CHARACTERISTIC CAL_342 "массив #342" VAL_BLK 0x080619C4 RL_FNC_SBYTE 0 CM_RAW -128 127 MATRIX_DIM 2 1 1 /end CHARACTERISTIC
/begin CHARACTERISTIC CAL_343 "кривая #343 8: GEAR" CURVE 0x080619C8 RL_FNC_UWORD 0 CM_RAW 0 65535
 /begin AXIS_DESCR COM_AXIS AXIN_05E_GEAR CM_RAW 8 -128 127 AXIS_PTS_REF AX_05E_GEAR /end AXIS_DESCR
/end CHARACTERISTIC
/begin CHARACTERISTIC CAL_344 "массив #344" VAL_BLK 0x080619D8 RL_FNC_UWORD 0 CM_RAW 0 65535 MATRIX_DIM 2 1 1 /end CHARACTERISTIC
/begin CHARACTERISTIC CAL_345 "значение #345" VALUE 0x080619DC RL_FNC_SWORD 0 CM_RAW -32768 32767 /end CHARACTERISTIC
/begin CHARACTERISTIC CAL_346 "значение #346" VALUE 0x080619DE RL_FNC_SWORD 0 CM_RAW -32768 32767 /end CHARACTERISTIC
/begin CHARACTERISTIC CAL_347 "значение #347" VALUE 0x08061A08 RL_FNC_UWORD 0 CM_RAW 0 65535 /end CHARACTERISTIC
/begin CHARACTERISTIC CAL_348_0 "кривая #348 10: N [1/2]" CURVE 0x080619E0 RL_FNC_UWORD 0 CM_RAW 0 65535
 /begin AXIS_DESCR COM_AXIS AXIN_00C_N CM_RPM2 10 0 32767.5 AXIS_PTS_REF AX_00C_N /end AXIS_DESCR
/end CHARACTERISTIC
/begin CHARACTERISTIC CAL_348_1 "кривая #348 10: N [2/2]" CURVE 0x080619F4 RL_FNC_UWORD 0 CM_RAW 0 65535
 /begin AXIS_DESCR COM_AXIS AXIN_00C_N CM_RPM2 10 0 32767.5 AXIS_PTS_REF AX_00C_N /end AXIS_DESCR
/end CHARACTERISTIC
/begin CHARACTERISTIC CAL_349 "значение #349" VALUE 0x08061A0A RL_FNC_UWORD 0 CM_RAW 0 65535 /end CHARACTERISTIC
/begin CHARACTERISTIC CAL_34A "значение #34A" VALUE 0x08061A0C RL_FNC_UWORD 0 CM_RAW 0 65535 /end CHARACTERISTIC
/begin CHARACTERISTIC CAL_34B "массив #34B" VAL_BLK 0x08061A10 RL_FNC_UWORD 0 CM_RAW 0 65535 MATRIX_DIM 2 1 1 /end CHARACTERISTIC
/begin CHARACTERISTIC CAL_34C "значение #34C" VALUE 0x08061A14 RL_FNC_SWORD 0 CM_RAW -32768 32767 /end CHARACTERISTIC
/begin CHARACTERISTIC CAL_34D "значение #34D" VALUE 0x08061A1C RL_FNC_UWORD 0 CM_RAW 0 65535 /end CHARACTERISTIC
/begin CHARACTERISTIC CAL_34E "массив #34E" VAL_BLK 0x08061A18 RL_FNC_UWORD 0 CM_RAW 0 65535 MATRIX_DIM 2 1 1 /end CHARACTERISTIC
/begin CHARACTERISTIC CAL_34F "значение #34F" VALUE 0x08061A1E RL_FNC_UWORD 0 CM_RAW 0 65535 /end CHARACTERISTIC
/begin CHARACTERISTIC CAL_350 "значение #350" VALUE 0x08061A20 RL_FNC_UWORD 0 CM_RAW 0 65535 /end CHARACTERISTIC
/begin CHARACTERISTIC CAL_351 "значение #351" VALUE 0x08061A22 RL_FNC_UWORD 0 CM_RAW 0 65535 /end CHARACTERISTIC
/end MODULE
/end PROJECT
